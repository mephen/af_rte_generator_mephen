AUTOSAR XML (schema 00049)
package /af_EvTi_Interface
  sender receiver interface IfSenderReceiver1
    data Acc: sw-impl-policy=queued
    data Spd
