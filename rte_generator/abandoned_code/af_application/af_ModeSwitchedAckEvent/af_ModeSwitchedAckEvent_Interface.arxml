AUTOSAR XML (schema 00049)
package /af_EvMsa_Interface
  mode switch interface IfModeSwitch1
    mode group ECUMModePrototype1: type=ECUMMode
