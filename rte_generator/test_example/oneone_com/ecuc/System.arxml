AUTOSAR XML (schema 00048)
package /System
  system ModelX
    root-software-compositions:
      root sw composition prototype RootSwCompositionPrototype: software-composition=TPC_Composition
    system mapping SystemMapping
      data-mappings:
        data-element=TPC_Composition.Ctrl.PpIfVehSpd.Spd, system-signal=SystemSignal_Spd
        data-element=TPC_Composition.Ctrl.PpIfVehAcc.Acc, system-signal=SystemSignal_Acc
        data-element=TPC_Composition.Ctrl.PpIfTemperature.Temp, system-signal=SystemSignal_Temp
  ecu instance EcuInstance0
    ecu partition Naruto
    ecu partition Sasuke
  ecu instance EcuInstance1
    ecu partition Kobe
    ecu partition LarryBird
package /Network
  pdu ISignalIPdu_Spd
    signal ISignal_Spd: 32 bit, data-type-policy=PORT-INTERFACE-DEFINITION
  pdu ISignalIPdu_Acc
    signal ISignal_Acc: 32 bit, data-type-policy=PORT-INTERFACE-DEFINITION
  pdu ISignalIPdu_Temp
    signal ISignal_Temp: 32 bit, data-type-policy=PORT-INTERFACE-DEFINITION
