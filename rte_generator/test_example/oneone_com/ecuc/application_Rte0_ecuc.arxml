AUTOSAR XML (schema 00048)
package /ActiveEcuC
  module config Rte: implementation-config-variant=VARIANT-POST-BUILD-SELECTABLE, module-description=Rte_Impl
    RteOsInteraction
      13 x RteUsedOsActivation, all with RteExpectedActivationOffset=0, RteExpectedTickDuration=0:
        Rte_Al_TE2_OsTask_BswMainFunctions_0_10ms: RteActivationOsAlarmRef=Rte_Al_TE2_OsTask_BswMainFunctions_0_10ms, RteActivationOsTaskRef=OsTask_BswMainFunctions
        Rte_Al_TE_OsTask_ApplMainFunctions_0_10ms: RteActivationOsAlarmRef=Rte_Al_TE_OsTask_ApplMainFunctions_0_10ms, RteActivationOsTaskRef=OsTask_ApplMainFunctions
        Rte_Al_TE_OsTask_ApplVerify_0_10ms: RteActivationOsAlarmRef=Rte_Al_TE_OsTask_ApplVerify_0_10ms, RteActivationOsTaskRef=OsTask_ApplVerify
        Rte_Al_TE_OsTask_ApplTimedInitDeInit_0_1ms: RteActivationOsAlarmRef=Rte_Al_TE_OsTask_ApplTimedInitDeInit_0_1ms, RteActivationOsTaskRef=OsTask_ApplTimedInitDeInit
        Rte_Al_TE2_OsTask_BswMainFunctions_0_20ms: RteActivationOsAlarmRef=Rte_Al_TE2_OsTask_BswMainFunctions_0_20ms, RteActivationOsTaskRef=OsTask_BswMainFunctions
        Rte_Al_TE_OsTask_ApplMainFunctions_0_1ms: RteActivationOsAlarmRef=Rte_Al_TE_OsTask_ApplMainFunctions_0_1ms, RteActivationOsTaskRef=OsTask_ApplMainFunctions
        Rte_Al_TE_CanTp_CanTp_MainFunction: RteActivationOsAlarmRef=Rte_Al_TE_CanTp_CanTp_MainFunction, RteActivationOsTaskRef=OsTask_BswMainFunctions
        Rte_Al_TE_ShA_Ivd_MainFunction: RteActivationOsAlarmRef=Rte_Al_TE_ShA_Ivd_MainFunction, RteActivationOsTaskRef=OsTask_ApplMainFunctions
        Rte_Al_TE_SwcTemperatureCorrection_SwcTempCor_MainFunction: RteActivationOsAlarmRef=Rte_Al_TE_SwcTemperatureCorrection_SwcTempCor_MainFunction, RteActivationOsTaskRef=OsTask_Dimming
        Rte_Al_TE_CddUart_CddUart_MainFunction: RteActivationOsAlarmRef=Rte_Al_TE_CddUart_CddUart_MainFunction, RteActivationOsTaskRef=OsTask_BswMainFunctions
        Rte_Al_TE_SwcSelfDiagnostics_SwcSelfDiag_UpdateCpuLoad: RteActivationOsAlarmRef=Rte_Al_TE_SwcSelfDiagnostics_SwcSelfDiag_UpdateCpuLoad, RteActivationOsTaskRef=OsTask_SelfDiagnostics
        Rte_Al_TE_SwcSelfDiagnostics_SwcSelfDiag_UpdateRuntime: RteActivationOsAlarmRef=Rte_Al_TE_SwcSelfDiagnostics_SwcSelfDiag_UpdateRuntime, RteActivationOsTaskRef=OsTask_SelfDiagnostics
        Rte_Al_TE_SwcTouch_SwcTouch_MainFunction: RteActivationOsAlarmRef=Rte_Al_TE_SwcTouch_SwcTouch_MainFunction, RteActivationOsTaskRef=OsTask_Touch
    RteBswGeneral: RteSchMVersionInfoApi=true, RteUseComShadowSignalApi=false
    RteGeneration:
      RteGenerationMode = COMPATIBILITY_MODE
      RteIocInteractionReturnValue = RTE_IOC
      RteValueRangeCheckEnabled = false
      RteCalibrationSupport = NONE
      RteCodeVendorId = 30
      RteDevErrorDetect = true
      RteDevErrorDetectUninit = false
      RteMeasurementSupport = false
      RteOptimizationMode = MEMORY
      RteVfbTraceEnabled = false
      RteNewSerializer = true
    RteInitializationBehavior: RteInitializationStrategy=RTE_INITIALIZATION_STRATEGY_AT_DATA_DECLARATION, RteSectionInitializationPolicy=INIT
    TPC_Composition_Ctrl_Instance (RteSwComponentInstance): RteSoftwareComponentInstanceRef=Ctrl
      3 x RteEventToTaskMapping, all with RteImmediateRestart=false, RteMappedToTaskRef=T001, RteUsedOsAlarmRef=alarm1:
        Send_TempValue_20ms: RtePositionInTask=1, RteEventRef=EvTiTemp_20ms
        Send_AccValue_20ms: RtePositionInTask=2, RteEventRef=EvTiAcc_20ms
        Send_SpdValue_20ms: RtePositionInTask=3, RteEventRef=EvTiSpd_20ms
    TPC_Composition_Obv_Instance (RteSwComponentInstance): RteSoftwareComponentInstanceRef=Obv
      4 x RteEventToTaskMapping:
        Receive_TempValue: RteEventRef=Obv_Ev_DR, RteUsedOsEventRef=event1
        Receive_TempValue_20ms: RteImmediateRestart=false, RtePositionInTask=1, RteEventRef=EvTiTemp_20ms, RteMappedToTaskRef=T011, RteUsedOsAlarmRef=alarm1
        Receive_AccValue_20ms: RteImmediateRestart=false, RtePositionInTask=2, RteEventRef=EvTiAcc_20ms, RteMappedToTaskRef=T011, RteUsedOsAlarmRef=alarm1
        Receive_SpdValue_20ms: RteImmediateRestart=false, RtePositionInTask=3, RteEventRef=EvTiSpd_20ms, RteMappedToTaskRef=T011, RteUsedOsAlarmRef=alarm1
