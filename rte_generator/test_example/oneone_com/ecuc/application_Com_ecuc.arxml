AUTOSAR XML (schema 4-1-1)
package /ActiveEcuC
  module config Com: implementation-config-variant=VARIANT-POST-BUILD
    ComConfig: ComConfigurationId=(unset)
      ComTimeBase: ComRxTimeBase=0.001, ComTxTimeBase=0.001
      3 x ComSignal, all with ComBitPosition=0, ComSignalEndianness=opaque, ComSignalType=UINT8_N, ComTransferProperty=PENDING, ComSignalLength=8, ComFirstTimeout=0, ComTimeout=0:
        ComSignal1: ComHandleId=1, ComSignalInitValue=0x00, ComSystemTemplateSystemSignalRef=iSignalToIPduMapping_Spd
        ComSignal2: ComHandleId=2, ComSignalInitValue=0, ComSystemTemplateSystemSignalRef=iSignalToIPduMapping_Acc
        ComSignal3: ComHandleId=3, ComSignalInitValue=0, ComSystemTemplateSystemSignalRef=iSignalToIPduMapping_Temp
    ComGeneral
