AUTOSAR XML (schema 00051)
package /TPC_Composition/Components
  composition sw component type TPC_Composition
    component Ctrl: type=Controller
    component Obv: type=Observation
    connect Ctrl.PpIfVehSpd -> Obv.RpIfVehSpd
    connect Ctrl.PpIfVehAcc -> Obv.RpIfVehAcc
    connect Ctrl.PpIfTemperature -> Obv.RpIfTemperature
