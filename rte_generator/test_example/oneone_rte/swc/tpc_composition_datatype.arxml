AUTOSAR XML (schema 00051)
standard types defined: Uint8, Uint16, Float32, Float64
package /TPC_Composition/Datatypes/ImplementationDataTypes
  4 x impl type, all with category=VALUE, type-emitter=RTE:
    Impl_uint8: base-type=Uint8
      symbol props Impl_uint8_symbol: symbol=MyUint8OfVendorID
    Impl_uint16: base-type=Uint16, invalid-value=DefaultInvalidValue_Uint16:100
      symbol props Impl_uint16_symbol: symbol=MyUint16OfVendorID
    Impl_float32: base-type=Float32
      symbol props Impl_float32_symbol: symbol=MyFloat32
    Impl_float64: base-type=Float64, invalid-value=DefaultInvalidValue_Float64:3.14159265358979
      symbol props Impl_float64_symbol: symbol=MyFloat64
package /TPC_Composition/Datatypes/ApplicationDataTypes
  app type App_uint8: category=VALUE
  app type App_uint16: category=VALUE
package /TPC_Composition/Datatypes/DataTypeMappingSets
  data type mapping set DataTypeMappingSet_A
    data-type-maps:
      Impl_float64
      application-data-type=App_uint8, implementation-data-type=Impl_uint8
      application-data-type=App_uint16, implementation-data-type=Impl_uint16
