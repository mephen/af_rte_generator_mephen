AUTOSAR XML (schema 4-2-1)
package /Demo/PortInterfaces
  parameter interface EP
    parameter data prototype Prm1: sw-addr-method=CALIB_QM, sw-calibration-access=READ-WRITE, type=Flg1
package /Demo/SwComponentTypes
  parameter sw component type PSWC
    provide port EP: parameter-provide-com-spec{init-value=Rst, parameter=Prm1}, provided-interface=EP
  application sw component type ASWC
    require port EP: required-interface=EP
    behavior ASWC
      per-instance-parameters:
        parameter data prototype PIP: sw-addr-method=CALIB_QM, sw-calibration-access=READ-WRITE, type=Flg1, init-value=Rst
      shared-parameters:
        parameter data prototype SP: sw-addr-method=CALIB_QM, sw-calibration-access=READ-WRITE, type=Flg1, init-value=Set
  composition sw component type RootComp
    4 x component:
      SWC_A: type=ASWC
      SWC_B: type=ASWC
      SWC_PA: type=PSWC
      SWC_PB: type=PSWC
    connect SWC_PA.EP -> SWC_A.EP
    connect SWC_PB.EP -> SWC_B.EP
package /Demo/Systems
  system Sys: category=ECU_EXTRACT
    root-software-compositions:
      root sw composition prototype RootSwComp: flat-map=SysFlatMap, software-composition=RootComp
package /Demo/FlatMaps
  flat map SysFlatMap
    8 x flat instance descriptor:
      SWC_A_PIP_Z0: ecu-extract-reference=RootSwComp.SWC_A.PIP, variation-point=post-build-variant-condition{matching-criterion=Z, value=0}
      SWC_A_PIP_Z1: ecu-extract-reference=RootSwComp.SWC_A.PIP, variation-point=post-build-variant-condition{matching-criterion=Z, value=1}
      SWC_B_PIP: ecu-extract-reference=RootSwComp.SWC_B.PIP
      SWC_A_SWC_B_SP_Z0: ecu-extract-reference=RootSwComp.SWC_A.SP, variation-point=post-build-variant-condition{matching-criterion=Z, value=0}
      SWC_A_SWC_B_SP_Z1: ecu-extract-reference=RootSwComp.SWC_A.SP, variation-point=post-build-variant-condition{matching-criterion=Z, value=1}
      SWC_PA_EP_Prm1_Z0: ecu-extract-reference=RootSwComp.SWC_PA.EP.Prm1, variation-point=post-build-variant-condition{matching-criterion=Z, value=0}
      SWC_PA_EP_Prm1_Z1: ecu-extract-reference=RootSwComp.SWC_PA.EP.Prm1, variation-point=post-build-variant-condition{matching-criterion=Z, value=1}
      SWC_PB_EP_Prm1: ecu-extract-reference=RootSwComp.SWC_PB.EP.Prm1
package /Demo/PostBuildVariantCriterions
  post build variant criterion Z: compu-method=TrsmTyp1
