AUTOSAR XML (schema 00051)
package /TPC_Composition/Components
  composition sw component type TPC_Composition
    component Ctrl: type=Controller
    component Obv: type=Observation
