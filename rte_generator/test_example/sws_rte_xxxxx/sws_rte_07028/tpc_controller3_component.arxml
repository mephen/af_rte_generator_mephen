AUTOSAR XML (schema 00051)
package /TPC_Composition/Components
  application sw component type Controller3
    behavior SWC_Controller3_InternalBehavior: supports-multiple-instantiation=true
      explicit-inter-runnable-variables:
        data Local_DE_Temp: category=VALUE, type=Impl_float64, sw-impl-policy=QUEUED, sw-calibration-access=READ-ONLY
        data Local_DE_Spd: category=VALUE, type=App_uint16, sw-calibration-access=READ-ONLY, invalid-value=DefaultInvalidValue_Local_DE_Spd:392
        data Local_DE_Acc: category=VALUE, type=App_uint16, sw-calibration-access=READ-ONLY, invalid-value=DefaultInvalidValue_Local_DE_Acc:392
      6 x runnable:
        ReTxTemp
          written-local-variables:
            access WrittenLocalVariable_Temp: return-value-provision=RETURN-VALUE-PROVIDED, accessed-variable=Local_DE_Temp
        ReRxTemp
          read-local-variables:
            access ReadLocalVariable_Temp: accessed-variable=Local_DE_Temp
        ReTxSpd
          written-local-variables:
            access WrittenLocalVariable_Spd: return-value-provision=RETURN-VALUE-PROVIDED, accessed-variable=Local_DE_Spd
        ReRxSpd
          read-local-variables:
            access ReadLocalVariable_Spd: accessed-variable=Local_DE_Spd
        ReTxAcc
          written-local-variables:
            access ReadLocalVariable_PpIfVehMov_Acc: return-value-provision=RETURN-VALUE-PROVIDED, accessed-variable=Local_DE_Acc
        ReRxAcc
          read-local-variables:
            access ReadLocalVariable_PpIfVehMov_Acc: accessed-variable=Local_DE_Acc
      6 x timing event, all with period=0.02:
        EvTiTxTemp_20ms: start-on-event=ReTxTemp
        EvTiRxTemp_20ms: start-on-event=ReRxTemp
        EvTiTxSpd_20ms: start-on-event=ReTxSpd
        EvTiRxSpd_20ms: start-on-event=ReRxSpd
        EvTiTxAcc_20ms: start-on-event=ReTxAcc
        EvTiRxAcc_20ms: start-on-event=ReRxAcc
