AUTOSAR XML (schema 00051)
package /TPC_Composition/Interfaces
  sender receiver interface SR_If1: invalidation-policys=[{handle-invalid=REPLACE, data-element=Acc}, {handle-invalid=KEEP, data-element=Spd}]
    data Acc: category=VALUE, type=App_uint8, sw-calibration-access=READ-ONLY, invalid-value=DefaultInvalidValue_SR_If1_DE_Acc:1618
    data Spd: category=VALUE, type=App_uint8, sw-calibration-access=READ-ONLY, invalid-value=DefaultInvalidValue_SR_If1_DE_Spd:392
  sender receiver interface SR_If2: invalidation-policy{handle-invalid=REPLACE, data-element=Temp}
    data Temp: category=VALUE, type=Impl_float64, sw-impl-policy=QUEUED, sw-calibration-access=READ-ONLY
