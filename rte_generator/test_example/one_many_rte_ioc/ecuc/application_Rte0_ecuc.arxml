AUTOSAR XML (schema 00048)
package /ActiveEcuC
  module config Rte: implementation-config-variant=VARIANT-POST-BUILD-SELECTABLE, module-description=Rte_Impl
    3 x RteSwComponentInstance:
      TPC_Composition_Ctrl_Instance: RteSoftwareComponentInstanceRef=Ctrl
        3 x RteEventToTaskMapping, all with RteImmediateRestart=false, RteMappedToTaskRef=T001, RteUsedOsAlarmRef=alarm1:
          Send_TempValue_20ms: RtePositionInTask=1, RteEventRef=EvTiTemp_20ms
          Send_AccValue_20ms: RtePositionInTask=2, RteEventRef=EvTiAcc_20ms
          Send_SpdValue_20ms: RtePositionInTask=3, RteEventRef=EvTiSpd_20ms
      TPC_Composition_Obv_Instance: RteSoftwareComponentInstanceRef=Obv
        4 x RteEventToTaskMapping:
          Receive_TempValue: RteEventRef=Obv_Ev_DR, RteUsedOsEventRef=event1
          Receive_TempValue_20ms: RteImmediateRestart=false, RtePositionInTask=1, RteEventRef=EvTiTemp_20ms, RteMappedToTaskRef=T001, RteUsedOsAlarmRef=alarm1
          Receive_AccValue_20ms: RteImmediateRestart=false, RtePositionInTask=2, RteEventRef=EvTiAcc_20ms, RteMappedToTaskRef=T001, RteUsedOsAlarmRef=alarm1
          Receive_SpdValue_20ms: RteImmediateRestart=false, RtePositionInTask=3, RteEventRef=EvTiSpd_20ms, RteMappedToTaskRef=T001, RteUsedOsAlarmRef=alarm1
      TPC_Composition_Obv2_Instance: RteSoftwareComponentInstanceRef=Obv2
        4 x RteEventToTaskMapping:
          Receive_TempValue: RteEventRef=Obv_Ev_DR, RteUsedOsEventRef=event1
          Receive_TempValue_20ms: RteImmediateRestart=false, RtePositionInTask=1, RteEventRef=EvTiTemp_20ms, RteMappedToTaskRef=T011, RteUsedOsAlarmRef=alarm1
          Receive_AccValue_20ms: RteImmediateRestart=false, RtePositionInTask=2, RteEventRef=EvTiAcc_20ms, RteMappedToTaskRef=T011
          Receive_SpdValue_20ms: RteImmediateRestart=false, RtePositionInTask=3, RteEventRef=EvTiSpd_20ms, RteMappedToTaskRef=T011
