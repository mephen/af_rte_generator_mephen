AUTOSAR XML (schema 00051)
package /TPC_Composition/Components
  composition sw component type TPC_Composition
    component Ctrl: type=Controller
    component Obv: type=Observation
    component Obv2: type=Observation2
    connect Ctrl.PpIfVehSpd -> Obv.RpIfVehSpd
    connect Ctrl.PpIfVehAcc -> Obv.RpIfVehAcc
    connect Ctrl.PpIfTemperature -> Obv.RpIfTemperature
    connect Ctrl.PpIfVehSpd -> Obv2.RpIfVehSpd2
    connect Ctrl.PpIfVehAcc -> Obv2.RpIfVehAcc2
    connect Ctrl.PpIfTemperature -> Obv2.RpIfTemperature2
