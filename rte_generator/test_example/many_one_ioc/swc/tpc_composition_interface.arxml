AUTOSAR XML (schema 00051)
package /TPC_Composition/Interfaces
  sender receiver interface SR_If1: invalidation-policys=[{handle-invalid=REPLACE, data-element=Acc}, {handle-invalid=KEEP, data-element=Spd}]
    data Acc: category=VALUE, type=Impl_uint16, sw-calibration-access=READ-ONLY, invalid-value=DefaultInvalidValue_SR_If1_DE_Acc:255
    data Spd: category=VALUE, type=Impl_uint16, sw-calibration-access=READ-ONLY, invalid-value=DefaultInvalidValue_SR_If1_DE_Spd:255
  sender receiver interface SR_If2
    data Temp: category=VALUE, type=Impl_uint16, sw-impl-policy=QUEUED, sw-calibration-access=READ-ONLY
