[part 1 of 3: package /ActiveEcuC]
AUTOSAR XML (schema 00048)
package /ActiveEcuC
  module config Rte: implementation-config-variant=VARIANT-POST-BUILD-SELECTABLE, module-description=Rte_Impl  # Requirements PLAIN_TEXT ABTE-SWREQ-3294 ABTE-SWREQ-3273
    RteOsInteraction
      13 x RteUsedOsActivation, all with RteExpectedActivationOffset=0, RteExpectedTickDuration=0:
        Rte_Al_TE2_OsTask_BswMainFunctions_0_10ms: RteActivationOsAlarmRef=Rte_Al_TE2_OsTask_BswMainFunctions_0_10ms, RteActivationOsTaskRef=OsTask_BswMainFunctions
        Rte_Al_TE_OsTask_ApplMainFunctions_0_10ms: RteActivationOsAlarmRef=Rte_Al_TE_OsTask_ApplMainFunctions_0_10ms, RteActivationOsTaskRef=OsTask_ApplMainFunctions
        Rte_Al_TE_OsTask_ApplVerify_0_10ms: RteActivationOsAlarmRef=Rte_Al_TE_OsTask_ApplVerify_0_10ms, RteActivationOsTaskRef=OsTask_ApplVerify
        Rte_Al_TE_OsTask_ApplTimedInitDeInit_0_1ms: RteActivationOsAlarmRef=Rte_Al_TE_OsTask_ApplTimedInitDeInit_0_1ms, RteActivationOsTaskRef=OsTask_ApplTimedInitDeInit
        Rte_Al_TE2_OsTask_BswMainFunctions_0_20ms: RteActivationOsAlarmRef=Rte_Al_TE2_OsTask_BswMainFunctions_0_20ms, RteActivationOsTaskRef=OsTask_BswMainFunctions
        Rte_Al_TE_OsTask_ApplMainFunctions_0_1ms: RteActivationOsAlarmRef=Rte_Al_TE_OsTask_ApplMainFunctions_0_1ms, RteActivationOsTaskRef=OsTask_ApplMainFunctions
        Rte_Al_TE_CanTp_CanTp_MainFunction: RteActivationOsAlarmRef=Rte_Al_TE_CanTp_CanTp_MainFunction, RteActivationOsTaskRef=OsTask_BswMainFunctions
        Rte_Al_TE_ShA_Ivd_MainFunction: RteActivationOsAlarmRef=Rte_Al_TE_ShA_Ivd_MainFunction, RteActivationOsTaskRef=OsTask_ApplMainFunctions
        Rte_Al_TE_SwcTemperatureCorrection_SwcTempCor_MainFunction: RteActivationOsAlarmRef=Rte_Al_TE_SwcTemperatureCorrection_SwcTempCor_MainFunction, RteActivationOsTaskRef=OsTask_Dimming
        Rte_Al_TE_CddUart_CddUart_MainFunction: RteActivationOsAlarmRef=Rte_Al_TE_CddUart_CddUart_MainFunction, RteActivationOsTaskRef=OsTask_BswMainFunctions
        Rte_Al_TE_SwcSelfDiagnostics_SwcSelfDiag_UpdateCpuLoad: RteActivationOsAlarmRef=Rte_Al_TE_SwcSelfDiagnostics_SwcSelfDiag_UpdateCpuLoad, RteActivationOsTaskRef=OsTask_SelfDiagnostics
        Rte_Al_TE_SwcSelfDiagnostics_SwcSelfDiag_UpdateRuntime: RteActivationOsAlarmRef=Rte_Al_TE_SwcSelfDiagnostics_SwcSelfDiag_UpdateRuntime, RteActivationOsTaskRef=OsTask_SelfDiagnostics
        Rte_Al_TE_SwcTouch_SwcTouch_MainFunction: RteActivationOsAlarmRef=Rte_Al_TE_SwcTouch_SwcTouch_MainFunction, RteActivationOsTaskRef=OsTask_Touch
    RteBswGeneral: RteSchMVersionInfoApi=true, RteUseComShadowSignalApi=false
    RteGeneration:
      RteGenerationMode = COMPATIBILITY_MODE
      RteIocInteractionReturnValue = RTE_IOC
      RteValueRangeCheckEnabled = false
      RteCalibrationSupport = NONE
      RteCodeVendorId = 30
      RteDevErrorDetect = true
      RteDevErrorDetectUninit = false
      RteMeasurementSupport = false
      RteOptimizationMode = MEMORY
      RteVfbTraceEnabled = false
      RteNewSerializer = true
    RteInitializationBehavior: RteInitializationStrategy=RTE_INITIALIZATION_STRATEGY_AT_DATA_DECLARATION, RteSectionInitializationPolicy=INIT
    Os_OsCore0_swc_EcuSwComposition (RteSwComponentInstance): RteSoftwareComponentInstanceRef=Os_OsCore0_swc
      4 x RteEventToTaskMapping, all with RteImmediateRestart=false:
        OpEventGetCounterValue_GetCounterValue_OsService_OsCounter_10ms: RteEventRef=OpEventGetCounterValue_GetCounterValue_OsService_OsCounter_10ms
        OpEventGetElapsedValue_GetElapsedValue_OsService_OsCounter_10ms: RteEventRef=OpEventGetElapsedValue_GetElapsedValue_OsService_OsCounter_10ms
        OpEventGetCounterValue_GetCounterValue_OsService_OsCounter_1ms: RteEventRef=OpEventGetCounterValue_GetCounterValue_OsService_OsCounter_1ms
        OpEventGetElapsedValue_GetElapsedValue_OsService_OsCounter_1ms: RteEventRef=OpEventGetElapsedValue_GetElapsedValue_OsService_OsCounter_1ms
    EcuM (RteBswModuleInstance): RteBswImplementationRef=EcuM_Impl, RteBswModuleConfigurationRef=EcuM
      EcuM_MainFunctionTimingEvent0 (RteBswEventToTaskMapping):
        RteBswImmediateRestart = false
        RteBswPositionInTask = 3
        RteBswEventRef = EcuM_MainFunctionTimingEvent0
        RteBswMappedToTaskRef = OsTask_BswMainFunctions
        RteBswUsedOsEventRef = Rte_Ev_Cyclic2_OsTask_BswMainFunctions_0_10ms
        RteBswUsedOsAlarmRef = Rte_Al_TE2_OsTask_BswMainFunctions_0_10ms
      4 x RteBswExclusiveAreaImpl, all with RteExclusiveAreaImplMechanism=ALL_INTERRUPT_BLOCKING:
        ECUM_EXCLUSIVE_AREA_{0..3}: RteBswExclusiveAreaRef=ECUM_EXCLUSIVE_AREA_{0..3}
    EcuM_EcuSwComposition (RteSwComponentInstance): RteSoftwareComponentInstanceRef=EcuM
      8 x RteEventToTaskMapping, all with RteImmediateRestart=false:
        Timer_EcuM_MainFunction: RtePositionInTask=3, RteEventRef=Timer_EcuM_MainFunction, RteMappedToTaskRef=OsTask_BswMainFunctions, RteUsedOsEventRef=Rte_Ev_Cyclic2_OsTask_BswMainFunctions_0_10ms, RteUsedOsAlarmRef=Rte_Al_TE2_OsTask_BswMainFunctions_0_10ms
        OpEventSelectShutdownTarget_SelectShutdownTarget_EcuM_ShutdownTarget: RteEventRef=OpEventSelectShutdownTarget_SelectShutdownTarget_EcuM_ShutdownTarget
        OpEventGetShutdownTarget_GetShutdownTarget_EcuM_ShutdownTarget: RteEventRef=OpEventGetShutdownTarget_GetShutdownTarget_EcuM_ShutdownTarget
        OpEventGetLastShutdownTarget_GetLastShutdownTarget_EcuM_ShutdownTarget: RteEventRef=OpEventGetLastShutdownTarget_GetLastShutdownTarget_EcuM_ShutdownTarget
        OpEventSelectShutdownCause_SelectShutdownCause_EcuM_ShutdownTarget: RteEventRef=OpEventSelectShutdownCause_SelectShutdownCause_EcuM_ShutdownTarget
        OpEventGetShutdownCause_GetShutdownCause_EcuM_ShutdownTarget: RteEventRef=OpEventGetShutdownCause_GetShutdownCause_EcuM_ShutdownTarget
        OpEventSelectBootTarget_SelectBootTarget_EcuM_BootTarget: RteEventRef=OpEventSelectBootTarget_SelectBootTarget_EcuM_BootTarget
        OpEventGetBootTarget_GetBootTarget_EcuM_BootTarget: RteEventRef=OpEventGetBootTarget_GetBootTarget_EcuM_BootTarget
    Det (RteBswModuleInstance): RteBswImplementationRef=Det_Impl, RteBswModuleConfigurationRef=Det
      DET_EXCLUSIVE_AREA_0 (RteBswExclusiveAreaImpl): RteExclusiveAreaImplMechanism=ALL_INTERRUPT_BLOCKING, RteBswExclusiveAreaRef=DET_EXCLUSIVE_AREA_0
    Det_EcuSwComposition (RteSwComponentInstance): RteSoftwareComponentInstanceRef=Det
    Dem (RteBswModuleInstance): RteBswImplementationRef=Dem_Impl, RteBswModuleConfigurationRef=Dem
      Dem_MasterMainFunctionTimingEvent0 (RteBswEventToTaskMapping):
        RteBswImmediateRestart = false
        RteBswPositionInTask = 1
        RteBswEventRef = Dem_MasterMainFunctionTimingEvent0
        RteBswMappedToTaskRef = OsTask_BswMainFunctions
        RteBswUsedOsEventRef = Rte_Ev_Cyclic2_OsTask_BswMainFunctions_0_10ms
        RteBswUsedOsAlarmRef = Rte_Al_TE2_OsTask_BswMainFunctions_0_10ms
      Dem_SatelliteMainFunctionTimingEvent0 (RteBswEventToTaskMapping):
        RteBswImmediateRestart = false
        RteBswPositionInTask = 2
        RteBswEventRef = Dem_SatelliteMainFunctionTimingEvent0
        RteBswMappedToTaskRef = OsTask_BswMainFunctions
        RteBswUsedOsEventRef = Rte_Ev_Cyclic2_OsTask_BswMainFunctions_0_10ms
        RteBswUsedOsAlarmRef = Rte_Al_TE2_OsTask_BswMainFunctions_0_10ms
      5 x RteBswExclusiveAreaImpl, all with RteExclusiveAreaImplMechanism=ALL_INTERRUPT_BLOCKING:
        DEM_EXCLUSIVE_AREA_{0..4}: RteBswExclusiveAreaRef=DEM_EXCLUSIVE_AREA_{0..4}
    DemMaster_0_EcuSwComposition (RteSwComponentInstance): RteSoftwareComponentInstanceRef=DemMaster_0
      22 x RteEventToTaskMapping, all with RteImmediateRestart=false:
        Timer_Dem_MasterMainFunction: RtePositionInTask=1, RteEventRef=Timer_Dem_MasterMainFunction, RteMappedToTaskRef=OsTask_BswMainFunctions, RteUsedOsEventRef=Rte_Ev_Cyclic2_OsTask_BswMainFunctions_0_10ms, RteUsedOsAlarmRef=Rte_Al_TE2_OsTask_BswMainFunctions_0_10ms
        OpEventPostRunRequested_GetPostRunRequested_DemServices: RteEventRef=OpEventPostRunRequested_GetPostRunRequested_DemServices
        OpEventGetDTCStatusAvailabilityMask_GetDTCStatusAvailabilityMask_DemServices: RteEventRef=OpEventGetDTCStatusAvailabilityMask_GetDTCStatusAvailabilityMask_DemServices
        OpEventGetEventUdsStatus_GetEventUdsStatus_GeneralEvtInfo: RteEventRef=OpEventGetEventUdsStatus_GetEventUdsStatus_GeneralEvtInfo
        OpEventGetEventStatus_GetEventStatus_GeneralEvtInfo: RteEventRef=OpEventGetEventStatus_GetEventStatus_GeneralEvtInfo
        OpEventGetEventFailed_GetEventFailed_GeneralEvtInfo: RteEventRef=OpEventGetEventFailed_GetEventFailed_GeneralEvtInfo
        OpEventGetEventTested_GetEventTested_GeneralEvtInfo: RteEventRef=OpEventGetEventTested_GetEventTested_GeneralEvtInfo
        OpEventGetDTCOfEvent_GetDTCOfEvent_GeneralEvtInfo: RteEventRef=OpEventGetDTCOfEvent_GetDTCOfEvent_GeneralEvtInfo
        OpEventGetFaultDetectionCounter_GetFaultDetectionCounter_GeneralEvtInfo: RteEventRef=OpEventGetFaultDetectionCounter_GetFaultDetectionCounter_GeneralEvtInfo
        OpEventGetEventFreezeFrameDataEx_GetEventFreezeFrameDataEx_GeneralEvtInfo: RteEventRef=OpEventGetEventFreezeFrameDataEx_GetEventFreezeFrameDataEx_GeneralEvtInfo
        OpEventGetEventExtendedDataRecordEx_GetEventExtendedDataRecordEx_GeneralEvtInfo: RteEventRef=OpEventGetEventExtendedDataRecordEx_GetEventExtendedDataRecordEx_GeneralEvtInfo
        OpEventGetEventEnableCondition_GetEventEnableCondition_GeneralEvtInfo: RteEventRef=OpEventGetEventEnableCondition_GetEventEnableCondition_GeneralEvtInfo
        OpEventGetDebouncingOfEvent_GetDebouncingOfEvent_GeneralEvtInfo: RteEventRef=OpEventGetDebouncingOfEvent_GetDebouncingOfEvent_GeneralEvtInfo
        OpEventGetMonitorStatus_GetMonitorStatus_GeneralEvtInfo: RteEventRef=OpEventGetMonitorStatus_GetMonitorStatus_GeneralEvtInfo
        OpEventGetOperationCycleState_GetOperationCycleState_OpCycle_DemOperationCycle: RteEventRef=OpEventGetOperationCycleState_GetOperationCycleState_OpCycle_DemOperationCycle
        OpEventSetOperationCycleState_SetOperationCycleState_OpCycle_DemOperationCycle: RteEventRef=OpEventSetOperationCycleState_SetOperationCycleState_OpCycle_DemOperationCycle
        OpEventSelectDTC_SelectDTC_ClearDTC_DemClient: RteEventRef=OpEventSelectDTC_SelectDTC_ClearDTC_DemClient
        OpEventGetEventMemoryOverflow_GetEventMemoryOverflow_OverflowIndPrimaryMemory_DemClient: RteEventRef=OpEventGetEventMemoryOverflow_GetEventMemoryOverflow_OverflowIndPrimaryMemory_DemClient
        OpEventGetNumberOfEventMemoryEntries_GetNumberOfEventMemoryEntries_OverflowIndPrimaryMemory_DemClient: RteEventRef=OpEventGetNumberOfEventMemoryEntries_GetNumberOfEventMemoryEntries_OverflowIndPrimaryMemory_DemClient
        OpEventClearDTC_ClearDTC_ClearDTC_DemClient: RteEventRef=OpEventClearDTC_ClearDTC_ClearDTC_DemClient
        OpEventGetOperationCycleState_GetOperationCycleState_OpCycle_PowerCycle: RteEventRef=OpEventGetOperationCycleState_GetOperationCycleState_OpCycle_PowerCycle
        OpEventSetOperationCycleState_SetOperationCycleState_OpCycle_PowerCycle: RteEventRef=OpEventSetOperationCycleState_SetOperationCycleState_OpCycle_PowerCycle
    DemSatellite_0_EcuSwComposition (RteSwComponentInstance): RteSoftwareComponentInstanceRef=DemSatellite_0
      969 x RteEventToTaskMapping, all with RteImmediateRestart=false:
        Timer_Dem_SatelliteMainFunction: RtePositionInTask=2, RteEventRef=Timer_Dem_SatelliteMainFunction, RteMappedToTaskRef=OsTask_BswMainFunctions, RteUsedOsEventRef=Rte_Ev_Cyclic2_OsTask_BswMainFunctions_0_10ms, RteUsedOsAlarmRef=Rte_Al_TE2_OsTask_BswMainFunctions_0_10ms
        OpEventGetEventUdsStatus_GetEventUdsStatus_EvtInfo_AutoCreatedDemEvent_McuDemEventParameterRefs_MCU_E_WRITE_TIMEOUT_FAILURE: RteEventRef=OpEventGetEventUdsStatus_GetEventUdsStatus_EvtInfo_AutoCreatedDemEvent_McuDemEventParameterRefs_MCU_E_WRITE_TIMEOUT_FAILURE
        OpEventGetEventUdsStatus_GetEventUdsStatus_EvtInfo_AutoCreatedDemEvent_McuDemEventParameterRefs_MCU_E_REG_WRITE_VERIFY: RteEventRef=OpEventGetEventUdsStatus_GetEventUdsStatus_EvtInfo_AutoCreatedDemEvent_McuDemEventParameterRefs_MCU_E_REG_WRITE_VERIFY
        OpEventGetEventUdsStatus_GetEventUdsStatus_EvtInfo_AutoCreatedDemEvent_McuDemEventParameterRefs_MCU_E_LVI_FAILURE: RteEventRef=OpEventGetEventUdsStatus_GetEventUdsStatus_EvtInfo_AutoCreatedDemEvent_McuDemEventParameterRefs_MCU_E_LVI_FAILURE
        OpEventGetEventUdsStatus_GetEventUdsStatus_EvtInfo_AutoCreatedDemEvent_McuDemEventParameterRefs_MCU_E_INCONCISTENCY_RESF_FAILURE: RteEventRef=OpEventGetEventUdsStatus_GetEventUdsStatus_EvtInfo_AutoCreatedDemEvent_McuDemEventParameterRefs_MCU_E_INCONCISTENCY_RESF_FAILURE
        OpEventGetEventUdsStatus_GetEventUdsStatus_EvtInfo_AutoCreatedDemEvent_McuDemEventParameterRefs_MCU_E_CVM_SETTING_FAILURE: RteEventRef=OpEventGetEventUdsStatus_GetEventUdsStatus_EvtInfo_AutoCreatedDemEvent_McuDemEventParameterRefs_MCU_E_CVM_SETTING_FAILURE
        OpEventGetEventUdsStatus_GetEventUdsStatus_EvtInfo_AutoCreatedDemEvent_McuDemEventParameterRefs_MCU_E_CLOCK_FAILURE: RteEventRef=OpEventGetEventUdsStatus_GetEventUdsStatus_EvtInfo_AutoCreatedDemEvent_McuDemEventParameterRefs_MCU_E_CLOCK_FAILURE
        OpEventGetEventUdsStatus_GetEventUdsStatus_GeneralEvtInfo: RteEventRef=OpEventGetEventUdsStatus_GetEventUdsStatus_GeneralEvtInfo
        OpEventGetEventStatus_GetEventStatus_EvtInfo_AutoCreatedDemEvent_McuDemEventParameterRefs_MCU_E_WRITE_TIMEOUT_FAILURE: RteEventRef=OpEventGetEventStatus_GetEventStatus_EvtInfo_AutoCreatedDemEvent_McuDemEventParameterRefs_MCU_E_WRITE_TIMEOUT_FAILURE
        OpEventGetEventStatus_GetEventStatus_EvtInfo_AutoCreatedDemEvent_McuDemEventParameterRefs_MCU_E_REG_WRITE_VERIFY: RteEventRef=OpEventGetEventStatus_GetEventStatus_EvtInfo_AutoCreatedDemEvent_McuDemEventParameterRefs_MCU_E_REG_WRITE_VERIFY
        OpEventGetEventStatus_GetEventStatus_EvtInfo_AutoCreatedDemEvent_McuDemEventParameterRefs_MCU_E_LVI_FAILURE: RteEventRef=OpEventGetEventStatus_GetEventStatus_EvtInfo_AutoCreatedDemEvent_McuDemEventParameterRefs_MCU_E_LVI_FAILURE
        OpEventGetEventStatus_GetEventStatus_EvtInfo_AutoCreatedDemEvent_McuDemEventParameterRefs_MCU_E_INCONCISTENCY_RESF_FAILURE: RteEventRef=OpEventGetEventStatus_GetEventStatus_EvtInfo_AutoCreatedDemEvent_McuDemEventParameterRefs_MCU_E_INCONCISTENCY_RESF_FAILURE
        OpEventGetEventStatus_GetEventStatus_EvtInfo_AutoCreatedDemEvent_McuDemEventParameterRefs_MCU_E_CVM_SETTING_FAILURE: RteEventRef=OpEventGetEventStatus_GetEventStatus_EvtInfo_AutoCreatedDemEvent_McuDemEventParameterRefs_MCU_E_CVM_SETTING_FAILURE
        OpEventGetEventStatus_GetEventStatus_EvtInfo_AutoCreatedDemEvent_McuDemEventParameterRefs_MCU_E_CLOCK_FAILURE: RteEventRef=OpEventGetEventStatus_GetEventStatus_EvtInfo_AutoCreatedDemEvent_McuDemEventParameterRefs_MCU_E_CLOCK_FAILURE
        OpEventGetEventStatus_GetEventStatus_GeneralEvtInfo: RteEventRef=OpEventGetEventStatus_GetEventStatus_GeneralEvtInfo
        OpEventGetEventFailed_GetEventFailed_EvtInfo_AutoCreatedDemEvent_McuDemEventParameterRefs_MCU_E_WRITE_TIMEOUT_FAILURE: RteEventRef=OpEventGetEventFailed_GetEventFailed_EvtInfo_AutoCreatedDemEvent_McuDemEventParameterRefs_MCU_E_WRITE_TIMEOUT_FAILURE
        OpEventGetEventFailed_GetEventFailed_EvtInfo_AutoCreatedDemEvent_McuDemEventParameterRefs_MCU_E_REG_WRITE_VERIFY: RteEventRef=OpEventGetEventFailed_GetEventFailed_EvtInfo_AutoCreatedDemEvent_McuDemEventParameterRefs_MCU_E_REG_WRITE_VERIFY
        OpEventGetEventFailed_GetEventFailed_EvtInfo_AutoCreatedDemEvent_McuDemEventParameterRefs_MCU_E_LVI_FAILURE: RteEventRef=OpEventGetEventFailed_GetEventFailed_EvtInfo_AutoCreatedDemEvent_McuDemEventParameterRefs_MCU_E_LVI_FAILURE
        OpEventGetEventFailed_GetEventFailed_EvtInfo_AutoCreatedDemEvent_McuDemEventParameterRefs_MCU_E_INCONCISTENCY_RESF_FAILURE: RteEventRef=OpEventGetEventFailed_GetEventFailed_EvtInfo_AutoCreatedDemEvent_McuDemEventParameterRefs_MCU_E_INCONCISTENCY_RESF_FAILURE
        OpEventGetEventFailed_GetEventFailed_EvtInfo_AutoCreatedDemEvent_McuDemEventParameterRefs_MCU_E_CVM_SETTING_FAILURE: RteEventRef=OpEventGetEventFailed_GetEventFailed_EvtInfo_AutoCreatedDemEvent_McuDemEventParameterRefs_MCU_E_CVM_SETTING_FAILURE
        OpEventGetEventFailed_GetEventFailed_EvtInfo_AutoCreatedDemEvent_McuDemEventParameterRefs_MCU_E_CLOCK_FAILURE: RteEventRef=OpEventGetEventFailed_GetEventFailed_EvtInfo_AutoCreatedDemEvent_McuDemEventParameterRefs_MCU_E_CLOCK_FAILURE
        OpEventGetEventFailed_GetEventFailed_GeneralEvtInfo: RteEventRef=OpEventGetEventFailed_GetEventFailed_GeneralEvtInfo
        OpEventGetEventTested_GetEventTested_EvtInfo_AutoCreatedDemEvent_McuDemEventParameterRefs_MCU_E_WRITE_TIMEOUT_FAILURE: RteEventRef=OpEventGetEventTested_GetEventTested_EvtInfo_AutoCreatedDemEvent_McuDemEventParameterRefs_MCU_E_WRITE_TIMEOUT_FAILURE
        OpEventGetEventTested_GetEventTested_EvtInfo_AutoCreatedDemEvent_McuDemEventParameterRefs_MCU_E_REG_WRITE_VERIFY: RteEventRef=OpEventGetEventTested_GetEventTested_EvtInfo_AutoCreatedDemEvent_McuDemEventParameterRefs_MCU_E_REG_WRITE_VERIFY
        OpEventGetEventTested_GetEventTested_EvtInfo_AutoCreatedDemEvent_McuDemEventParameterRefs_MCU_E_LVI_FAILURE: RteEventRef=OpEventGetEventTested_GetEventTested_EvtInfo_AutoCreatedDemEvent_McuDemEventParameterRefs_MCU_E_LVI_FAILURE
        OpEventGetEventTested_GetEventTested_EvtInfo_AutoCreatedDemEvent_McuDemEventParameterRefs_MCU_E_INCONCISTENCY_RESF_FAILURE: RteEventRef=OpEventGetEventTested_GetEventTested_EvtInfo_AutoCreatedDemEvent_McuDemEventParameterRefs_MCU_E_INCONCISTENCY_RESF_FAILURE
        OpEventGetEventTested_GetEventTested_EvtInfo_AutoCreatedDemEvent_McuDemEventParameterRefs_MCU_E_CVM_SETTING_FAILURE: RteEventRef=OpEventGetEventTested_GetEventTested_EvtInfo_AutoCreatedDemEvent_McuDemEventParameterRefs_MCU_E_CVM_SETTING_FAILURE
        OpEventGetEventTested_GetEventTested_EvtInfo_AutoCreatedDemEvent_McuDemEventParameterRefs_MCU_E_CLOCK_FAILURE: RteEventRef=OpEventGetEventTested_GetEventTested_EvtInfo_AutoCreatedDemEvent_McuDemEventParameterRefs_MCU_E_CLOCK_FAILURE
        OpEventGetEventTested_GetEventTested_GeneralEvtInfo: RteEventRef=OpEventGetEventTested_GetEventTested_GeneralEvtInfo
        OpEventGetDTCOfEvent_GetDTCOfEvent_EvtInfo_AutoCreatedDemEvent_McuDemEventParameterRefs_MCU_E_WRITE_TIMEOUT_FAILURE: RteEventRef=OpEventGetDTCOfEvent_GetDTCOfEvent_EvtInfo_AutoCreatedDemEvent_McuDemEventParameterRefs_MCU_E_WRITE_TIMEOUT_FAILURE
        OpEventGetDTCOfEvent_GetDTCOfEvent_EvtInfo_AutoCreatedDemEvent_McuDemEventParameterRefs_MCU_E_REG_WRITE_VERIFY: RteEventRef=OpEventGetDTCOfEvent_GetDTCOfEvent_EvtInfo_AutoCreatedDemEvent_McuDemEventParameterRefs_MCU_E_REG_WRITE_VERIFY
        OpEventGetDTCOfEvent_GetDTCOfEvent_EvtInfo_AutoCreatedDemEvent_McuDemEventParameterRefs_MCU_E_LVI_FAILURE: RteEventRef=OpEventGetDTCOfEvent_GetDTCOfEvent_EvtInfo_AutoCreatedDemEvent_McuDemEventParameterRefs_MCU_E_LVI_FAILURE
        OpEventGetDTCOfEvent_GetDTCOfEvent_EvtInfo_AutoCreatedDemEvent_McuDemEventParameterRefs_MCU_E_INCONCISTENCY_RESF_FAILURE: RteEventRef=OpEventGetDTCOfEvent_GetDTCOfEvent_EvtInfo_AutoCreatedDemEvent_McuDemEventParameterRefs_MCU_E_INCONCISTENCY_RESF_FAILURE
        OpEventGetDTCOfEvent_GetDTCOfEvent_EvtInfo_AutoCreatedDemEvent_McuDemEventParameterRefs_MCU_E_CVM_SETTING_FAILURE: RteEventRef=OpEventGetDTCOfEvent_GetDTCOfEvent_EvtInfo_AutoCreatedDemEvent_McuDemEventParameterRefs_MCU_E_CVM_SETTING_FAILURE
        OpEventGetDTCOfEvent_GetDTCOfEvent_EvtInfo_AutoCreatedDemEvent_McuDemEventParameterRefs_MCU_E_CLOCK_FAILURE: RteEventRef=OpEventGetDTCOfEvent_GetDTCOfEvent_EvtInfo_AutoCreatedDemEvent_McuDemEventParameterRefs_MCU_E_CLOCK_FAILURE
        OpEventGetDTCOfEvent_GetDTCOfEvent_GeneralEvtInfo: RteEventRef=OpEventGetDTCOfEvent_GetDTCOfEvent_GeneralEvtInfo
        OpEventGetFaultDetectionCounter_GetFaultDetectionCounter_EvtInfo_AutoCreatedDemEvent_McuDemEventParameterRefs_MCU_E_WRI_467caa8f: RteEventRef=OpEventGetFaultDetectionCounter_GetFaultDetectionCounter_EvtInfo_AutoCreatedDemEvent_McuDemEventParameterRefs_MCU_E_WRI_467caa8f
        OpEventGetFaultDetectionCounter_GetFaultDetectionCounter_EvtInfo_AutoCreatedDemEvent_McuDemEventParameterRefs_MCU_E_REG_28a404a7: RteEventRef=OpEventGetFaultDetectionCounter_GetFaultDetectionCounter_EvtInfo_AutoCreatedDemEvent_McuDemEventParameterRefs_MCU_E_REG_28a404a7
        OpEventGetFaultDetectionCounter_GetFaultDetectionCounter_EvtInfo_AutoCreatedDemEvent_McuDemEventParameterRefs_MCU_E_LVI_FAILURE: RteEventRef=OpEventGetFaultDetectionCounter_GetFaultDetectionCounter_EvtInfo_AutoCreatedDemEvent_McuDemEventParameterRefs_MCU_E_LVI_FAILURE
        OpEventGetFaultDetectionCounter_GetFaultDetectionCounter_EvtInfo_AutoCreatedDemEvent_McuDemEventParameterRefs_MCU_E_INC_91e09dbe: RteEventRef=OpEventGetFaultDetectionCounter_GetFaultDetectionCounter_EvtInfo_AutoCreatedDemEvent_McuDemEventParameterRefs_MCU_E_INC_91e09dbe
        OpEventGetFaultDetectionCounter_GetFaultDetectionCounter_EvtInfo_AutoCreatedDemEvent_McuDemEventParameterRefs_MCU_E_CVM_348f8fae: RteEventRef=OpEventGetFaultDetectionCounter_GetFaultDetectionCounter_EvtInfo_AutoCreatedDemEvent_McuDemEventParameterRefs_MCU_E_CVM_348f8fae
        OpEventGetFaultDetectionCounter_GetFaultDetectionCounter_EvtInfo_AutoCreatedDemEvent_McuDemEventParameterRefs_MCU_E_CLO_365612d7: RteEventRef=OpEventGetFaultDetectionCounter_GetFaultDetectionCounter_EvtInfo_AutoCreatedDemEvent_McuDemEventParameterRefs_MCU_E_CLO_365612d7
        OpEventGetFaultDetectionCounter_GetFaultDetectionCounter_GeneralEvtInfo: RteEventRef=OpEventGetFaultDetectionCounter_GetFaultDetectionCounter_GeneralEvtInfo
        OpEventGetEventFreezeFrameDataEx_GetEventFreezeFrameDataEx_EvtInfo_AutoCreatedDemEvent_McuDemEventParameterRefs_MCU_E_W_7b9246b1: RteEventRef=OpEventGetEventFreezeFrameDataEx_GetEventFreezeFrameDataEx_EvtInfo_AutoCreatedDemEvent_McuDemEventParameterRefs_MCU_E_W_7b9246b1
        OpEventGetEventFreezeFrameDataEx_GetEventFreezeFrameDataEx_EvtInfo_AutoCreatedDemEvent_McuDemEventParameterRefs_MCU_E_R_b092c91f: RteEventRef=OpEventGetEventFreezeFrameDataEx_GetEventFreezeFrameDataEx_EvtInfo_AutoCreatedDemEvent_McuDemEventParameterRefs_MCU_E_R_b092c91f
        OpEventGetEventFreezeFrameDataEx_GetEventFreezeFrameDataEx_EvtInfo_AutoCreatedDemEvent_McuDemEventParameterRefs_MCU_E_L_196a2fb9: RteEventRef=OpEventGetEventFreezeFrameDataEx_GetEventFreezeFrameDataEx_EvtInfo_AutoCreatedDemEvent_McuDemEventParameterRefs_MCU_E_L_196a2fb9
        OpEventGetEventFreezeFrameDataEx_GetEventFreezeFrameDataEx_EvtInfo_AutoCreatedDemEvent_McuDemEventParameterRefs_MCU_E_I_daccd0cd: RteEventRef=OpEventGetEventFreezeFrameDataEx_GetEventFreezeFrameDataEx_EvtInfo_AutoCreatedDemEvent_McuDemEventParameterRefs_MCU_E_I_daccd0cd
        OpEventGetEventFreezeFrameDataEx_GetEventFreezeFrameDataEx_EvtInfo_AutoCreatedDemEvent_McuDemEventParameterRefs_MCU_E_C_4e2c1c04: RteEventRef=OpEventGetEventFreezeFrameDataEx_GetEventFreezeFrameDataEx_EvtInfo_AutoCreatedDemEvent_McuDemEventParameterRefs_MCU_E_C_4e2c1c04
        OpEventGetEventFreezeFrameDataEx_GetEventFreezeFrameDataEx_EvtInfo_AutoCreatedDemEvent_McuDemEventParameterRefs_MCU_E_C_9e148c5f: RteEventRef=OpEventGetEventFreezeFrameDataEx_GetEventFreezeFrameDataEx_EvtInfo_AutoCreatedDemEvent_McuDemEventParameterRefs_MCU_E_C_9e148c5f
        OpEventGetEventFreezeFrameDataEx_GetEventFreezeFrameDataEx_GeneralEvtInfo: RteEventRef=OpEventGetEventFreezeFrameDataEx_GetEventFreezeFrameDataEx_GeneralEvtInfo
        OpEventGetEventExtendedDataRecordEx_GetEventExtendedDataRecordEx_EvtInfo_AutoCreatedDemEvent_McuDemEventParameterRefs_M_f37ef889: RteEventRef=OpEventGetEventExtendedDataRecordEx_GetEventExtendedDataRecordEx_EvtInfo_AutoCreatedDemEvent_McuDemEventParameterRefs_M_f37ef889
        OpEventGetEventExtendedDataRecordEx_GetEventExtendedDataRecordEx_EvtInfo_AutoCreatedDemEvent_McuDemEventParameterRefs_M_406a6748: RteEventRef=OpEventGetEventExtendedDataRecordEx_GetEventExtendedDataRecordEx_EvtInfo_AutoCreatedDemEvent_McuDemEventParameterRefs_M_406a6748
        OpEventGetEventExtendedDataRecordEx_GetEventExtendedDataRecordEx_EvtInfo_AutoCreatedDemEvent_McuDemEventParameterRefs_M_fb49e412: RteEventRef=OpEventGetEventExtendedDataRecordEx_GetEventExtendedDataRecordEx_EvtInfo_AutoCreatedDemEvent_McuDemEventParameterRefs_M_fb49e412
        OpEventGetEventExtendedDataRecordEx_GetEventExtendedDataRecordEx_EvtInfo_AutoCreatedDemEvent_McuDemEventParameterRefs_M_e59221a4: RteEventRef=OpEventGetEventExtendedDataRecordEx_GetEventExtendedDataRecordEx_EvtInfo_AutoCreatedDemEvent_McuDemEventParameterRefs_M_e59221a4
        OpEventGetEventExtendedDataRecordEx_GetEventExtendedDataRecordEx_EvtInfo_AutoCreatedDemEvent_McuDemEventParameterRefs_M_a43dcf88: RteEventRef=OpEventGetEventExtendedDataRecordEx_GetEventExtendedDataRecordEx_EvtInfo_AutoCreatedDemEvent_McuDemEventParameterRefs_M_a43dcf88
        OpEventGetEventExtendedDataRecordEx_GetEventExtendedDataRecordEx_EvtInfo_AutoCreatedDemEvent_McuDemEventParameterRefs_M_df511066: RteEventRef=OpEventGetEventExtendedDataRecordEx_GetEventExtendedDataRecordEx_EvtInfo_AutoCreatedDemEvent_McuDemEventParameterRefs_M_df511066
        OpEventGetEventExtendedDataRecordEx_GetEventExtendedDataRecordEx_GeneralEvtInfo: RteEventRef=OpEventGetEventExtendedDataRecordEx_GetEventExtendedDataRecordEx_GeneralEvtInfo
        OpEventGetEventEnableCondition_GetEventEnableCondition_EvtInfo_AutoCreatedDemEvent_McuDemEventParameterRefs_MCU_E_WRITE_cd571f63: RteEventRef=OpEventGetEventEnableCondition_GetEventEnableCondition_EvtInfo_AutoCreatedDemEvent_McuDemEventParameterRefs_MCU_E_WRITE_cd571f63
        OpEventGetEventEnableCondition_GetEventEnableCondition_EvtInfo_AutoCreatedDemEvent_McuDemEventParameterRefs_MCU_E_REG_W_479bcca3: RteEventRef=OpEventGetEventEnableCondition_GetEventEnableCondition_EvtInfo_AutoCreatedDemEvent_McuDemEventParameterRefs_MCU_E_REG_W_479bcca3
        OpEventGetEventEnableCondition_GetEventEnableCondition_EvtInfo_AutoCreatedDemEvent_McuDemEventParameterRefs_MCU_E_LVI_FAILURE: RteEventRef=OpEventGetEventEnableCondition_GetEventEnableCondition_EvtInfo_AutoCreatedDemEvent_McuDemEventParameterRefs_MCU_E_LVI_FAILURE
        OpEventGetEventEnableCondition_GetEventEnableCondition_EvtInfo_AutoCreatedDemEvent_McuDemEventParameterRefs_MCU_E_INCON_ba07e149: RteEventRef=OpEventGetEventEnableCondition_GetEventEnableCondition_EvtInfo_AutoCreatedDemEvent_McuDemEventParameterRefs_MCU_E_INCON_ba07e149
        OpEventGetEventEnableCondition_GetEventEnableCondition_EvtInfo_AutoCreatedDemEvent_McuDemEventParameterRefs_MCU_E_CVM_S_86c35766: RteEventRef=OpEventGetEventEnableCondition_GetEventEnableCondition_EvtInfo_AutoCreatedDemEvent_McuDemEventParameterRefs_MCU_E_CVM_S_86c35766
        OpEventGetEventEnableCondition_GetEventEnableCondition_EvtInfo_AutoCreatedDemEvent_McuDemEventParameterRefs_MCU_E_CLOCK_FAILURE: RteEventRef=OpEventGetEventEnableCondition_GetEventEnableCondition_EvtInfo_AutoCreatedDemEvent_McuDemEventParameterRefs_MCU_E_CLOCK_FAILURE
        OpEventGetEventEnableCondition_GetEventEnableCondition_GeneralEvtInfo: RteEventRef=OpEventGetEventEnableCondition_GetEventEnableCondition_GeneralEvtInfo
        OpEventGetDebouncingOfEvent_GetDebouncingOfEvent_EvtInfo_AutoCreatedDemEvent_McuDemEventParameterRefs_MCU_E_WRITE_TIMEO_be003f9e: RteEventRef=OpEventGetDebouncingOfEvent_GetDebouncingOfEvent_EvtInfo_AutoCreatedDemEvent_McuDemEventParameterRefs_MCU_E_WRITE_TIMEO_be003f9e
        OpEventGetDebouncingOfEvent_GetDebouncingOfEvent_EvtInfo_AutoCreatedDemEvent_McuDemEventParameterRefs_MCU_E_REG_WRITE_VERIFY: RteEventRef=OpEventGetDebouncingOfEvent_GetDebouncingOfEvent_EvtInfo_AutoCreatedDemEvent_McuDemEventParameterRefs_MCU_E_REG_WRITE_VERIFY
        OpEventGetDebouncingOfEvent_GetDebouncingOfEvent_EvtInfo_AutoCreatedDemEvent_McuDemEventParameterRefs_MCU_E_LVI_FAILURE: RteEventRef=OpEventGetDebouncingOfEvent_GetDebouncingOfEvent_EvtInfo_AutoCreatedDemEvent_McuDemEventParameterRefs_MCU_E_LVI_FAILURE
        OpEventGetDebouncingOfEvent_GetDebouncingOfEvent_EvtInfo_AutoCreatedDemEvent_McuDemEventParameterRefs_MCU_E_INCONCISTEN_c770c89b: RteEventRef=OpEventGetDebouncingOfEvent_GetDebouncingOfEvent_EvtInfo_AutoCreatedDemEvent_McuDemEventParameterRefs_MCU_E_INCONCISTEN_c770c89b
        OpEventGetDebouncingOfEvent_GetDebouncingOfEvent_EvtInfo_AutoCreatedDemEvent_McuDemEventParameterRefs_MCU_E_CVM_SETTING_FAILURE: RteEventRef=OpEventGetDebouncingOfEvent_GetDebouncingOfEvent_EvtInfo_AutoCreatedDemEvent_McuDemEventParameterRefs_MCU_E_CVM_SETTING_FAILURE
        OpEventGetDebouncingOfEvent_GetDebouncingOfEvent_EvtInfo_AutoCreatedDemEvent_McuDemEventParameterRefs_MCU_E_CLOCK_FAILURE: RteEventRef=OpEventGetDebouncingOfEvent_GetDebouncingOfEvent_EvtInfo_AutoCreatedDemEvent_McuDemEventParameterRefs_MCU_E_CLOCK_FAILURE
        OpEventGetDebouncingOfEvent_GetDebouncingOfEvent_GeneralEvtInfo: RteEventRef=OpEventGetDebouncingOfEvent_GetDebouncingOfEvent_GeneralEvtInfo
        OpEventGetMonitorStatus_GetMonitorStatus_EvtInfo_AutoCreatedDemEvent_McuDemEventParameterRefs_MCU_E_WRITE_TIMEOUT_FAILURE: RteEventRef=OpEventGetMonitorStatus_GetMonitorStatus_EvtInfo_AutoCreatedDemEvent_McuDemEventParameterRefs_MCU_E_WRITE_TIMEOUT_FAILURE
        OpEventGetMonitorStatus_GetMonitorStatus_EvtInfo_AutoCreatedDemEvent_McuDemEventParameterRefs_MCU_E_REG_WRITE_VERIFY: RteEventRef=OpEventGetMonitorStatus_GetMonitorStatus_EvtInfo_AutoCreatedDemEvent_McuDemEventParameterRefs_MCU_E_REG_WRITE_VERIFY
        OpEventGetMonitorStatus_GetMonitorStatus_EvtInfo_AutoCreatedDemEvent_McuDemEventParameterRefs_MCU_E_LVI_FAILURE: RteEventRef=OpEventGetMonitorStatus_GetMonitorStatus_EvtInfo_AutoCreatedDemEvent_McuDemEventParameterRefs_MCU_E_LVI_FAILURE
        OpEventGetMonitorStatus_GetMonitorStatus_EvtInfo_AutoCreatedDemEvent_McuDemEventParameterRefs_MCU_E_INCONCISTENCY_RESF_FAILURE: RteEventRef=OpEventGetMonitorStatus_GetMonitorStatus_EvtInfo_AutoCreatedDemEvent_McuDemEventParameterRefs_MCU_E_INCONCISTENCY_RESF_FAILURE
        OpEventGetMonitorStatus_GetMonitorStatus_EvtInfo_AutoCreatedDemEvent_McuDemEventParameterRefs_MCU_E_CVM_SETTING_FAILURE: RteEventRef=OpEventGetMonitorStatus_GetMonitorStatus_EvtInfo_AutoCreatedDemEvent_McuDemEventParameterRefs_MCU_E_CVM_SETTING_FAILURE
        OpEventGetMonitorStatus_GetMonitorStatus_EvtInfo_AutoCreatedDemEvent_McuDemEventParameterRefs_MCU_E_CLOCK_FAILURE: RteEventRef=OpEventGetMonitorStatus_GetMonitorStatus_EvtInfo_AutoCreatedDemEvent_McuDemEventParameterRefs_MCU_E_CLOCK_FAILURE
        OpEventGetMonitorStatus_GetMonitorStatus_GeneralEvtInfo: RteEventRef=OpEventGetMonitorStatus_GetMonitorStatus_GeneralEvtInfo
        OpEventGetEventFailed_GetEventFailed_EvtInfo_AutoCreatedDemEvent_EepDemEventParameterRefs_EEP_E_SET_LOCK_LEVEL_FAILED: RteEventRef=OpEventGetEventFailed_GetEventFailed_EvtInfo_AutoCreatedDemEvent_EepDemEventParameterRefs_EEP_E_SET_LOCK_LEVEL_FAILED
        OpEventGetEventUdsStatus_GetEventUdsStatus_EvtInfo_AutoCreatedDemEvent_NVM_E_INTEGRITY_FAILED: RteEventRef=OpEventGetEventUdsStatus_GetEventUdsStatus_EvtInfo_AutoCreatedDemEvent_NVM_E_INTEGRITY_FAILED
        OpEventGetDTCOfEvent_GetDTCOfEvent_EvtInfo_AutoCreatedDemEvent_ECUM_E_CONFIGURATION_DATA_INCONSISTENT: RteEventRef=OpEventGetDTCOfEvent_GetDTCOfEvent_EvtInfo_AutoCreatedDemEvent_ECUM_E_CONFIGURATION_DATA_INCONSISTENT
        OpEventGetDebouncingOfEvent_GetDebouncingOfEvent_EvtInfo_AutoCreatedDemEvent_EepDemEventParameterRefs_EEP_E_TEST_COM_FAILED: RteEventRef=OpEventGetDebouncingOfEvent_GetDebouncingOfEvent_EvtInfo_AutoCreatedDemEvent_EepDemEventParameterRefs_EEP_E_TEST_COM_FAILED
        OpEventGetDTCOfEvent_GetDTCOfEvent_EvtInfo_AutoCreatedDemEvent_EepDemEventParameterRefs_EEP_E_COMPARE_FAILED: RteEventRef=OpEventGetDTCOfEvent_GetDTCOfEvent_EvtInfo_AutoCreatedDemEvent_EepDemEventParameterRefs_EEP_E_COMPARE_FAILED
        OpEventGetDebouncingOfEvent_GetDebouncingOfEvent_EvtInfo_AutoCreatedDemEvent_NVM_E_VERIFY_FAILED: RteEventRef=OpEventGetDebouncingOfEvent_GetDebouncingOfEvent_EvtInfo_AutoCreatedDemEvent_NVM_E_VERIFY_FAILED
        OpEventGetMonitorStatus_GetMonitorStatus_EvtInfo_AutoCreatedDemEvent_ECUM_E_RAM_CHECK_FAILED: RteEventRef=OpEventGetMonitorStatus_GetMonitorStatus_EvtInfo_AutoCreatedDemEvent_ECUM_E_RAM_CHECK_FAILED
        OpEventGetDTCOfEvent_GetDTCOfEvent_EvtInfo_AutoCreatedDemEvent_NVM_E_WRONG_BLOCK_ID: RteEventRef=OpEventGetDTCOfEvent_GetDTCOfEvent_EvtInfo_AutoCreatedDemEvent_NVM_E_WRONG_BLOCK_ID
        OpEventGetFaultDetectionCounter_GetFaultDetectionCounter_EvtInfo_AutoCreatedDemEvent_EepDemEventParameterRefs_EEP_E_WRITE_FAILED: RteEventRef=OpEventGetFaultDetectionCounter_GetFaultDetectionCounter_EvtInfo_AutoCreatedDemEvent_EepDemEventParameterRefs_EEP_E_WRITE_FAILED
        OpEventGetFaultDetectionCounter_GetFaultDetectionCounter_EvtInfo_AutoCreatedDemEvent_EepDemEventParameterRefs_EEP_E_SET_c6c22bcd: RteEventRef=OpEventGetFaultDetectionCounter_GetFaultDetectionCounter_EvtInfo_AutoCreatedDemEvent_EepDemEventParameterRefs_EEP_E_SET_c6c22bcd
        OpEventGetEventTested_GetEventTested_EvtInfo_AutoCreatedDemEvent_EepDemEventParameterRefs_EEP_E_WRITE_FAILED: RteEventRef=OpEventGetEventTested_GetEventTested_EvtInfo_AutoCreatedDemEvent_EepDemEventParameterRefs_EEP_E_WRITE_FAILED
        OpEventGetEventTested_GetEventTested_EvtInfo_AutoCreatedDemEvent_EepDemEventParameterRefs_EEP_E_READ_FAILED: RteEventRef=OpEventGetEventTested_GetEventTested_EvtInfo_AutoCreatedDemEvent_EepDemEventParameterRefs_EEP_E_READ_FAILED
        OpEventGetEventEnableCondition_GetEventEnableCondition_EvtInfo_AutoCreatedDemEvent_NVM_E_REQ_FAILED: RteEventRef=OpEventGetEventEnableCondition_GetEventEnableCondition_EvtInfo_AutoCreatedDemEvent_NVM_E_REQ_FAILED
        OpEventGetMonitorStatus_GetMonitorStatus_EvtInfo_AutoCreatedDemEvent_EepDemEventParameterRefs_EEP_E_READ_FAILED: RteEventRef=OpEventGetMonitorStatus_GetMonitorStatus_EvtInfo_AutoCreatedDemEvent_EepDemEventParameterRefs_EEP_E_READ_FAILED
        OpEventGetDebouncingOfEvent_GetDebouncingOfEvent_EvtInfo_AutoCreatedDemEvent_EepDemEventParameterRefs_EEP_E_COMPARE_FAILED: RteEventRef=OpEventGetDebouncingOfEvent_GetDebouncingOfEvent_EvtInfo_AutoCreatedDemEvent_EepDemEventParameterRefs_EEP_E_COMPARE_FAILED
        OpEventGetEventExtendedDataRecordEx_GetEventExtendedDataRecordEx_EvtInfo_AutoCreatedDemEvent_NVM_E_WRONG_BLOCK_ID: RteEventRef=OpEventGetEventExtendedDataRecordEx_GetEventExtendedDataRecordEx_EvtInfo_AutoCreatedDemEvent_NVM_E_WRONG_BLOCK_ID
        OpEventGetMonitorStatus_GetMonitorStatus_EvtInfo_AutoCreatedDemEvent_ECUM_E_ALL_RUN_REQUESTS_KILLED: RteEventRef=OpEventGetMonitorStatus_GetMonitorStatus_EvtInfo_AutoCreatedDemEvent_ECUM_E_ALL_RUN_REQUESTS_KILLED
        OpEventGetDTCOfEvent_GetDTCOfEvent_EvtInfo_AutoCreatedDemEvent_NVM_E_WRITE_PROTECTED: RteEventRef=OpEventGetDTCOfEvent_GetDTCOfEvent_EvtInfo_AutoCreatedDemEvent_NVM_E_WRITE_PROTECTED
        OpEventGetEventUdsStatus_GetEventUdsStatus_EvtInfo_AutoCreatedDemEvent_EepDemEventParameterRefs_EEP_E_WRITE_FAILED: RteEventRef=OpEventGetEventUdsStatus_GetEventUdsStatus_EvtInfo_AutoCreatedDemEvent_EepDemEventParameterRefs_EEP_E_WRITE_FAILED
        OpEventGetEventFreezeFrameDataEx_GetEventFreezeFrameDataEx_EvtInfo_AutoCreatedDemEvent_EepDemEventParameterRefs_EEP_E_E_64b7b0f1: RteEventRef=OpEventGetEventFreezeFrameDataEx_GetEventFreezeFrameDataEx_EvtInfo_AutoCreatedDemEvent_EepDemEventParameterRefs_EEP_E_E_64b7b0f1
        OpEventGetEventEnableCondition_GetEventEnableCondition_EvtInfo_AutoCreatedDemEvent_NVM_E_VERIFY_FAILED: RteEventRef=OpEventGetEventEnableCondition_GetEventEnableCondition_EvtInfo_AutoCreatedDemEvent_NVM_E_VERIFY_FAILED
        OpEventGetEventFreezeFrameDataEx_GetEventFreezeFrameDataEx_EvtInfo_AutoCreatedDemEvent_NVM_E_WRITE_PROTECTED: RteEventRef=OpEventGetEventFreezeFrameDataEx_GetEventFreezeFrameDataEx_EvtInfo_AutoCreatedDemEvent_NVM_E_WRITE_PROTECTED
        OpEventGetEventExtendedDataRecordEx_GetEventExtendedDataRecordEx_EvtInfo_AutoCreatedDemEvent_ECUM_E_CONFIGURATION_DATA_22f5ed01: RteEventRef=OpEventGetEventExtendedDataRecordEx_GetEventExtendedDataRecordEx_EvtInfo_AutoCreatedDemEvent_ECUM_E_CONFIGURATION_DATA_22f5ed01
        OpEventGetMonitorStatus_GetMonitorStatus_EvtInfo_AutoCreatedDemEvent_EepDemEventParameterRefs_EEP_E_SET_LOCK_LEVEL_FAILED: RteEventRef=OpEventGetMonitorStatus_GetMonitorStatus_EvtInfo_AutoCreatedDemEvent_EepDemEventParameterRefs_EEP_E_SET_LOCK_LEVEL_FAILED
        OpEventGetEventExtendedDataRecordEx_GetEventExtendedDataRecordEx_EvtInfo_AutoCreatedDemEvent_NVM_E_VERIFY_FAILED: RteEventRef=OpEventGetEventExtendedDataRecordEx_GetEventExtendedDataRecordEx_EvtInfo_AutoCreatedDemEvent_NVM_E_VERIFY_FAILED
        OpEventGetEventTested_GetEventTested_EvtInfo_AutoCreatedDemEvent_NVM_E_LOSS_OF_REDUNDANCY: RteEventRef=OpEventGetEventTested_GetEventTested_EvtInfo_AutoCreatedDemEvent_NVM_E_LOSS_OF_REDUNDANCY
        OpEventGetEventStatus_GetEventStatus_EvtInfo_AutoCreatedDemEvent_NVM_E_VERIFY_FAILED: RteEventRef=OpEventGetEventStatus_GetEventStatus_EvtInfo_AutoCreatedDemEvent_NVM_E_VERIFY_FAILED
        OpEventGetEventEnableCondition_GetEventEnableCondition_EvtInfo_AutoCreatedDemEvent_EepDemEventParameterRefs_EEP_E_COMPARE_FAILED: RteEventRef=OpEventGetEventEnableCondition_GetEventEnableCondition_EvtInfo_AutoCreatedDemEvent_EepDemEventParameterRefs_EEP_E_COMPARE_FAILED
        OpEventGetEventStatus_GetEventStatus_EvtInfo_AutoCreatedDemEvent_EepDemEventParameterRefs_EEP_E_ERASE_FAILED: RteEventRef=OpEventGetEventStatus_GetEventStatus_EvtInfo_AutoCreatedDemEvent_EepDemEventParameterRefs_EEP_E_ERASE_FAILED
        OpEventGetFaultDetectionCounter_GetFaultDetectionCounter_EvtInfo_AutoCreatedDemEvent_EepDemEventParameterRefs_EEP_E_ERASE_FAILED: RteEventRef=OpEventGetFaultDetectionCounter_GetFaultDetectionCounter_EvtInfo_AutoCreatedDemEvent_EepDemEventParameterRefs_EEP_E_ERASE_FAILED
        OpEventGetDTCOfEvent_GetDTCOfEvent_EvtInfo_AutoCreatedDemEvent_NVM_E_INTEGRITY_FAILED: RteEventRef=OpEventGetDTCOfEvent_GetDTCOfEvent_EvtInfo_AutoCreatedDemEvent_NVM_E_INTEGRITY_FAILED
        OpEventGetDebouncingOfEvent_GetDebouncingOfEvent_EvtInfo_AutoCreatedDemEvent_NVM_E_REQ_FAILED: RteEventRef=OpEventGetDebouncingOfEvent_GetDebouncingOfEvent_EvtInfo_AutoCreatedDemEvent_NVM_E_REQ_FAILED
        OpEventGetEventStatus_GetEventStatus_EvtInfo_AutoCreatedDemEvent_EepDemEventParameterRefs_EEP_E_READ_FAILED: RteEventRef=OpEventGetEventStatus_GetEventStatus_EvtInfo_AutoCreatedDemEvent_EepDemEventParameterRefs_EEP_E_READ_FAILED
        OpEventGetEventFreezeFrameDataEx_GetEventFreezeFrameDataEx_EvtInfo_AutoCreatedDemEvent_EepDemEventParameterRefs_EEP_E_C_e068b25a: RteEventRef=OpEventGetEventFreezeFrameDataEx_GetEventFreezeFrameDataEx_EvtInfo_AutoCreatedDemEvent_EepDemEventParameterRefs_EEP_E_C_e068b25a
        OpEventGetEventTested_GetEventTested_EvtInfo_AutoCreatedDemEvent_NVM_E_WRITE_PROTECTED: RteEventRef=OpEventGetEventTested_GetEventTested_EvtInfo_AutoCreatedDemEvent_NVM_E_WRITE_PROTECTED
        OpEventGetEventFailed_GetEventFailed_EvtInfo_AutoCreatedDemEvent_ECUM_E_ALL_RUN_REQUESTS_KILLED: RteEventRef=OpEventGetEventFailed_GetEventFailed_EvtInfo_AutoCreatedDemEvent_ECUM_E_ALL_RUN_REQUESTS_KILLED
        OpEventGetEventFreezeFrameDataEx_GetEventFreezeFrameDataEx_EvtInfo_AutoCreatedDemEvent_EepDemEventParameterRefs_EEP_E_W_f322eeaf: RteEventRef=OpEventGetEventFreezeFrameDataEx_GetEventFreezeFrameDataEx_EvtInfo_AutoCreatedDemEvent_EepDemEventParameterRefs_EEP_E_W_f322eeaf
        OpEventGetEventUdsStatus_GetEventUdsStatus_EvtInfo_AutoCreatedDemEvent_EepDemEventParameterRefs_EEP_E_COMPARE_FAILED: RteEventRef=OpEventGetEventUdsStatus_GetEventUdsStatus_EvtInfo_AutoCreatedDemEvent_EepDemEventParameterRefs_EEP_E_COMPARE_FAILED
        OpEventGetFaultDetectionCounter_GetFaultDetectionCounter_EvtInfo_AutoCreatedDemEvent_NVM_E_WRITE_PROTECTED: RteEventRef=OpEventGetFaultDetectionCounter_GetFaultDetectionCounter_EvtInfo_AutoCreatedDemEvent_NVM_E_WRITE_PROTECTED
        OpEventGetEventStatus_GetEventStatus_EvtInfo_AutoCreatedDemEvent_NVM_E_LOSS_OF_REDUNDANCY: RteEventRef=OpEventGetEventStatus_GetEventStatus_EvtInfo_AutoCreatedDemEvent_NVM_E_LOSS_OF_REDUNDANCY
        OpEventGetDebouncingOfEvent_GetDebouncingOfEvent_EvtInfo_AutoCreatedDemEvent_NVM_E_WRITE_PROTECTED: RteEventRef=OpEventGetDebouncingOfEvent_GetDebouncingOfEvent_EvtInfo_AutoCreatedDemEvent_NVM_E_WRITE_PROTECTED
        OpEventGetEventEnableCondition_GetEventEnableCondition_EvtInfo_AutoCreatedDemEvent_EepDemEventParameterRefs_EEP_E_TEST_62776158: RteEventRef=OpEventGetEventEnableCondition_GetEventEnableCondition_EvtInfo_AutoCreatedDemEvent_EepDemEventParameterRefs_EEP_E_TEST_62776158
        OpEventGetMonitorStatus_GetMonitorStatus_EvtInfo_AutoCreatedDemEvent_ECUM_E_CONFIGURATION_DATA_INCONSISTENT: RteEventRef=OpEventGetMonitorStatus_GetMonitorStatus_EvtInfo_AutoCreatedDemEvent_ECUM_E_CONFIGURATION_DATA_INCONSISTENT
        OpEventGetEventFailed_GetEventFailed_EvtInfo_AutoCreatedDemEvent_ECUM_E_IMPROPER_CALLER: RteEventRef=OpEventGetEventFailed_GetEventFailed_EvtInfo_AutoCreatedDemEvent_ECUM_E_IMPROPER_CALLER
        OpEventGetEventUdsStatus_GetEventUdsStatus_EvtInfo_AutoCreatedDemEvent_ECUM_E_ALL_RUN_REQUESTS_KILLED: RteEventRef=OpEventGetEventUdsStatus_GetEventUdsStatus_EvtInfo_AutoCreatedDemEvent_ECUM_E_ALL_RUN_REQUESTS_KILLED
        OpEventGetFaultDetectionCounter_GetFaultDetectionCounter_EvtInfo_AutoCreatedDemEvent_NVM_E_INTEGRITY_FAILED: RteEventRef=OpEventGetFaultDetectionCounter_GetFaultDetectionCounter_EvtInfo_AutoCreatedDemEvent_NVM_E_INTEGRITY_FAILED
        OpEventGetEventExtendedDataRecordEx_GetEventExtendedDataRecordEx_EvtInfo_AutoCreatedDemEvent_EepDemEventParameterRefs_E_bf2c7fce: RteEventRef=OpEventGetEventExtendedDataRecordEx_GetEventExtendedDataRecordEx_EvtInfo_AutoCreatedDemEvent_EepDemEventParameterRefs_E_bf2c7fce
        OpEventGetEventUdsStatus_GetEventUdsStatus_EvtInfo_AutoCreatedDemEvent_EepDemEventParameterRefs_EEP_E_SET_LOCK_LEVEL_FAILED: RteEventRef=OpEventGetEventUdsStatus_GetEventUdsStatus_EvtInfo_AutoCreatedDemEvent_EepDemEventParameterRefs_EEP_E_SET_LOCK_LEVEL_FAILED
        OpEventGetEventFailed_GetEventFailed_EvtInfo_AutoCreatedDemEvent_NVM_E_WRITE_PROTECTED: RteEventRef=OpEventGetEventFailed_GetEventFailed_EvtInfo_AutoCreatedDemEvent_NVM_E_WRITE_PROTECTED
        OpEventGetEventExtendedDataRecordEx_GetEventExtendedDataRecordEx_EvtInfo_AutoCreatedDemEvent_NVM_E_REQ_FAILED: RteEventRef=OpEventGetEventExtendedDataRecordEx_GetEventExtendedDataRecordEx_EvtInfo_AutoCreatedDemEvent_NVM_E_REQ_FAILED
        OpEventGetEventFailed_GetEventFailed_EvtInfo_AutoCreatedDemEvent_EepDemEventParameterRefs_EEP_E_TEST_COM_FAILED: RteEventRef=OpEventGetEventFailed_GetEventFailed_EvtInfo_AutoCreatedDemEvent_EepDemEventParameterRefs_EEP_E_TEST_COM_FAILED
        OpEventGetEventStatus_GetEventStatus_EvtInfo_AutoCreatedDemEvent_ECUM_E_IMPROPER_CALLER: RteEventRef=OpEventGetEventStatus_GetEventStatus_EvtInfo_AutoCreatedDemEvent_ECUM_E_IMPROPER_CALLER
        OpEventGetFaultDetectionCounter_GetFaultDetectionCounter_EvtInfo_AutoCreatedDemEvent_EepDemEventParameterRefs_EEP_E_TES_edc8848e: RteEventRef=OpEventGetFaultDetectionCounter_GetFaultDetectionCounter_EvtInfo_AutoCreatedDemEvent_EepDemEventParameterRefs_EEP_E_TES_edc8848e
        OpEventGetMonitorStatus_GetMonitorStatus_EvtInfo_AutoCreatedDemEvent_EepDemEventParameterRefs_EEP_E_ERASE_FAILED: RteEventRef=OpEventGetMonitorStatus_GetMonitorStatus_EvtInfo_AutoCreatedDemEvent_EepDemEventParameterRefs_EEP_E_ERASE_FAILED
        OpEventGetEventTested_GetEventTested_EvtInfo_AutoCreatedDemEvent_EepDemEventParameterRefs_EEP_E_COMPARE_FAILED: RteEventRef=OpEventGetEventTested_GetEventTested_EvtInfo_AutoCreatedDemEvent_EepDemEventParameterRefs_EEP_E_COMPARE_FAILED
        OpEventGetFaultDetectionCounter_GetFaultDetectionCounter_EvtInfo_AutoCreatedDemEvent_ECUM_E_RAM_CHECK_FAILED: RteEventRef=OpEventGetFaultDetectionCounter_GetFaultDetectionCounter_EvtInfo_AutoCreatedDemEvent_ECUM_E_RAM_CHECK_FAILED
        OpEventGetEventEnableCondition_GetEventEnableCondition_EvtInfo_AutoCreatedDemEvent_EepDemEventParameterRefs_EEP_E_SET_L_4de99e21: RteEventRef=OpEventGetEventEnableCondition_GetEventEnableCondition_EvtInfo_AutoCreatedDemEvent_EepDemEventParameterRefs_EEP_E_SET_L_4de99e21
        OpEventGetEventUdsStatus_GetEventUdsStatus_EvtInfo_AutoCreatedDemEvent_ECUM_E_CONFIGURATION_DATA_INCONSISTENT: RteEventRef=OpEventGetEventUdsStatus_GetEventUdsStatus_EvtInfo_AutoCreatedDemEvent_ECUM_E_CONFIGURATION_DATA_INCONSISTENT
        OpEventGetEventUdsStatus_GetEventUdsStatus_EvtInfo_AutoCreatedDemEvent_ECUM_E_RAM_CHECK_FAILED: RteEventRef=OpEventGetEventUdsStatus_GetEventUdsStatus_EvtInfo_AutoCreatedDemEvent_ECUM_E_RAM_CHECK_FAILED
        OpEventGetEventFailed_GetEventFailed_EvtInfo_AutoCreatedDemEvent_EepDemEventParameterRefs_EEP_E_ERASE_FAILED: RteEventRef=OpEventGetEventFailed_GetEventFailed_EvtInfo_AutoCreatedDemEvent_EepDemEventParameterRefs_EEP_E_ERASE_FAILED
        OpEventGetDTCOfEvent_GetDTCOfEvent_EvtInfo_AutoCreatedDemEvent_NVM_E_LOSS_OF_REDUNDANCY: RteEventRef=OpEventGetDTCOfEvent_GetDTCOfEvent_EvtInfo_AutoCreatedDemEvent_NVM_E_LOSS_OF_REDUNDANCY
        OpEventGetEventExtendedDataRecordEx_GetEventExtendedDataRecordEx_EvtInfo_AutoCreatedDemEvent_ECUM_E_IMPROPER_CALLER: RteEventRef=OpEventGetEventExtendedDataRecordEx_GetEventExtendedDataRecordEx_EvtInfo_AutoCreatedDemEvent_ECUM_E_IMPROPER_CALLER
        OpEventGetEventEnableCondition_GetEventEnableCondition_EvtInfo_AutoCreatedDemEvent_NVM_E_WRONG_BLOCK_ID: RteEventRef=OpEventGetEventEnableCondition_GetEventEnableCondition_EvtInfo_AutoCreatedDemEvent_NVM_E_WRONG_BLOCK_ID
        OpEventGetMonitorStatus_GetMonitorStatus_EvtInfo_AutoCreatedDemEvent_NVM_E_LOSS_OF_REDUNDANCY: RteEventRef=OpEventGetMonitorStatus_GetMonitorStatus_EvtInfo_AutoCreatedDemEvent_NVM_E_LOSS_OF_REDUNDANCY
        OpEventGetEventEnableCondition_GetEventEnableCondition_EvtInfo_AutoCreatedDemEvent_ECUM_E_IMPROPER_CALLER: RteEventRef=OpEventGetEventEnableCondition_GetEventEnableCondition_EvtInfo_AutoCreatedDemEvent_ECUM_E_IMPROPER_CALLER
        OpEventGetEventStatus_GetEventStatus_EvtInfo_AutoCreatedDemEvent_EepDemEventParameterRefs_EEP_E_TEST_COM_FAILED: RteEventRef=OpEventGetEventStatus_GetEventStatus_EvtInfo_AutoCreatedDemEvent_EepDemEventParameterRefs_EEP_E_TEST_COM_FAILED
        OpEventGetFaultDetectionCounter_GetFaultDetectionCounter_EvtInfo_AutoCreatedDemEvent_NVM_E_REQ_FAILED: RteEventRef=OpEventGetFaultDetectionCounter_GetFaultDetectionCounter_EvtInfo_AutoCreatedDemEvent_NVM_E_REQ_FAILED
        OpEventGetEventEnableCondition_GetEventEnableCondition_EvtInfo_AutoCreatedDemEvent_NVM_E_QUEUE_OVERFLOW: RteEventRef=OpEventGetEventEnableCondition_GetEventEnableCondition_EvtInfo_AutoCreatedDemEvent_NVM_E_QUEUE_OVERFLOW
        OpEventGetDebouncingOfEvent_GetDebouncingOfEvent_EvtInfo_AutoCreatedDemEvent_NVM_E_QUEUE_OVERFLOW: RteEventRef=OpEventGetDebouncingOfEvent_GetDebouncingOfEvent_EvtInfo_AutoCreatedDemEvent_NVM_E_QUEUE_OVERFLOW
        OpEventGetEventExtendedDataRecordEx_GetEventExtendedDataRecordEx_EvtInfo_AutoCreatedDemEvent_NVM_E_QUEUE_OVERFLOW: RteEventRef=OpEventGetEventExtendedDataRecordEx_GetEventExtendedDataRecordEx_EvtInfo_AutoCreatedDemEvent_NVM_E_QUEUE_OVERFLOW
        OpEventGetEventFailed_GetEventFailed_EvtInfo_AutoCreatedDemEvent_EepDemEventParameterRefs_EEP_E_COMPARE_FAILED: RteEventRef=OpEventGetEventFailed_GetEventFailed_EvtInfo_AutoCreatedDemEvent_EepDemEventParameterRefs_EEP_E_COMPARE_FAILED
        OpEventGetEventFreezeFrameDataEx_GetEventFreezeFrameDataEx_EvtInfo_AutoCreatedDemEvent_ECUM_E_CONFIGURATION_DATA_INCONSISTENT: RteEventRef=OpEventGetEventFreezeFrameDataEx_GetEventFreezeFrameDataEx_EvtInfo_AutoCreatedDemEvent_ECUM_E_CONFIGURATION_DATA_INCONSISTENT
        OpEventGetEventFailed_GetEventFailed_EvtInfo_AutoCreatedDemEvent_ECUM_E_CONFIGURATION_DATA_INCONSISTENT: RteEventRef=OpEventGetEventFailed_GetEventFailed_EvtInfo_AutoCreatedDemEvent_ECUM_E_CONFIGURATION_DATA_INCONSISTENT
        OpEventGetEventEnableCondition_GetEventEnableCondition_EvtInfo_AutoCreatedDemEvent_ECUM_E_RAM_CHECK_FAILED: RteEventRef=OpEventGetEventEnableCondition_GetEventEnableCondition_EvtInfo_AutoCreatedDemEvent_ECUM_E_RAM_CHECK_FAILED
        OpEventGetDebouncingOfEvent_GetDebouncingOfEvent_EvtInfo_AutoCreatedDemEvent_EepDemEventParameterRefs_EEP_E_SET_LOCK_LE_3ebebedc: RteEventRef=OpEventGetDebouncingOfEvent_GetDebouncingOfEvent_EvtInfo_AutoCreatedDemEvent_EepDemEventParameterRefs_EEP_E_SET_LOCK_LE_3ebebedc
        OpEventGetEventTested_GetEventTested_EvtInfo_AutoCreatedDemEvent_NVM_E_VERIFY_FAILED: RteEventRef=OpEventGetEventTested_GetEventTested_EvtInfo_AutoCreatedDemEvent_NVM_E_VERIFY_FAILED
        OpEventGetEventTested_GetEventTested_EvtInfo_AutoCreatedDemEvent_EepDemEventParameterRefs_EEP_E_TEST_COM_FAILED: RteEventRef=OpEventGetEventTested_GetEventTested_EvtInfo_AutoCreatedDemEvent_EepDemEventParameterRefs_EEP_E_TEST_COM_FAILED
        OpEventGetDebouncingOfEvent_GetDebouncingOfEvent_EvtInfo_AutoCreatedDemEvent_EepDemEventParameterRefs_EEP_E_WRITE_FAILED: RteEventRef=OpEventGetDebouncingOfEvent_GetDebouncingOfEvent_EvtInfo_AutoCreatedDemEvent_EepDemEventParameterRefs_EEP_E_WRITE_FAILED
        OpEventGetMonitorStatus_GetMonitorStatus_EvtInfo_AutoCreatedDemEvent_NVM_E_INTEGRITY_FAILED: RteEventRef=OpEventGetMonitorStatus_GetMonitorStatus_EvtInfo_AutoCreatedDemEvent_NVM_E_INTEGRITY_FAILED
        OpEventGetEventFailed_GetEventFailed_EvtInfo_AutoCreatedDemEvent_NVM_E_VERIFY_FAILED: RteEventRef=OpEventGetEventFailed_GetEventFailed_EvtInfo_AutoCreatedDemEvent_NVM_E_VERIFY_FAILED
        OpEventGetEventStatus_GetEventStatus_EvtInfo_AutoCreatedDemEvent_NVM_E_WRONG_BLOCK_ID: RteEventRef=OpEventGetEventStatus_GetEventStatus_EvtInfo_AutoCreatedDemEvent_NVM_E_WRONG_BLOCK_ID
        OpEventGetEventEnableCondition_GetEventEnableCondition_EvtInfo_AutoCreatedDemEvent_ECUM_E_CONFIGURATION_DATA_INCONSISTENT: RteEventRef=OpEventGetEventEnableCondition_GetEventEnableCondition_EvtInfo_AutoCreatedDemEvent_ECUM_E_CONFIGURATION_DATA_INCONSISTENT
        OpEventGetEventTested_GetEventTested_EvtInfo_AutoCreatedDemEvent_EepDemEventParameterRefs_EEP_E_ERASE_FAILED: RteEventRef=OpEventGetEventTested_GetEventTested_EvtInfo_AutoCreatedDemEvent_EepDemEventParameterRefs_EEP_E_ERASE_FAILED
        OpEventGetEventExtendedDataRecordEx_GetEventExtendedDataRecordEx_EvtInfo_AutoCreatedDemEvent_ECUM_E_RAM_CHECK_FAILED: RteEventRef=OpEventGetEventExtendedDataRecordEx_GetEventExtendedDataRecordEx_EvtInfo_AutoCreatedDemEvent_ECUM_E_RAM_CHECK_FAILED
        OpEventGetEventFailed_GetEventFailed_EvtInfo_AutoCreatedDemEvent_NVM_E_WRONG_BLOCK_ID: RteEventRef=OpEventGetEventFailed_GetEventFailed_EvtInfo_AutoCreatedDemEvent_NVM_E_WRONG_BLOCK_ID
        OpEventGetEventFailed_GetEventFailed_EvtInfo_AutoCreatedDemEvent_ECUM_E_RAM_CHECK_FAILED: RteEventRef=OpEventGetEventFailed_GetEventFailed_EvtInfo_AutoCreatedDemEvent_ECUM_E_RAM_CHECK_FAILED
        OpEventGetMonitorStatus_GetMonitorStatus_EvtInfo_AutoCreatedDemEvent_NVM_E_VERIFY_FAILED: RteEventRef=OpEventGetMonitorStatus_GetMonitorStatus_EvtInfo_AutoCreatedDemEvent_NVM_E_VERIFY_FAILED
        OpEventGetEventUdsStatus_GetEventUdsStatus_EvtInfo_AutoCreatedDemEvent_NVM_E_WRONG_BLOCK_ID: RteEventRef=OpEventGetEventUdsStatus_GetEventUdsStatus_EvtInfo_AutoCreatedDemEvent_NVM_E_WRONG_BLOCK_ID
        OpEventGetMonitorStatus_GetMonitorStatus_EvtInfo_AutoCreatedDemEvent_EepDemEventParameterRefs_EEP_E_TEST_COM_FAILED: RteEventRef=OpEventGetMonitorStatus_GetMonitorStatus_EvtInfo_AutoCreatedDemEvent_EepDemEventParameterRefs_EEP_E_TEST_COM_FAILED
        OpEventGetEventExtendedDataRecordEx_GetEventExtendedDataRecordEx_EvtInfo_AutoCreatedDemEvent_NVM_E_WRITE_PROTECTED: RteEventRef=OpEventGetEventExtendedDataRecordEx_GetEventExtendedDataRecordEx_EvtInfo_AutoCreatedDemEvent_NVM_E_WRITE_PROTECTED
        OpEventGetEventFreezeFrameDataEx_GetEventFreezeFrameDataEx_EvtInfo_AutoCreatedDemEvent_NVM_E_QUEUE_OVERFLOW: RteEventRef=OpEventGetEventFreezeFrameDataEx_GetEventFreezeFrameDataEx_EvtInfo_AutoCreatedDemEvent_NVM_E_QUEUE_OVERFLOW
        OpEventGetEventEnableCondition_GetEventEnableCondition_EvtInfo_AutoCreatedDemEvent_NVM_E_INTEGRITY_FAILED: RteEventRef=OpEventGetEventEnableCondition_GetEventEnableCondition_EvtInfo_AutoCreatedDemEvent_NVM_E_INTEGRITY_FAILED
        OpEventGetEventStatus_GetEventStatus_EvtInfo_AutoCreatedDemEvent_NVM_E_INTEGRITY_FAILED: RteEventRef=OpEventGetEventStatus_GetEventStatus_EvtInfo_AutoCreatedDemEvent_NVM_E_INTEGRITY_FAILED
        OpEventGetEventExtendedDataRecordEx_GetEventExtendedDataRecordEx_EvtInfo_AutoCreatedDemEvent_EepDemEventParameterRefs_E_357dd423: RteEventRef=OpEventGetEventExtendedDataRecordEx_GetEventExtendedDataRecordEx_EvtInfo_AutoCreatedDemEvent_EepDemEventParameterRefs_E_357dd423
        OpEventGetEventTested_GetEventTested_EvtInfo_AutoCreatedDemEvent_NVM_E_QUEUE_OVERFLOW: RteEventRef=OpEventGetEventTested_GetEventTested_EvtInfo_AutoCreatedDemEvent_NVM_E_QUEUE_OVERFLOW
        OpEventGetMonitorStatus_GetMonitorStatus_EvtInfo_AutoCreatedDemEvent_EepDemEventParameterRefs_EEP_E_COMPARE_FAILED: RteEventRef=OpEventGetMonitorStatus_GetMonitorStatus_EvtInfo_AutoCreatedDemEvent_EepDemEventParameterRefs_EEP_E_COMPARE_FAILED
        OpEventGetFaultDetectionCounter_GetFaultDetectionCounter_EvtInfo_AutoCreatedDemEvent_NVM_E_VERIFY_FAILED: RteEventRef=OpEventGetFaultDetectionCounter_GetFaultDetectionCounter_EvtInfo_AutoCreatedDemEvent_NVM_E_VERIFY_FAILED
        OpEventGetEventTested_GetEventTested_EvtInfo_AutoCreatedDemEvent_NVM_E_INTEGRITY_FAILED: RteEventRef=OpEventGetEventTested_GetEventTested_EvtInfo_AutoCreatedDemEvent_NVM_E_INTEGRITY_FAILED
        OpEventGetDTCOfEvent_GetDTCOfEvent_EvtInfo_AutoCreatedDemEvent_EepDemEventParameterRefs_EEP_E_READ_FAILED: RteEventRef=OpEventGetDTCOfEvent_GetDTCOfEvent_EvtInfo_AutoCreatedDemEvent_EepDemEventParameterRefs_EEP_E_READ_FAILED
        OpEventGetEventUdsStatus_GetEventUdsStatus_EvtInfo_AutoCreatedDemEvent_NVM_E_REQ_FAILED: RteEventRef=OpEventGetEventUdsStatus_GetEventUdsStatus_EvtInfo_AutoCreatedDemEvent_NVM_E_REQ_FAILED
        OpEventGetEventExtendedDataRecordEx_GetEventExtendedDataRecordEx_EvtInfo_AutoCreatedDemEvent_NVM_E_INTEGRITY_FAILED: RteEventRef=OpEventGetEventExtendedDataRecordEx_GetEventExtendedDataRecordEx_EvtInfo_AutoCreatedDemEvent_NVM_E_INTEGRITY_FAILED
        OpEventGetFaultDetectionCounter_GetFaultDetectionCounter_EvtInfo_AutoCreatedDemEvent_ECUM_E_CONFIGURATION_DATA_INCONSISTENT: RteEventRef=OpEventGetFaultDetectionCounter_GetFaultDetectionCounter_EvtInfo_AutoCreatedDemEvent_ECUM_E_CONFIGURATION_DATA_INCONSISTENT
        OpEventGetEventFreezeFrameDataEx_GetEventFreezeFrameDataEx_EvtInfo_AutoCreatedDemEvent_NVM_E_WRONG_BLOCK_ID: RteEventRef=OpEventGetEventFreezeFrameDataEx_GetEventFreezeFrameDataEx_EvtInfo_AutoCreatedDemEvent_NVM_E_WRONG_BLOCK_ID
        OpEventGetEventExtendedDataRecordEx_GetEventExtendedDataRecordEx_EvtInfo_AutoCreatedDemEvent_EepDemEventParameterRefs_E_2551e95a: RteEventRef=OpEventGetEventExtendedDataRecordEx_GetEventExtendedDataRecordEx_EvtInfo_AutoCreatedDemEvent_EepDemEventParameterRefs_E_2551e95a
        OpEventGetDebouncingOfEvent_GetDebouncingOfEvent_EvtInfo_AutoCreatedDemEvent_EepDemEventParameterRefs_EEP_E_READ_FAILED: RteEventRef=OpEventGetDebouncingOfEvent_GetDebouncingOfEvent_EvtInfo_AutoCreatedDemEvent_EepDemEventParameterRefs_EEP_E_READ_FAILED
        OpEventGetDTCOfEvent_GetDTCOfEvent_EvtInfo_AutoCreatedDemEvent_EepDemEventParameterRefs_EEP_E_TEST_COM_FAILED: RteEventRef=OpEventGetDTCOfEvent_GetDTCOfEvent_EvtInfo_AutoCreatedDemEvent_EepDemEventParameterRefs_EEP_E_TEST_COM_FAILED
        OpEventGetEventEnableCondition_GetEventEnableCondition_EvtInfo_AutoCreatedDemEvent_ECUM_E_ALL_RUN_REQUESTS_KILLED: RteEventRef=OpEventGetEventEnableCondition_GetEventEnableCondition_EvtInfo_AutoCreatedDemEvent_ECUM_E_ALL_RUN_REQUESTS_KILLED
        OpEventGetDebouncingOfEvent_GetDebouncingOfEvent_EvtInfo_AutoCreatedDemEvent_ECUM_E_CONFIGURATION_DATA_INCONSISTENT: RteEventRef=OpEventGetDebouncingOfEvent_GetDebouncingOfEvent_EvtInfo_AutoCreatedDemEvent_ECUM_E_CONFIGURATION_DATA_INCONSISTENT
        OpEventGetDebouncingOfEvent_GetDebouncingOfEvent_EvtInfo_AutoCreatedDemEvent_NVM_E_LOSS_OF_REDUNDANCY: RteEventRef=OpEventGetDebouncingOfEvent_GetDebouncingOfEvent_EvtInfo_AutoCreatedDemEvent_NVM_E_LOSS_OF_REDUNDANCY
        OpEventGetEventExtendedDataRecordEx_GetEventExtendedDataRecordEx_EvtInfo_AutoCreatedDemEvent_EepDemEventParameterRefs_E_73c079cb: RteEventRef=OpEventGetEventExtendedDataRecordEx_GetEventExtendedDataRecordEx_EvtInfo_AutoCreatedDemEvent_EepDemEventParameterRefs_E_73c079cb
        OpEventGetDTCOfEvent_GetDTCOfEvent_EvtInfo_AutoCreatedDemEvent_ECUM_E_RAM_CHECK_FAILED: RteEventRef=OpEventGetDTCOfEvent_GetDTCOfEvent_EvtInfo_AutoCreatedDemEvent_ECUM_E_RAM_CHECK_FAILED
        OpEventGetEventFreezeFrameDataEx_GetEventFreezeFrameDataEx_EvtInfo_AutoCreatedDemEvent_ECUM_E_RAM_CHECK_FAILED: RteEventRef=OpEventGetEventFreezeFrameDataEx_GetEventFreezeFrameDataEx_EvtInfo_AutoCreatedDemEvent_ECUM_E_RAM_CHECK_FAILED
        OpEventGetEventEnableCondition_GetEventEnableCondition_EvtInfo_AutoCreatedDemEvent_EepDemEventParameterRefs_EEP_E_ERASE_FAILED: RteEventRef=OpEventGetEventEnableCondition_GetEventEnableCondition_EvtInfo_AutoCreatedDemEvent_EepDemEventParameterRefs_EEP_E_ERASE_FAILED
        OpEventGetEventFreezeFrameDataEx_GetEventFreezeFrameDataEx_EvtInfo_AutoCreatedDemEvent_ECUM_E_IMPROPER_CALLER: RteEventRef=OpEventGetEventFreezeFrameDataEx_GetEventFreezeFrameDataEx_EvtInfo_AutoCreatedDemEvent_ECUM_E_IMPROPER_CALLER
        OpEventGetEventUdsStatus_GetEventUdsStatus_EvtInfo_AutoCreatedDemEvent_NVM_E_WRITE_PROTECTED: RteEventRef=OpEventGetEventUdsStatus_GetEventUdsStatus_EvtInfo_AutoCreatedDemEvent_NVM_E_WRITE_PROTECTED
        OpEventGetEventStatus_GetEventStatus_EvtInfo_AutoCreatedDemEvent_EepDemEventParameterRefs_EEP_E_COMPARE_FAILED: RteEventRef=OpEventGetEventStatus_GetEventStatus_EvtInfo_AutoCreatedDemEvent_EepDemEventParameterRefs_EEP_E_COMPARE_FAILED
        OpEventGetEventFreezeFrameDataEx_GetEventFreezeFrameDataEx_EvtInfo_AutoCreatedDemEvent_EepDemEventParameterRefs_EEP_E_R_d75e1f88: RteEventRef=OpEventGetEventFreezeFrameDataEx_GetEventFreezeFrameDataEx_EvtInfo_AutoCreatedDemEvent_EepDemEventParameterRefs_EEP_E_R_d75e1f88
        OpEventGetEventUdsStatus_GetEventUdsStatus_EvtInfo_AutoCreatedDemEvent_ECUM_E_IMPROPER_CALLER: RteEventRef=OpEventGetEventUdsStatus_GetEventUdsStatus_EvtInfo_AutoCreatedDemEvent_ECUM_E_IMPROPER_CALLER
        OpEventGetMonitorStatus_GetMonitorStatus_EvtInfo_AutoCreatedDemEvent_NVM_E_WRITE_PROTECTED: RteEventRef=OpEventGetMonitorStatus_GetMonitorStatus_EvtInfo_AutoCreatedDemEvent_NVM_E_WRITE_PROTECTED
        OpEventGetEventExtendedDataRecordEx_GetEventExtendedDataRecordEx_EvtInfo_AutoCreatedDemEvent_EepDemEventParameterRefs_E_fe18935c: RteEventRef=OpEventGetEventExtendedDataRecordEx_GetEventExtendedDataRecordEx_EvtInfo_AutoCreatedDemEvent_EepDemEventParameterRefs_E_fe18935c
        OpEventGetDTCOfEvent_GetDTCOfEvent_EvtInfo_AutoCreatedDemEvent_EepDemEventParameterRefs_EEP_E_WRITE_FAILED: RteEventRef=OpEventGetDTCOfEvent_GetDTCOfEvent_EvtInfo_AutoCreatedDemEvent_EepDemEventParameterRefs_EEP_E_WRITE_FAILED
        OpEventGetEventUdsStatus_GetEventUdsStatus_EvtInfo_AutoCreatedDemEvent_NVM_E_LOSS_OF_REDUNDANCY: RteEventRef=OpEventGetEventUdsStatus_GetEventUdsStatus_EvtInfo_AutoCreatedDemEvent_NVM_E_LOSS_OF_REDUNDANCY
        OpEventGetDTCOfEvent_GetDTCOfEvent_EvtInfo_AutoCreatedDemEvent_EepDemEventParameterRefs_EEP_E_ERASE_FAILED: RteEventRef=OpEventGetDTCOfEvent_GetDTCOfEvent_EvtInfo_AutoCreatedDemEvent_EepDemEventParameterRefs_EEP_E_ERASE_FAILED
        OpEventGetDebouncingOfEvent_GetDebouncingOfEvent_EvtInfo_AutoCreatedDemEvent_NVM_E_WRONG_BLOCK_ID: RteEventRef=OpEventGetDebouncingOfEvent_GetDebouncingOfEvent_EvtInfo_AutoCreatedDemEvent_NVM_E_WRONG_BLOCK_ID
        OpEventGetMonitorStatus_GetMonitorStatus_EvtInfo_AutoCreatedDemEvent_EepDemEventParameterRefs_EEP_E_WRITE_FAILED: RteEventRef=OpEventGetMonitorStatus_GetMonitorStatus_EvtInfo_AutoCreatedDemEvent_EepDemEventParameterRefs_EEP_E_WRITE_FAILED
        OpEventGetEventFreezeFrameDataEx_GetEventFreezeFrameDataEx_EvtInfo_AutoCreatedDemEvent_EepDemEventParameterRefs_EEP_E_S_fb2cc7f3: RteEventRef=OpEventGetEventFreezeFrameDataEx_GetEventFreezeFrameDataEx_EvtInfo_AutoCreatedDemEvent_EepDemEventParameterRefs_EEP_E_S_fb2cc7f3
        OpEventGetEventTested_GetEventTested_EvtInfo_AutoCreatedDemEvent_ECUM_E_RAM_CHECK_FAILED: RteEventRef=OpEventGetEventTested_GetEventTested_EvtInfo_AutoCreatedDemEvent_ECUM_E_RAM_CHECK_FAILED
        OpEventGetEventTested_GetEventTested_EvtInfo_AutoCreatedDemEvent_EepDemEventParameterRefs_EEP_E_SET_LOCK_LEVEL_FAILED: RteEventRef=OpEventGetEventTested_GetEventTested_EvtInfo_AutoCreatedDemEvent_EepDemEventParameterRefs_EEP_E_SET_LOCK_LEVEL_FAILED
        OpEventGetFaultDetectionCounter_GetFaultDetectionCounter_EvtInfo_AutoCreatedDemEvent_NVM_E_LOSS_OF_REDUNDANCY: RteEventRef=OpEventGetFaultDetectionCounter_GetFaultDetectionCounter_EvtInfo_AutoCreatedDemEvent_NVM_E_LOSS_OF_REDUNDANCY
        OpEventGetEventStatus_GetEventStatus_EvtInfo_AutoCreatedDemEvent_NVM_E_REQ_FAILED: RteEventRef=OpEventGetEventStatus_GetEventStatus_EvtInfo_AutoCreatedDemEvent_NVM_E_REQ_FAILED
        OpEventGetFaultDetectionCounter_GetFaultDetectionCounter_EvtInfo_AutoCreatedDemEvent_EepDemEventParameterRefs_EEP_E_COM_03a3fbd6: RteEventRef=OpEventGetFaultDetectionCounter_GetFaultDetectionCounter_EvtInfo_AutoCreatedDemEvent_EepDemEventParameterRefs_EEP_E_COM_03a3fbd6
        OpEventGetEventStatus_GetEventStatus_EvtInfo_AutoCreatedDemEvent_ECUM_E_CONFIGURATION_DATA_INCONSISTENT: RteEventRef=OpEventGetEventStatus_GetEventStatus_EvtInfo_AutoCreatedDemEvent_ECUM_E_CONFIGURATION_DATA_INCONSISTENT
        OpEventGetFaultDetectionCounter_GetFaultDetectionCounter_EvtInfo_AutoCreatedDemEvent_ECUM_E_IMPROPER_CALLER: RteEventRef=OpEventGetFaultDetectionCounter_GetFaultDetectionCounter_EvtInfo_AutoCreatedDemEvent_ECUM_E_IMPROPER_CALLER
        OpEventGetMonitorStatus_GetMonitorStatus_EvtInfo_AutoCreatedDemEvent_ECUM_E_IMPROPER_CALLER: RteEventRef=OpEventGetMonitorStatus_GetMonitorStatus_EvtInfo_AutoCreatedDemEvent_ECUM_E_IMPROPER_CALLER
        OpEventGetEventFailed_GetEventFailed_EvtInfo_AutoCreatedDemEvent_NVM_E_LOSS_OF_REDUNDANCY: RteEventRef=OpEventGetEventFailed_GetEventFailed_EvtInfo_AutoCreatedDemEvent_NVM_E_LOSS_OF_REDUNDANCY
        OpEventGetFaultDetectionCounter_GetFaultDetectionCounter_EvtInfo_AutoCreatedDemEvent_ECUM_E_ALL_RUN_REQUESTS_KILLED: RteEventRef=OpEventGetFaultDetectionCounter_GetFaultDetectionCounter_EvtInfo_AutoCreatedDemEvent_ECUM_E_ALL_RUN_REQUESTS_KILLED
        OpEventGetEventStatus_GetEventStatus_EvtInfo_AutoCreatedDemEvent_ECUM_E_RAM_CHECK_FAILED: RteEventRef=OpEventGetEventStatus_GetEventStatus_EvtInfo_AutoCreatedDemEvent_ECUM_E_RAM_CHECK_FAILED
        OpEventGetEventExtendedDataRecordEx_GetEventExtendedDataRecordEx_EvtInfo_AutoCreatedDemEvent_ECUM_E_ALL_RUN_REQUESTS_KILLED: RteEventRef=OpEventGetEventExtendedDataRecordEx_GetEventExtendedDataRecordEx_EvtInfo_AutoCreatedDemEvent_ECUM_E_ALL_RUN_REQUESTS_KILLED
        OpEventGetEventFailed_GetEventFailed_EvtInfo_AutoCreatedDemEvent_NVM_E_REQ_FAILED: RteEventRef=OpEventGetEventFailed_GetEventFailed_EvtInfo_AutoCreatedDemEvent_NVM_E_REQ_FAILED
        OpEventGetEventExtendedDataRecordEx_GetEventExtendedDataRecordEx_EvtInfo_AutoCreatedDemEvent_NVM_E_LOSS_OF_REDUNDANCY: RteEventRef=OpEventGetEventExtendedDataRecordEx_GetEventExtendedDataRecordEx_EvtInfo_AutoCreatedDemEvent_NVM_E_LOSS_OF_REDUNDANCY
        OpEventGetEventFreezeFrameDataEx_GetEventFreezeFrameDataEx_EvtInfo_AutoCreatedDemEvent_NVM_E_VERIFY_FAILED: RteEventRef=OpEventGetEventFreezeFrameDataEx_GetEventFreezeFrameDataEx_EvtInfo_AutoCreatedDemEvent_NVM_E_VERIFY_FAILED
        OpEventGetEventTested_GetEventTested_EvtInfo_AutoCreatedDemEvent_ECUM_E_CONFIGURATION_DATA_INCONSISTENT: RteEventRef=OpEventGetEventTested_GetEventTested_EvtInfo_AutoCreatedDemEvent_ECUM_E_CONFIGURATION_DATA_INCONSISTENT
        OpEventGetMonitorStatus_GetMonitorStatus_EvtInfo_AutoCreatedDemEvent_NVM_E_WRONG_BLOCK_ID: RteEventRef=OpEventGetMonitorStatus_GetMonitorStatus_EvtInfo_AutoCreatedDemEvent_NVM_E_WRONG_BLOCK_ID
        OpEventGetEventFreezeFrameDataEx_GetEventFreezeFrameDataEx_EvtInfo_AutoCreatedDemEvent_NVM_E_LOSS_OF_REDUNDANCY: RteEventRef=OpEventGetEventFreezeFrameDataEx_GetEventFreezeFrameDataEx_EvtInfo_AutoCreatedDemEvent_NVM_E_LOSS_OF_REDUNDANCY
        OpEventGetEventTested_GetEventTested_EvtInfo_AutoCreatedDemEvent_NVM_E_WRONG_BLOCK_ID: RteEventRef=OpEventGetEventTested_GetEventTested_EvtInfo_AutoCreatedDemEvent_NVM_E_WRONG_BLOCK_ID
        OpEventGetEventFailed_GetEventFailed_EvtInfo_AutoCreatedDemEvent_NVM_E_INTEGRITY_FAILED: RteEventRef=OpEventGetEventFailed_GetEventFailed_EvtInfo_AutoCreatedDemEvent_NVM_E_INTEGRITY_FAILED
        OpEventGetEventEnableCondition_GetEventEnableCondition_EvtInfo_AutoCreatedDemEvent_NVM_E_WRITE_PROTECTED: RteEventRef=OpEventGetEventEnableCondition_GetEventEnableCondition_EvtInfo_AutoCreatedDemEvent_NVM_E_WRITE_PROTECTED
        OpEventGetDebouncingOfEvent_GetDebouncingOfEvent_EvtInfo_AutoCreatedDemEvent_EepDemEventParameterRefs_EEP_E_ERASE_FAILED: RteEventRef=OpEventGetDebouncingOfEvent_GetDebouncingOfEvent_EvtInfo_AutoCreatedDemEvent_EepDemEventParameterRefs_EEP_E_ERASE_FAILED
        OpEventGetEventFreezeFrameDataEx_GetEventFreezeFrameDataEx_EvtInfo_AutoCreatedDemEvent_NVM_E_REQ_FAILED: RteEventRef=OpEventGetEventFreezeFrameDataEx_GetEventFreezeFrameDataEx_EvtInfo_AutoCreatedDemEvent_NVM_E_REQ_FAILED
        OpEventGetEventTested_GetEventTested_EvtInfo_AutoCreatedDemEvent_NVM_E_REQ_FAILED: RteEventRef=OpEventGetEventTested_GetEventTested_EvtInfo_AutoCreatedDemEvent_NVM_E_REQ_FAILED
        OpEventGetEventUdsStatus_GetEventUdsStatus_EvtInfo_AutoCreatedDemEvent_EepDemEventParameterRefs_EEP_E_ERASE_FAILED: RteEventRef=OpEventGetEventUdsStatus_GetEventUdsStatus_EvtInfo_AutoCreatedDemEvent_EepDemEventParameterRefs_EEP_E_ERASE_FAILED
        OpEventGetDTCOfEvent_GetDTCOfEvent_EvtInfo_AutoCreatedDemEvent_NVM_E_VERIFY_FAILED: RteEventRef=OpEventGetDTCOfEvent_GetDTCOfEvent_EvtInfo_AutoCreatedDemEvent_NVM_E_VERIFY_FAILED
        OpEventGetEventTested_GetEventTested_EvtInfo_AutoCreatedDemEvent_ECUM_E_IMPROPER_CALLER: RteEventRef=OpEventGetEventTested_GetEventTested_EvtInfo_AutoCreatedDemEvent_ECUM_E_IMPROPER_CALLER
        OpEventGetEventFreezeFrameDataEx_GetEventFreezeFrameDataEx_EvtInfo_AutoCreatedDemEvent_ECUM_E_ALL_RUN_REQUESTS_KILLED: RteEventRef=OpEventGetEventFreezeFrameDataEx_GetEventFreezeFrameDataEx_EvtInfo_AutoCreatedDemEvent_ECUM_E_ALL_RUN_REQUESTS_KILLED
        OpEventGetEventStatus_GetEventStatus_EvtInfo_AutoCreatedDemEvent_NVM_E_WRITE_PROTECTED: RteEventRef=OpEventGetEventStatus_GetEventStatus_EvtInfo_AutoCreatedDemEvent_NVM_E_WRITE_PROTECTED
        OpEventGetEventExtendedDataRecordEx_GetEventExtendedDataRecordEx_EvtInfo_AutoCreatedDemEvent_EepDemEventParameterRefs_E_b2c4b704: RteEventRef=OpEventGetEventExtendedDataRecordEx_GetEventExtendedDataRecordEx_EvtInfo_AutoCreatedDemEvent_EepDemEventParameterRefs_E_b2c4b704
        OpEventGetDebouncingOfEvent_GetDebouncingOfEvent_EvtInfo_AutoCreatedDemEvent_NVM_E_INTEGRITY_FAILED: RteEventRef=OpEventGetDebouncingOfEvent_GetDebouncingOfEvent_EvtInfo_AutoCreatedDemEvent_NVM_E_INTEGRITY_FAILED
        OpEventGetEventFailed_GetEventFailed_EvtInfo_AutoCreatedDemEvent_EepDemEventParameterRefs_EEP_E_READ_FAILED: RteEventRef=OpEventGetEventFailed_GetEventFailed_EvtInfo_AutoCreatedDemEvent_EepDemEventParameterRefs_EEP_E_READ_FAILED
        OpEventGetMonitorStatus_GetMonitorStatus_EvtInfo_AutoCreatedDemEvent_NVM_E_QUEUE_OVERFLOW: RteEventRef=OpEventGetMonitorStatus_GetMonitorStatus_EvtInfo_AutoCreatedDemEvent_NVM_E_QUEUE_OVERFLOW
        OpEventGetEventStatus_GetEventStatus_EvtInfo_AutoCreatedDemEvent_ECUM_E_ALL_RUN_REQUESTS_KILLED: RteEventRef=OpEventGetEventStatus_GetEventStatus_EvtInfo_AutoCreatedDemEvent_ECUM_E_ALL_RUN_REQUESTS_KILLED
        OpEventGetEventEnableCondition_GetEventEnableCondition_EvtInfo_AutoCreatedDemEvent_NVM_E_LOSS_OF_REDUNDANCY: RteEventRef=OpEventGetEventEnableCondition_GetEventEnableCondition_EvtInfo_AutoCreatedDemEvent_NVM_E_LOSS_OF_REDUNDANCY
        OpEventGetDebouncingOfEvent_GetDebouncingOfEvent_EvtInfo_AutoCreatedDemEvent_ECUM_E_ALL_RUN_REQUESTS_KILLED: RteEventRef=OpEventGetDebouncingOfEvent_GetDebouncingOfEvent_EvtInfo_AutoCreatedDemEvent_ECUM_E_ALL_RUN_REQUESTS_KILLED
        OpEventGetEventFailed_GetEventFailed_EvtInfo_AutoCreatedDemEvent_NVM_E_QUEUE_OVERFLOW: RteEventRef=OpEventGetEventFailed_GetEventFailed_EvtInfo_AutoCreatedDemEvent_NVM_E_QUEUE_OVERFLOW
        OpEventGetEventUdsStatus_GetEventUdsStatus_EvtInfo_AutoCreatedDemEvent_NVM_E_VERIFY_FAILED: RteEventRef=OpEventGetEventUdsStatus_GetEventUdsStatus_EvtInfo_AutoCreatedDemEvent_NVM_E_VERIFY_FAILED
        OpEventGetEventTested_GetEventTested_EvtInfo_AutoCreatedDemEvent_ECUM_E_ALL_RUN_REQUESTS_KILLED: RteEventRef=OpEventGetEventTested_GetEventTested_EvtInfo_AutoCreatedDemEvent_ECUM_E_ALL_RUN_REQUESTS_KILLED
        OpEventGetDTCOfEvent_GetDTCOfEvent_EvtInfo_AutoCreatedDemEvent_ECUM_E_ALL_RUN_REQUESTS_KILLED: RteEventRef=OpEventGetDTCOfEvent_GetDTCOfEvent_EvtInfo_AutoCreatedDemEvent_ECUM_E_ALL_RUN_REQUESTS_KILLED
        OpEventGetEventFailed_GetEventFailed_EvtInfo_AutoCreatedDemEvent_EepDemEventParameterRefs_EEP_E_WRITE_FAILED: RteEventRef=OpEventGetEventFailed_GetEventFailed_EvtInfo_AutoCreatedDemEvent_EepDemEventParameterRefs_EEP_E_WRITE_FAILED
        OpEventGetDebouncingOfEvent_GetDebouncingOfEvent_EvtInfo_AutoCreatedDemEvent_ECUM_E_RAM_CHECK_FAILED: RteEventRef=OpEventGetDebouncingOfEvent_GetDebouncingOfEvent_EvtInfo_AutoCreatedDemEvent_ECUM_E_RAM_CHECK_FAILED
        OpEventGetDTCOfEvent_GetDTCOfEvent_EvtInfo_AutoCreatedDemEvent_NVM_E_QUEUE_OVERFLOW: RteEventRef=OpEventGetDTCOfEvent_GetDTCOfEvent_EvtInfo_AutoCreatedDemEvent_NVM_E_QUEUE_OVERFLOW
        OpEventGetEventUdsStatus_GetEventUdsStatus_EvtInfo_AutoCreatedDemEvent_EepDemEventParameterRefs_EEP_E_READ_FAILED: RteEventRef=OpEventGetEventUdsStatus_GetEventUdsStatus_EvtInfo_AutoCreatedDemEvent_EepDemEventParameterRefs_EEP_E_READ_FAILED
        OpEventGetEventUdsStatus_GetEventUdsStatus_EvtInfo_AutoCreatedDemEvent_EepDemEventParameterRefs_EEP_E_TEST_COM_FAILED: RteEventRef=OpEventGetEventUdsStatus_GetEventUdsStatus_EvtInfo_AutoCreatedDemEvent_EepDemEventParameterRefs_EEP_E_TEST_COM_FAILED
        OpEventGetFaultDetectionCounter_GetFaultDetectionCounter_EvtInfo_AutoCreatedDemEvent_NVM_E_WRONG_BLOCK_ID: RteEventRef=OpEventGetFaultDetectionCounter_GetFaultDetectionCounter_EvtInfo_AutoCreatedDemEvent_NVM_E_WRONG_BLOCK_ID
        OpEventGetEventFreezeFrameDataEx_GetEventFreezeFrameDataEx_EvtInfo_AutoCreatedDemEvent_NVM_E_INTEGRITY_FAILED: RteEventRef=OpEventGetEventFreezeFrameDataEx_GetEventFreezeFrameDataEx_EvtInfo_AutoCreatedDemEvent_NVM_E_INTEGRITY_FAILED
        OpEventGetEventUdsStatus_GetEventUdsStatus_EvtInfo_AutoCreatedDemEvent_NVM_E_QUEUE_OVERFLOW: RteEventRef=OpEventGetEventUdsStatus_GetEventUdsStatus_EvtInfo_AutoCreatedDemEvent_NVM_E_QUEUE_OVERFLOW
        OpEventGetFaultDetectionCounter_GetFaultDetectionCounter_EvtInfo_AutoCreatedDemEvent_NVM_E_QUEUE_OVERFLOW: RteEventRef=OpEventGetFaultDetectionCounter_GetFaultDetectionCounter_EvtInfo_AutoCreatedDemEvent_NVM_E_QUEUE_OVERFLOW
        OpEventGetEventEnableCondition_GetEventEnableCondition_EvtInfo_AutoCreatedDemEvent_EepDemEventParameterRefs_EEP_E_WRITE_FAILED: RteEventRef=OpEventGetEventEnableCondition_GetEventEnableCondition_EvtInfo_AutoCreatedDemEvent_EepDemEventParameterRefs_EEP_E_WRITE_FAILED
        OpEventGetEventStatus_GetEventStatus_EvtInfo_AutoCreatedDemEvent_NVM_E_QUEUE_OVERFLOW: RteEventRef=OpEventGetEventStatus_GetEventStatus_EvtInfo_AutoCreatedDemEvent_NVM_E_QUEUE_OVERFLOW
        OpEventGetDebouncingOfEvent_GetDebouncingOfEvent_EvtInfo_AutoCreatedDemEvent_ECUM_E_IMPROPER_CALLER: RteEventRef=OpEventGetDebouncingOfEvent_GetDebouncingOfEvent_EvtInfo_AutoCreatedDemEvent_ECUM_E_IMPROPER_CALLER
        OpEventGetEventStatus_GetEventStatus_EvtInfo_AutoCreatedDemEvent_EepDemEventParameterRefs_EEP_E_SET_LOCK_LEVEL_FAILED: RteEventRef=OpEventGetEventStatus_GetEventStatus_EvtInfo_AutoCreatedDemEvent_EepDemEventParameterRefs_EEP_E_SET_LOCK_LEVEL_FAILED
        OpEventGetDTCOfEvent_GetDTCOfEvent_EvtInfo_AutoCreatedDemEvent_ECUM_E_IMPROPER_CALLER: RteEventRef=OpEventGetDTCOfEvent_GetDTCOfEvent_EvtInfo_AutoCreatedDemEvent_ECUM_E_IMPROPER_CALLER
        OpEventGetMonitorStatus_GetMonitorStatus_EvtInfo_AutoCreatedDemEvent_NVM_E_REQ_FAILED: RteEventRef=OpEventGetMonitorStatus_GetMonitorStatus_EvtInfo_AutoCreatedDemEvent_NVM_E_REQ_FAILED
        OpEventGetDTCOfEvent_GetDTCOfEvent_EvtInfo_AutoCreatedDemEvent_EepDemEventParameterRefs_EEP_E_SET_LOCK_LEVEL_FAILED: RteEventRef=OpEventGetDTCOfEvent_GetDTCOfEvent_EvtInfo_AutoCreatedDemEvent_EepDemEventParameterRefs_EEP_E_SET_LOCK_LEVEL_FAILED
        OpEventGetDTCOfEvent_GetDTCOfEvent_EvtInfo_AutoCreatedDemEvent_NVM_E_REQ_FAILED: RteEventRef=OpEventGetDTCOfEvent_GetDTCOfEvent_EvtInfo_AutoCreatedDemEvent_NVM_E_REQ_FAILED
        OpEventGetEventEnableCondition_GetEventEnableCondition_EvtInfo_AutoCreatedDemEvent_EepDemEventParameterRefs_EEP_E_READ_FAILED: RteEventRef=OpEventGetEventEnableCondition_GetEventEnableCondition_EvtInfo_AutoCreatedDemEvent_EepDemEventParameterRefs_EEP_E_READ_FAILED
        OpEventGetFaultDetectionCounter_GetFaultDetectionCounter_EvtInfo_AutoCreatedDemEvent_EepDemEventParameterRefs_EEP_E_READ_FAILED: RteEventRef=OpEventGetFaultDetectionCounter_GetFaultDetectionCounter_EvtInfo_AutoCreatedDemEvent_EepDemEventParameterRefs_EEP_E_READ_FAILED
        OpEventGetEventFreezeFrameDataEx_GetEventFreezeFrameDataEx_EvtInfo_AutoCreatedDemEvent_EepDemEventParameterRefs_EEP_E_T_092580cc: RteEventRef=OpEventGetEventFreezeFrameDataEx_GetEventFreezeFrameDataEx_EvtInfo_AutoCreatedDemEvent_EepDemEventParameterRefs_EEP_E_T_092580cc
        OpEventGetEventStatus_GetEventStatus_EvtInfo_AutoCreatedDemEvent_EepDemEventParameterRefs_EEP_E_WRITE_FAILED: RteEventRef=OpEventGetEventStatus_GetEventStatus_EvtInfo_AutoCreatedDemEvent_EepDemEventParameterRefs_EEP_E_WRITE_FAILED
        OpEventGetEventExtendedDataRecordEx_GetEventExtendedDataRecordEx_EvtInfo_AutoCreatedDemEvent_PortDemEventParameterRefs_c101940b: RteEventRef=OpEventGetEventExtendedDataRecordEx_GetEventExtendedDataRecordEx_EvtInfo_AutoCreatedDemEvent_PortDemEventParameterRefs_c101940b
        OpEventGetFaultDetectionCounter_GetFaultDetectionCounter_EvtInfo_AutoCreatedDemEvent_PortDemEventParameterRefs_PORT_E_R_cc5c2304: RteEventRef=OpEventGetFaultDetectionCounter_GetFaultDetectionCounter_EvtInfo_AutoCreatedDemEvent_PortDemEventParameterRefs_PORT_E_R_cc5c2304
        OpEventGetDTCOfEvent_GetDTCOfEvent_EvtInfo_AutoCreatedDemEvent_PortDemEventParameterRefs_PORT_E_REG_WRITE_VERIFY: RteEventRef=OpEventGetDTCOfEvent_GetDTCOfEvent_EvtInfo_AutoCreatedDemEvent_PortDemEventParameterRefs_PORT_E_REG_WRITE_VERIFY
        OpEventGetEventUdsStatus_GetEventUdsStatus_EvtInfo_AutoCreatedDemEvent_PortDemEventParameterRefs_PORT_E_WRITE_TIMEOUT_FAILURE: RteEventRef=OpEventGetEventUdsStatus_GetEventUdsStatus_EvtInfo_AutoCreatedDemEvent_PortDemEventParameterRefs_PORT_E_WRITE_TIMEOUT_FAILURE
        OpEventGetEventFailed_GetEventFailed_EvtInfo_AutoCreatedDemEvent_PortDemEventParameterRefs_PORT_E_WRITE_TIMEOUT_FAILURE: RteEventRef=OpEventGetEventFailed_GetEventFailed_EvtInfo_AutoCreatedDemEvent_PortDemEventParameterRefs_PORT_E_WRITE_TIMEOUT_FAILURE
        OpEventGetEventEnableCondition_GetEventEnableCondition_EvtInfo_AutoCreatedDemEvent_PortDemEventParameterRefs_PORT_E_WRI_841bbc06: RteEventRef=OpEventGetEventEnableCondition_GetEventEnableCondition_EvtInfo_AutoCreatedDemEvent_PortDemEventParameterRefs_PORT_E_WRI_841bbc06
        OpEventGetDebouncingOfEvent_GetDebouncingOfEvent_EvtInfo_AutoCreatedDemEvent_PortDemEventParameterRefs_PORT_E_WRITE_TIM_1e677069: RteEventRef=OpEventGetDebouncingOfEvent_GetDebouncingOfEvent_EvtInfo_AutoCreatedDemEvent_PortDemEventParameterRefs_PORT_E_WRITE_TIM_1e677069
        OpEventGetEventStatus_GetEventStatus_EvtInfo_AutoCreatedDemEvent_PortDemEventParameterRefs_PORT_E_REG_WRITE_VERIFY: RteEventRef=OpEventGetEventStatus_GetEventStatus_EvtInfo_AutoCreatedDemEvent_PortDemEventParameterRefs_PORT_E_REG_WRITE_VERIFY
        OpEventGetEventUdsStatus_GetEventUdsStatus_EvtInfo_AutoCreatedDemEvent_PortDemEventParameterRefs_PORT_E_REG_WRITE_VERIFY: RteEventRef=OpEventGetEventUdsStatus_GetEventUdsStatus_EvtInfo_AutoCreatedDemEvent_PortDemEventParameterRefs_PORT_E_REG_WRITE_VERIFY
        OpEventGetEventTested_GetEventTested_EvtInfo_AutoCreatedDemEvent_PortDemEventParameterRefs_PORT_E_REG_WRITE_VERIFY: RteEventRef=OpEventGetEventTested_GetEventTested_EvtInfo_AutoCreatedDemEvent_PortDemEventParameterRefs_PORT_E_REG_WRITE_VERIFY
        OpEventGetMonitorStatus_GetMonitorStatus_EvtInfo_AutoCreatedDemEvent_PortDemEventParameterRefs_PORT_E_WRITE_TIMEOUT_FAILURE: RteEventRef=OpEventGetMonitorStatus_GetMonitorStatus_EvtInfo_AutoCreatedDemEvent_PortDemEventParameterRefs_PORT_E_WRITE_TIMEOUT_FAILURE
        OpEventGetEventFailed_GetEventFailed_EvtInfo_AutoCreatedDemEvent_PortDemEventParameterRefs_PORT_E_REG_WRITE_VERIFY: RteEventRef=OpEventGetEventFailed_GetEventFailed_EvtInfo_AutoCreatedDemEvent_PortDemEventParameterRefs_PORT_E_REG_WRITE_VERIFY
        OpEventGetEventStatus_GetEventStatus_EvtInfo_AutoCreatedDemEvent_PortDemEventParameterRefs_PORT_E_WRITE_TIMEOUT_FAILURE: RteEventRef=OpEventGetEventStatus_GetEventStatus_EvtInfo_AutoCreatedDemEvent_PortDemEventParameterRefs_PORT_E_WRITE_TIMEOUT_FAILURE
        OpEventGetFaultDetectionCounter_GetFaultDetectionCounter_EvtInfo_AutoCreatedDemEvent_PortDemEventParameterRefs_PORT_E_W_cddbccce: RteEventRef=OpEventGetFaultDetectionCounter_GetFaultDetectionCounter_EvtInfo_AutoCreatedDemEvent_PortDemEventParameterRefs_PORT_E_W_cddbccce
        OpEventGetEventExtendedDataRecordEx_GetEventExtendedDataRecordEx_EvtInfo_AutoCreatedDemEvent_PortDemEventParameterRefs_1ee4ee92: RteEventRef=OpEventGetEventExtendedDataRecordEx_GetEventExtendedDataRecordEx_EvtInfo_AutoCreatedDemEvent_PortDemEventParameterRefs_1ee4ee92
        OpEventGetMonitorStatus_GetMonitorStatus_EvtInfo_AutoCreatedDemEvent_PortDemEventParameterRefs_PORT_E_REG_WRITE_VERIFY: RteEventRef=OpEventGetMonitorStatus_GetMonitorStatus_EvtInfo_AutoCreatedDemEvent_PortDemEventParameterRefs_PORT_E_REG_WRITE_VERIFY
        OpEventGetEventFreezeFrameDataEx_GetEventFreezeFrameDataEx_EvtInfo_AutoCreatedDemEvent_PortDemEventParameterRefs_PORT_E_25a2440e: RteEventRef=OpEventGetEventFreezeFrameDataEx_GetEventFreezeFrameDataEx_EvtInfo_AutoCreatedDemEvent_PortDemEventParameterRefs_PORT_E_25a2440e
        OpEventGetEventFreezeFrameDataEx_GetEventFreezeFrameDataEx_EvtInfo_AutoCreatedDemEvent_PortDemEventParameterRefs_PORT_E_0595218f: RteEventRef=OpEventGetEventFreezeFrameDataEx_GetEventFreezeFrameDataEx_EvtInfo_AutoCreatedDemEvent_PortDemEventParameterRefs_PORT_E_0595218f
        OpEventGetDTCOfEvent_GetDTCOfEvent_EvtInfo_AutoCreatedDemEvent_PortDemEventParameterRefs_PORT_E_WRITE_TIMEOUT_FAILURE: RteEventRef=OpEventGetDTCOfEvent_GetDTCOfEvent_EvtInfo_AutoCreatedDemEvent_PortDemEventParameterRefs_PORT_E_WRITE_TIMEOUT_FAILURE
        OpEventGetEventTested_GetEventTested_EvtInfo_AutoCreatedDemEvent_PortDemEventParameterRefs_PORT_E_WRITE_TIMEOUT_FAILURE: RteEventRef=OpEventGetEventTested_GetEventTested_EvtInfo_AutoCreatedDemEvent_PortDemEventParameterRefs_PORT_E_WRITE_TIMEOUT_FAILURE
        OpEventGetDebouncingOfEvent_GetDebouncingOfEvent_EvtInfo_AutoCreatedDemEvent_PortDemEventParameterRefs_PORT_E_REG_WRITE_VERIFY: RteEventRef=OpEventGetDebouncingOfEvent_GetDebouncingOfEvent_EvtInfo_AutoCreatedDemEvent_PortDemEventParameterRefs_PORT_E_REG_WRITE_VERIFY
        OpEventGetEventEnableCondition_GetEventEnableCondition_EvtInfo_AutoCreatedDemEvent_PortDemEventParameterRefs_PORT_E_REG_3d8fc3bd: RteEventRef=OpEventGetEventEnableCondition_GetEventEnableCondition_EvtInfo_AutoCreatedDemEvent_PortDemEventParameterRefs_PORT_E_REG_3d8fc3bd
        OpEventGetEventExtendedDataRecordEx_GetEventExtendedDataRecordEx_EvtInfo_AutoCreatedDemEvent_SpiDemEventParameterRefs_S_ee87fc1c: RteEventRef=OpEventGetEventExtendedDataRecordEx_GetEventExtendedDataRecordEx_EvtInfo_AutoCreatedDemEvent_SpiDemEventParameterRefs_S_ee87fc1c
        OpEventGetEventTested_GetEventTested_EvtInfo_AutoCreatedDemEvent_SpiDemEventParameterRefs_SPI_E_REG_WRITE_VERIFY: RteEventRef=OpEventGetEventTested_GetEventTested_EvtInfo_AutoCreatedDemEvent_SpiDemEventParameterRefs_SPI_E_REG_WRITE_VERIFY
        OpEventGetDTCOfEvent_GetDTCOfEvent_EvtInfo_AutoCreatedDemEvent_SpiDemEventParameterRefs_SPI_E_ECC_SELFTEST_FAILURE: RteEventRef=OpEventGetDTCOfEvent_GetDTCOfEvent_EvtInfo_AutoCreatedDemEvent_SpiDemEventParameterRefs_SPI_E_ECC_SELFTEST_FAILURE
        OpEventGetEventTested_GetEventTested_EvtInfo_AutoCreatedDemEvent_SpiDemEventParameterRefs_SPI_E_ECC_SELFTEST_FAILURE: RteEventRef=OpEventGetEventTested_GetEventTested_EvtInfo_AutoCreatedDemEvent_SpiDemEventParameterRefs_SPI_E_ECC_SELFTEST_FAILURE
        OpEventGetEventFreezeFrameDataEx_GetEventFreezeFrameDataEx_EvtInfo_AutoCreatedDemEvent_SpiDemEventParameterRefs_SPI_E_D_75cb79a6: RteEventRef=OpEventGetEventFreezeFrameDataEx_GetEventFreezeFrameDataEx_EvtInfo_AutoCreatedDemEvent_SpiDemEventParameterRefs_SPI_E_D_75cb79a6
        OpEventGetEventStatus_GetEventStatus_EvtInfo_AutoCreatedDemEvent_SpiDemEventParameterRefs_SPI_E_DATA_TX_TIMEOUT_FAILURE: RteEventRef=OpEventGetEventStatus_GetEventStatus_EvtInfo_AutoCreatedDemEvent_SpiDemEventParameterRefs_SPI_E_DATA_TX_TIMEOUT_FAILURE
        OpEventGetDTCOfEvent_GetDTCOfEvent_EvtInfo_AutoCreatedDemEvent_SpiDriver_SPI_E_HARDWARE_ERROR: RteEventRef=OpEventGetDTCOfEvent_GetDTCOfEvent_EvtInfo_AutoCreatedDemEvent_SpiDriver_SPI_E_HARDWARE_ERROR
        OpEventGetDebouncingOfEvent_GetDebouncingOfEvent_EvtInfo_AutoCreatedDemEvent_SpiDriver_SPI_E_HARDWARE_ERROR: RteEventRef=OpEventGetDebouncingOfEvent_GetDebouncingOfEvent_EvtInfo_AutoCreatedDemEvent_SpiDriver_SPI_E_HARDWARE_ERROR
        OpEventGetMonitorStatus_GetMonitorStatus_EvtInfo_AutoCreatedDemEvent_SpiDemEventParameterRefs_SPI_E_LOOPBACK_SELFTEST_FAILURE: RteEventRef=OpEventGetMonitorStatus_GetMonitorStatus_EvtInfo_AutoCreatedDemEvent_SpiDemEventParameterRefs_SPI_E_LOOPBACK_SELFTEST_FAILURE
        OpEventGetEventTested_GetEventTested_EvtInfo_AutoCreatedDemEvent_SpiDriver_SPI_E_HARDWARE_ERROR: RteEventRef=OpEventGetEventTested_GetEventTested_EvtInfo_AutoCreatedDemEvent_SpiDriver_SPI_E_HARDWARE_ERROR
        OpEventGetEventFailed_GetEventFailed_EvtInfo_AutoCreatedDemEvent_SpiDemEventParameterRefs_SPI_E_DATA_TX_TIMEOUT_FAILURE: RteEventRef=OpEventGetEventFailed_GetEventFailed_EvtInfo_AutoCreatedDemEvent_SpiDemEventParameterRefs_SPI_E_DATA_TX_TIMEOUT_FAILURE
        OpEventGetMonitorStatus_GetMonitorStatus_EvtInfo_AutoCreatedDemEvent_SpiDemEventParameterRefs_SPI_E_DATA_TX_TIMEOUT_FAILURE: RteEventRef=OpEventGetMonitorStatus_GetMonitorStatus_EvtInfo_AutoCreatedDemEvent_SpiDemEventParameterRefs_SPI_E_DATA_TX_TIMEOUT_FAILURE
        OpEventGetEventUdsStatus_GetEventUdsStatus_EvtInfo_AutoCreatedDemEvent_SpiDemEventParameterRefs_SPI_E_HARDWARE_ERROR: RteEventRef=OpEventGetEventUdsStatus_GetEventUdsStatus_EvtInfo_AutoCreatedDemEvent_SpiDemEventParameterRefs_SPI_E_HARDWARE_ERROR
        OpEventGetEventStatus_GetEventStatus_EvtInfo_AutoCreatedDemEvent_SpiDemEventParameterRefs_SPI_E_REG_WRITE_VERIFY: RteEventRef=OpEventGetEventStatus_GetEventStatus_EvtInfo_AutoCreatedDemEvent_SpiDemEventParameterRefs_SPI_E_REG_WRITE_VERIFY
        OpEventGetEventStatus_GetEventStatus_EvtInfo_AutoCreatedDemEvent_SpiDriver_SPI_E_HARDWARE_ERROR: RteEventRef=OpEventGetEventStatus_GetEventStatus_EvtInfo_AutoCreatedDemEvent_SpiDriver_SPI_E_HARDWARE_ERROR
        OpEventGetEventFreezeFrameDataEx_GetEventFreezeFrameDataEx_EvtInfo_AutoCreatedDemEvent_SpiDemEventParameterRefs_SPI_E_R_76536f24: RteEventRef=OpEventGetEventFreezeFrameDataEx_GetEventFreezeFrameDataEx_EvtInfo_AutoCreatedDemEvent_SpiDemEventParameterRefs_SPI_E_R_76536f24
        OpEventGetEventFailed_GetEventFailed_EvtInfo_AutoCreatedDemEvent_SpiDemEventParameterRefs_SPI_E_HARDWARE_ERROR: RteEventRef=OpEventGetEventFailed_GetEventFailed_EvtInfo_AutoCreatedDemEvent_SpiDemEventParameterRefs_SPI_E_HARDWARE_ERROR
        OpEventGetMonitorStatus_GetMonitorStatus_EvtInfo_AutoCreatedDemEvent_SpiDemEventParameterRefs_SPI_E_HARDWARE_ERROR: RteEventRef=OpEventGetMonitorStatus_GetMonitorStatus_EvtInfo_AutoCreatedDemEvent_SpiDemEventParameterRefs_SPI_E_HARDWARE_ERROR
        OpEventGetEventUdsStatus_GetEventUdsStatus_EvtInfo_AutoCreatedDemEvent_SpiDemEventParameterRefs_SPI_E_ECC_SELFTEST_FAILURE: RteEventRef=OpEventGetEventUdsStatus_GetEventUdsStatus_EvtInfo_AutoCreatedDemEvent_SpiDemEventParameterRefs_SPI_E_ECC_SELFTEST_FAILURE
        OpEventGetEventFailed_GetEventFailed_EvtInfo_AutoCreatedDemEvent_SpiDriver_SPI_E_HARDWARE_ERROR: RteEventRef=OpEventGetEventFailed_GetEventFailed_EvtInfo_AutoCreatedDemEvent_SpiDriver_SPI_E_HARDWARE_ERROR
        OpEventGetEventFreezeFrameDataEx_GetEventFreezeFrameDataEx_EvtInfo_AutoCreatedDemEvent_SpiDemEventParameterRefs_SPI_E_H_5db33cc8: RteEventRef=OpEventGetEventFreezeFrameDataEx_GetEventFreezeFrameDataEx_EvtInfo_AutoCreatedDemEvent_SpiDemEventParameterRefs_SPI_E_H_5db33cc8
        OpEventGetDTCOfEvent_GetDTCOfEvent_EvtInfo_AutoCreatedDemEvent_SpiDemEventParameterRefs_SPI_E_HARDWARE_ERROR: RteEventRef=OpEventGetDTCOfEvent_GetDTCOfEvent_EvtInfo_AutoCreatedDemEvent_SpiDemEventParameterRefs_SPI_E_HARDWARE_ERROR
        OpEventGetDebouncingOfEvent_GetDebouncingOfEvent_EvtInfo_AutoCreatedDemEvent_SpiDemEventParameterRefs_SPI_E_DATA_TX_TIM_4e0e4dc1: RteEventRef=OpEventGetDebouncingOfEvent_GetDebouncingOfEvent_EvtInfo_AutoCreatedDemEvent_SpiDemEventParameterRefs_SPI_E_DATA_TX_TIM_4e0e4dc1
        OpEventGetFaultDetectionCounter_GetFaultDetectionCounter_EvtInfo_AutoCreatedDemEvent_SpiDemEventParameterRefs_SPI_E_DAT_9db2f166: RteEventRef=OpEventGetFaultDetectionCounter_GetFaultDetectionCounter_EvtInfo_AutoCreatedDemEvent_SpiDemEventParameterRefs_SPI_E_DAT_9db2f166
        OpEventGetEventTested_GetEventTested_EvtInfo_AutoCreatedDemEvent_SpiDemEventParameterRefs_SPI_E_DATA_TX_TIMEOUT_FAILURE: RteEventRef=OpEventGetEventTested_GetEventTested_EvtInfo_AutoCreatedDemEvent_SpiDemEventParameterRefs_SPI_E_DATA_TX_TIMEOUT_FAILURE
        OpEventGetFaultDetectionCounter_GetFaultDetectionCounter_EvtInfo_AutoCreatedDemEvent_SpiDemEventParameterRefs_SPI_E_REG_ee65a29c: RteEventRef=OpEventGetFaultDetectionCounter_GetFaultDetectionCounter_EvtInfo_AutoCreatedDemEvent_SpiDemEventParameterRefs_SPI_E_REG_ee65a29c
        OpEventGetEventExtendedDataRecordEx_GetEventExtendedDataRecordEx_EvtInfo_AutoCreatedDemEvent_SpiDriver_SPI_E_HARDWARE_ERROR: RteEventRef=OpEventGetEventExtendedDataRecordEx_GetEventExtendedDataRecordEx_EvtInfo_AutoCreatedDemEvent_SpiDriver_SPI_E_HARDWARE_ERROR
        OpEventGetEventEnableCondition_GetEventEnableCondition_EvtInfo_AutoCreatedDemEvent_SpiDemEventParameterRefs_SPI_E_REG_W_815a6a98: RteEventRef=OpEventGetEventEnableCondition_GetEventEnableCondition_EvtInfo_AutoCreatedDemEvent_SpiDemEventParameterRefs_SPI_E_REG_W_815a6a98
        OpEventGetEventExtendedDataRecordEx_GetEventExtendedDataRecordEx_EvtInfo_AutoCreatedDemEvent_SpiDemEventParameterRefs_S_86abc173: RteEventRef=OpEventGetEventExtendedDataRecordEx_GetEventExtendedDataRecordEx_EvtInfo_AutoCreatedDemEvent_SpiDemEventParameterRefs_S_86abc173
        OpEventGetEventTested_GetEventTested_EvtInfo_AutoCreatedDemEvent_SpiDemEventParameterRefs_SPI_E_LOOPBACK_SELFTEST_FAILURE: RteEventRef=OpEventGetEventTested_GetEventTested_EvtInfo_AutoCreatedDemEvent_SpiDemEventParameterRefs_SPI_E_LOOPBACK_SELFTEST_FAILURE
        OpEventGetEventExtendedDataRecordEx_GetEventExtendedDataRecordEx_EvtInfo_AutoCreatedDemEvent_SpiDemEventParameterRefs_S_c108a575: RteEventRef=OpEventGetEventExtendedDataRecordEx_GetEventExtendedDataRecordEx_EvtInfo_AutoCreatedDemEvent_SpiDemEventParameterRefs_S_c108a575
        OpEventGetFaultDetectionCounter_GetFaultDetectionCounter_EvtInfo_AutoCreatedDemEvent_SpiDemEventParameterRefs_SPI_E_ECC_3c1acba1: RteEventRef=OpEventGetFaultDetectionCounter_GetFaultDetectionCounter_EvtInfo_AutoCreatedDemEvent_SpiDemEventParameterRefs_SPI_E_ECC_3c1acba1
        OpEventGetDebouncingOfEvent_GetDebouncingOfEvent_EvtInfo_AutoCreatedDemEvent_SpiDemEventParameterRefs_SPI_E_ECC_SELFTEST_FAILURE: RteEventRef=OpEventGetDebouncingOfEvent_GetDebouncingOfEvent_EvtInfo_AutoCreatedDemEvent_SpiDemEventParameterRefs_SPI_E_ECC_SELFTEST_FAILURE
        OpEventGetEventEnableCondition_GetEventEnableCondition_EvtInfo_AutoCreatedDemEvent_SpiDriver_SPI_E_HARDWARE_ERROR: RteEventRef=OpEventGetEventEnableCondition_GetEventEnableCondition_EvtInfo_AutoCreatedDemEvent_SpiDriver_SPI_E_HARDWARE_ERROR
        OpEventGetEventTested_GetEventTested_EvtInfo_AutoCreatedDemEvent_SpiDemEventParameterRefs_SPI_E_HARDWARE_ERROR: RteEventRef=OpEventGetEventTested_GetEventTested_EvtInfo_AutoCreatedDemEvent_SpiDemEventParameterRefs_SPI_E_HARDWARE_ERROR
        OpEventGetDebouncingOfEvent_GetDebouncingOfEvent_EvtInfo_AutoCreatedDemEvent_SpiDemEventParameterRefs_SPI_E_LOOPBACK_SE_21f723c3: RteEventRef=OpEventGetDebouncingOfEvent_GetDebouncingOfEvent_EvtInfo_AutoCreatedDemEvent_SpiDemEventParameterRefs_SPI_E_LOOPBACK_SE_21f723c3
        OpEventGetMonitorStatus_GetMonitorStatus_EvtInfo_AutoCreatedDemEvent_SpiDemEventParameterRefs_SPI_E_ECC_SELFTEST_FAILURE: RteEventRef=OpEventGetMonitorStatus_GetMonitorStatus_EvtInfo_AutoCreatedDemEvent_SpiDemEventParameterRefs_SPI_E_ECC_SELFTEST_FAILURE
        OpEventGetEventFailed_GetEventFailed_EvtInfo_AutoCreatedDemEvent_SpiDemEventParameterRefs_SPI_E_LOOPBACK_SELFTEST_FAILURE: RteEventRef=OpEventGetEventFailed_GetEventFailed_EvtInfo_AutoCreatedDemEvent_SpiDemEventParameterRefs_SPI_E_LOOPBACK_SELFTEST_FAILURE
        OpEventGetEventFreezeFrameDataEx_GetEventFreezeFrameDataEx_EvtInfo_AutoCreatedDemEvent_SpiDemEventParameterRefs_SPI_E_L_2aff11d3: RteEventRef=OpEventGetEventFreezeFrameDataEx_GetEventFreezeFrameDataEx_EvtInfo_AutoCreatedDemEvent_SpiDemEventParameterRefs_SPI_E_L_2aff11d3
        OpEventGetEventExtendedDataRecordEx_GetEventExtendedDataRecordEx_EvtInfo_AutoCreatedDemEvent_SpiDemEventParameterRefs_S_4e8dd33a: RteEventRef=OpEventGetEventExtendedDataRecordEx_GetEventExtendedDataRecordEx_EvtInfo_AutoCreatedDemEvent_SpiDemEventParameterRefs_S_4e8dd33a
        OpEventGetEventStatus_GetEventStatus_EvtInfo_AutoCreatedDemEvent_SpiDemEventParameterRefs_SPI_E_HARDWARE_ERROR: RteEventRef=OpEventGetEventStatus_GetEventStatus_EvtInfo_AutoCreatedDemEvent_SpiDemEventParameterRefs_SPI_E_HARDWARE_ERROR
        OpEventGetEventEnableCondition_GetEventEnableCondition_EvtInfo_AutoCreatedDemEvent_SpiDemEventParameterRefs_SPI_E_DATA_d47281ae: RteEventRef=OpEventGetEventEnableCondition_GetEventEnableCondition_EvtInfo_AutoCreatedDemEvent_SpiDemEventParameterRefs_SPI_E_DATA_d47281ae
        OpEventGetDebouncingOfEvent_GetDebouncingOfEvent_EvtInfo_AutoCreatedDemEvent_SpiDemEventParameterRefs_SPI_E_REG_WRITE_VERIFY: RteEventRef=OpEventGetDebouncingOfEvent_GetDebouncingOfEvent_EvtInfo_AutoCreatedDemEvent_SpiDemEventParameterRefs_SPI_E_REG_WRITE_VERIFY
        OpEventGetEventEnableCondition_GetEventEnableCondition_EvtInfo_AutoCreatedDemEvent_SpiDemEventParameterRefs_SPI_E_ECC_S_a917cdfb: RteEventRef=OpEventGetEventEnableCondition_GetEventEnableCondition_EvtInfo_AutoCreatedDemEvent_SpiDemEventParameterRefs_SPI_E_ECC_S_a917cdfb
        OpEventGetDTCOfEvent_GetDTCOfEvent_EvtInfo_AutoCreatedDemEvent_SpiDemEventParameterRefs_SPI_E_DATA_TX_TIMEOUT_FAILURE: RteEventRef=OpEventGetDTCOfEvent_GetDTCOfEvent_EvtInfo_AutoCreatedDemEvent_SpiDemEventParameterRefs_SPI_E_DATA_TX_TIMEOUT_FAILURE
        OpEventGetMonitorStatus_GetMonitorStatus_EvtInfo_AutoCreatedDemEvent_SpiDriver_SPI_E_HARDWARE_ERROR: RteEventRef=OpEventGetMonitorStatus_GetMonitorStatus_EvtInfo_AutoCreatedDemEvent_SpiDriver_SPI_E_HARDWARE_ERROR
        OpEventGetMonitorStatus_GetMonitorStatus_EvtInfo_AutoCreatedDemEvent_SpiDemEventParameterRefs_SPI_E_REG_WRITE_VERIFY: RteEventRef=OpEventGetMonitorStatus_GetMonitorStatus_EvtInfo_AutoCreatedDemEvent_SpiDemEventParameterRefs_SPI_E_REG_WRITE_VERIFY
        OpEventGetEventExtendedDataRecordEx_GetEventExtendedDataRecordEx_EvtInfo_AutoCreatedDemEvent_SpiDemEventParameterRefs_S_02f7f15c: RteEventRef=OpEventGetEventExtendedDataRecordEx_GetEventExtendedDataRecordEx_EvtInfo_AutoCreatedDemEvent_SpiDemEventParameterRefs_S_02f7f15c
        OpEventGetFaultDetectionCounter_GetFaultDetectionCounter_EvtInfo_AutoCreatedDemEvent_SpiDemEventParameterRefs_SPI_E_HAR_be787544: RteEventRef=OpEventGetFaultDetectionCounter_GetFaultDetectionCounter_EvtInfo_AutoCreatedDemEvent_SpiDemEventParameterRefs_SPI_E_HAR_be787544
        OpEventGetFaultDetectionCounter_GetFaultDetectionCounter_EvtInfo_AutoCreatedDemEvent_SpiDemEventParameterRefs_SPI_E_LOO_026625f6: RteEventRef=OpEventGetFaultDetectionCounter_GetFaultDetectionCounter_EvtInfo_AutoCreatedDemEvent_SpiDemEventParameterRefs_SPI_E_LOO_026625f6
        OpEventGetEventStatus_GetEventStatus_EvtInfo_AutoCreatedDemEvent_SpiDemEventParameterRefs_SPI_E_ECC_SELFTEST_FAILURE: RteEventRef=OpEventGetEventStatus_GetEventStatus_EvtInfo_AutoCreatedDemEvent_SpiDemEventParameterRefs_SPI_E_ECC_SELFTEST_FAILURE
        OpEventGetEventUdsStatus_GetEventUdsStatus_EvtInfo_AutoCreatedDemEvent_SpiDemEventParameterRefs_SPI_E_REG_WRITE_VERIFY: RteEventRef=OpEventGetEventUdsStatus_GetEventUdsStatus_EvtInfo_AutoCreatedDemEvent_SpiDemEventParameterRefs_SPI_E_REG_WRITE_VERIFY
        OpEventGetEventFailed_GetEventFailed_EvtInfo_AutoCreatedDemEvent_SpiDemEventParameterRefs_SPI_E_ECC_SELFTEST_FAILURE: RteEventRef=OpEventGetEventFailed_GetEventFailed_EvtInfo_AutoCreatedDemEvent_SpiDemEventParameterRefs_SPI_E_ECC_SELFTEST_FAILURE
        OpEventGetDTCOfEvent_GetDTCOfEvent_EvtInfo_AutoCreatedDemEvent_SpiDemEventParameterRefs_SPI_E_REG_WRITE_VERIFY: RteEventRef=OpEventGetDTCOfEvent_GetDTCOfEvent_EvtInfo_AutoCreatedDemEvent_SpiDemEventParameterRefs_SPI_E_REG_WRITE_VERIFY
        OpEventGetDTCOfEvent_GetDTCOfEvent_EvtInfo_AutoCreatedDemEvent_SpiDemEventParameterRefs_SPI_E_LOOPBACK_SELFTEST_FAILURE: RteEventRef=OpEventGetDTCOfEvent_GetDTCOfEvent_EvtInfo_AutoCreatedDemEvent_SpiDemEventParameterRefs_SPI_E_LOOPBACK_SELFTEST_FAILURE
        OpEventGetEventFailed_GetEventFailed_EvtInfo_AutoCreatedDemEvent_SpiDemEventParameterRefs_SPI_E_REG_WRITE_VERIFY: RteEventRef=OpEventGetEventFailed_GetEventFailed_EvtInfo_AutoCreatedDemEvent_SpiDemEventParameterRefs_SPI_E_REG_WRITE_VERIFY
        OpEventGetEventUdsStatus_GetEventUdsStatus_EvtInfo_AutoCreatedDemEvent_SpiDemEventParameterRefs_SPI_E_LOOPBACK_SELFTEST_FAILURE: RteEventRef=OpEventGetEventUdsStatus_GetEventUdsStatus_EvtInfo_AutoCreatedDemEvent_SpiDemEventParameterRefs_SPI_E_LOOPBACK_SELFTEST_FAILURE
        OpEventGetEventEnableCondition_GetEventEnableCondition_EvtInfo_AutoCreatedDemEvent_SpiDemEventParameterRefs_SPI_E_LOOPB_5140404c: RteEventRef=OpEventGetEventEnableCondition_GetEventEnableCondition_EvtInfo_AutoCreatedDemEvent_SpiDemEventParameterRefs_SPI_E_LOOPB_5140404c
        OpEventGetEventFreezeFrameDataEx_GetEventFreezeFrameDataEx_EvtInfo_AutoCreatedDemEvent_SpiDemEventParameterRefs_SPI_E_E_0a6322c4: RteEventRef=OpEventGetEventFreezeFrameDataEx_GetEventFreezeFrameDataEx_EvtInfo_AutoCreatedDemEvent_SpiDemEventParameterRefs_SPI_E_E_0a6322c4
        OpEventGetEventUdsStatus_GetEventUdsStatus_EvtInfo_AutoCreatedDemEvent_SpiDriver_SPI_E_HARDWARE_ERROR: RteEventRef=OpEventGetEventUdsStatus_GetEventUdsStatus_EvtInfo_AutoCreatedDemEvent_SpiDriver_SPI_E_HARDWARE_ERROR
        OpEventGetDebouncingOfEvent_GetDebouncingOfEvent_EvtInfo_AutoCreatedDemEvent_SpiDemEventParameterRefs_SPI_E_HARDWARE_ERROR: RteEventRef=OpEventGetDebouncingOfEvent_GetDebouncingOfEvent_EvtInfo_AutoCreatedDemEvent_SpiDemEventParameterRefs_SPI_E_HARDWARE_ERROR
        OpEventGetEventFreezeFrameDataEx_GetEventFreezeFrameDataEx_EvtInfo_AutoCreatedDemEvent_SpiDriver_SPI_E_HARDWARE_ERROR: RteEventRef=OpEventGetEventFreezeFrameDataEx_GetEventFreezeFrameDataEx_EvtInfo_AutoCreatedDemEvent_SpiDriver_SPI_E_HARDWARE_ERROR
        OpEventGetEventUdsStatus_GetEventUdsStatus_EvtInfo_AutoCreatedDemEvent_SpiDemEventParameterRefs_SPI_E_DATA_TX_TIMEOUT_FAILURE: RteEventRef=OpEventGetEventUdsStatus_GetEventUdsStatus_EvtInfo_AutoCreatedDemEvent_SpiDemEventParameterRefs_SPI_E_DATA_TX_TIMEOUT_FAILURE
        OpEventGetFaultDetectionCounter_GetFaultDetectionCounter_EvtInfo_AutoCreatedDemEvent_SpiDriver_SPI_E_HARDWARE_ERROR: RteEventRef=OpEventGetFaultDetectionCounter_GetFaultDetectionCounter_EvtInfo_AutoCreatedDemEvent_SpiDriver_SPI_E_HARDWARE_ERROR
        OpEventGetEventStatus_GetEventStatus_EvtInfo_AutoCreatedDemEvent_SpiDemEventParameterRefs_SPI_E_LOOPBACK_SELFTEST_FAILURE: RteEventRef=OpEventGetEventStatus_GetEventStatus_EvtInfo_AutoCreatedDemEvent_SpiDemEventParameterRefs_SPI_E_LOOPBACK_SELFTEST_FAILURE
        OpEventGetEventEnableCondition_GetEventEnableCondition_EvtInfo_AutoCreatedDemEvent_SpiDemEventParameterRefs_SPI_E_HARDWARE_ERROR: RteEventRef=OpEventGetEventEnableCondition_GetEventEnableCondition_EvtInfo_AutoCreatedDemEvent_SpiDemEventParameterRefs_SPI_E_HARDWARE_ERROR
        OpEventGetEventStatus_GetEventStatus_EvtInfo_AutoCreatedDemEvent_I2cDriver_I2C_E_BUS_ERROR: RteEventRef=OpEventGetEventStatus_GetEventStatus_EvtInfo_AutoCreatedDemEvent_I2cDriver_I2C_E_BUS_ERROR
        OpEventGetEventStatus_GetEventStatus_EvtInfo_AutoCreatedDemEvent_I2cDriver_I2C_E_ARBITRATION_ERROR: RteEventRef=OpEventGetEventStatus_GetEventStatus_EvtInfo_AutoCreatedDemEvent_I2cDriver_I2C_E_ARBITRATION_ERROR
        OpEventGetEventTested_GetEventTested_EvtInfo_AutoCreatedDemEvent_DIO_E_REG_WRITE_VERIFY: RteEventRef=OpEventGetEventTested_GetEventTested_EvtInfo_AutoCreatedDemEvent_DIO_E_REG_WRITE_VERIFY
        OpEventGetEventFreezeFrameDataEx_GetEventFreezeFrameDataEx_EvtInfo_AutoCreatedDemEvent_I2cDriver_I2C_E_BUS_ERROR: RteEventRef=OpEventGetEventFreezeFrameDataEx_GetEventFreezeFrameDataEx_EvtInfo_AutoCreatedDemEvent_I2cDriver_I2C_E_BUS_ERROR
        OpEventGetDTCOfEvent_GetDTCOfEvent_EvtInfo_AutoCreatedDemEvent_DIO_E_REG_WRITE_VERIFY: RteEventRef=OpEventGetDTCOfEvent_GetDTCOfEvent_EvtInfo_AutoCreatedDemEvent_DIO_E_REG_WRITE_VERIFY
        OpEventGetEventExtendedDataRecordEx_GetEventExtendedDataRecordEx_EvtInfo_AutoCreatedDemEvent_I2cDriver_I2C_E_ADDRESSING_ERROR: RteEventRef=OpEventGetEventExtendedDataRecordEx_GetEventExtendedDataRecordEx_EvtInfo_AutoCreatedDemEvent_I2cDriver_I2C_E_ADDRESSING_ERROR
        OpEventGetEventEnableCondition_GetEventEnableCondition_EvtInfo_AutoCreatedDemEvent_DIO_E_REG_WRITE_VERIFY: RteEventRef=OpEventGetEventEnableCondition_GetEventEnableCondition_EvtInfo_AutoCreatedDemEvent_DIO_E_REG_WRITE_VERIFY
        OpEventGetDTCOfEvent_GetDTCOfEvent_EvtInfo_AutoCreatedDemEvent_I2cDriver_I2C_E_ARBITRATION_ERROR: RteEventRef=OpEventGetDTCOfEvent_GetDTCOfEvent_EvtInfo_AutoCreatedDemEvent_I2cDriver_I2C_E_ARBITRATION_ERROR
        OpEventGetEventEnableCondition_GetEventEnableCondition_EvtInfo_AutoCreatedDemEvent_I2cDriver_I2C_E_BUS_ERROR: RteEventRef=OpEventGetEventEnableCondition_GetEventEnableCondition_EvtInfo_AutoCreatedDemEvent_I2cDriver_I2C_E_BUS_ERROR
        OpEventGetEventFreezeFrameDataEx_GetEventFreezeFrameDataEx_EvtInfo_AutoCreatedDemEvent_DIO_E_REG_WRITE_VERIFY: RteEventRef=OpEventGetEventFreezeFrameDataEx_GetEventFreezeFrameDataEx_EvtInfo_AutoCreatedDemEvent_DIO_E_REG_WRITE_VERIFY
        OpEventGetEventEnableCondition_GetEventEnableCondition_EvtInfo_AutoCreatedDemEvent_I2cDriver_I2C_E_ARBITRATION_ERROR: RteEventRef=OpEventGetEventEnableCondition_GetEventEnableCondition_EvtInfo_AutoCreatedDemEvent_I2cDriver_I2C_E_ARBITRATION_ERROR
        OpEventGetDTCOfEvent_GetDTCOfEvent_EvtInfo_AutoCreatedDemEvent_I2cDriver_I2C_E_BUS_ERROR: RteEventRef=OpEventGetDTCOfEvent_GetDTCOfEvent_EvtInfo_AutoCreatedDemEvent_I2cDriver_I2C_E_BUS_ERROR
        OpEventGetDTCOfEvent_GetDTCOfEvent_EvtInfo_AutoCreatedDemEvent_I2cDriver_I2C_E_ADDRESSING_ERROR: RteEventRef=OpEventGetDTCOfEvent_GetDTCOfEvent_EvtInfo_AutoCreatedDemEvent_I2cDriver_I2C_E_ADDRESSING_ERROR
        OpEventGetMonitorStatus_GetMonitorStatus_EvtInfo_AutoCreatedDemEvent_I2cDriver_I2C_E_BUS_ERROR: RteEventRef=OpEventGetMonitorStatus_GetMonitorStatus_EvtInfo_AutoCreatedDemEvent_I2cDriver_I2C_E_BUS_ERROR
        OpEventGetEventUdsStatus_GetEventUdsStatus_EvtInfo_AutoCreatedDemEvent_I2cDriver_I2C_E_ARBITRATION_ERROR: RteEventRef=OpEventGetEventUdsStatus_GetEventUdsStatus_EvtInfo_AutoCreatedDemEvent_I2cDriver_I2C_E_ARBITRATION_ERROR
        OpEventGetEventFreezeFrameDataEx_GetEventFreezeFrameDataEx_EvtInfo_AutoCreatedDemEvent_I2cDriver_I2C_E_ADDRESSING_ERROR: RteEventRef=OpEventGetEventFreezeFrameDataEx_GetEventFreezeFrameDataEx_EvtInfo_AutoCreatedDemEvent_I2cDriver_I2C_E_ADDRESSING_ERROR
        OpEventGetFaultDetectionCounter_GetFaultDetectionCounter_EvtInfo_AutoCreatedDemEvent_DIO_E_REG_WRITE_VERIFY: RteEventRef=OpEventGetFaultDetectionCounter_GetFaultDetectionCounter_EvtInfo_AutoCreatedDemEvent_DIO_E_REG_WRITE_VERIFY
        OpEventGetDebouncingOfEvent_GetDebouncingOfEvent_EvtInfo_AutoCreatedDemEvent_I2cDriver_I2C_E_BUS_ERROR: RteEventRef=OpEventGetDebouncingOfEvent_GetDebouncingOfEvent_EvtInfo_AutoCreatedDemEvent_I2cDriver_I2C_E_BUS_ERROR
        OpEventGetDebouncingOfEvent_GetDebouncingOfEvent_EvtInfo_AutoCreatedDemEvent_I2cDriver_I2C_E_ADDRESSING_ERROR: RteEventRef=OpEventGetDebouncingOfEvent_GetDebouncingOfEvent_EvtInfo_AutoCreatedDemEvent_I2cDriver_I2C_E_ADDRESSING_ERROR
        OpEventGetEventUdsStatus_GetEventUdsStatus_EvtInfo_AutoCreatedDemEvent_I2cDriver_I2C_E_BUS_ERROR: RteEventRef=OpEventGetEventUdsStatus_GetEventUdsStatus_EvtInfo_AutoCreatedDemEvent_I2cDriver_I2C_E_BUS_ERROR
        OpEventGetEventEnableCondition_GetEventEnableCondition_EvtInfo_AutoCreatedDemEvent_I2cDriver_I2C_E_ADDRESSING_ERROR: RteEventRef=OpEventGetEventEnableCondition_GetEventEnableCondition_EvtInfo_AutoCreatedDemEvent_I2cDriver_I2C_E_ADDRESSING_ERROR
        OpEventGetFaultDetectionCounter_GetFaultDetectionCounter_EvtInfo_AutoCreatedDemEvent_I2cDriver_I2C_E_ARBITRATION_ERROR: RteEventRef=OpEventGetFaultDetectionCounter_GetFaultDetectionCounter_EvtInfo_AutoCreatedDemEvent_I2cDriver_I2C_E_ARBITRATION_ERROR
        OpEventGetFaultDetectionCounter_GetFaultDetectionCounter_EvtInfo_AutoCreatedDemEvent_I2cDriver_I2C_E_BUS_ERROR: RteEventRef=OpEventGetFaultDetectionCounter_GetFaultDetectionCounter_EvtInfo_AutoCreatedDemEvent_I2cDriver_I2C_E_BUS_ERROR
        OpEventGetMonitorStatus_GetMonitorStatus_EvtInfo_AutoCreatedDemEvent_I2cDriver_I2C_E_ARBITRATION_ERROR: RteEventRef=OpEventGetMonitorStatus_GetMonitorStatus_EvtInfo_AutoCreatedDemEvent_I2cDriver_I2C_E_ARBITRATION_ERROR
        OpEventGetDebouncingOfEvent_GetDebouncingOfEvent_EvtInfo_AutoCreatedDemEvent_DIO_E_REG_WRITE_VERIFY: RteEventRef=OpEventGetDebouncingOfEvent_GetDebouncingOfEvent_EvtInfo_AutoCreatedDemEvent_DIO_E_REG_WRITE_VERIFY
        OpEventGetEventFreezeFrameDataEx_GetEventFreezeFrameDataEx_EvtInfo_AutoCreatedDemEvent_I2cDriver_I2C_E_ARBITRATION_ERROR: RteEventRef=OpEventGetEventFreezeFrameDataEx_GetEventFreezeFrameDataEx_EvtInfo_AutoCreatedDemEvent_I2cDriver_I2C_E_ARBITRATION_ERROR
        OpEventGetEventUdsStatus_GetEventUdsStatus_EvtInfo_AutoCreatedDemEvent_I2cDriver_I2C_E_ADDRESSING_ERROR: RteEventRef=OpEventGetEventUdsStatus_GetEventUdsStatus_EvtInfo_AutoCreatedDemEvent_I2cDriver_I2C_E_ADDRESSING_ERROR
        OpEventGetMonitorStatus_GetMonitorStatus_EvtInfo_AutoCreatedDemEvent_I2cDriver_I2C_E_ADDRESSING_ERROR: RteEventRef=OpEventGetMonitorStatus_GetMonitorStatus_EvtInfo_AutoCreatedDemEvent_I2cDriver_I2C_E_ADDRESSING_ERROR
        OpEventGetEventUdsStatus_GetEventUdsStatus_EvtInfo_AutoCreatedDemEvent_DIO_E_REG_WRITE_VERIFY: RteEventRef=OpEventGetEventUdsStatus_GetEventUdsStatus_EvtInfo_AutoCreatedDemEvent_DIO_E_REG_WRITE_VERIFY
        OpEventGetEventFailed_GetEventFailed_EvtInfo_AutoCreatedDemEvent_I2cDriver_I2C_E_ARBITRATION_ERROR: RteEventRef=OpEventGetEventFailed_GetEventFailed_EvtInfo_AutoCreatedDemEvent_I2cDriver_I2C_E_ARBITRATION_ERROR
        OpEventGetDebouncingOfEvent_GetDebouncingOfEvent_EvtInfo_AutoCreatedDemEvent_I2cDriver_I2C_E_ARBITRATION_ERROR: RteEventRef=OpEventGetDebouncingOfEvent_GetDebouncingOfEvent_EvtInfo_AutoCreatedDemEvent_I2cDriver_I2C_E_ARBITRATION_ERROR
        OpEventGetEventFailed_GetEventFailed_EvtInfo_AutoCreatedDemEvent_I2cDriver_I2C_E_BUS_ERROR: RteEventRef=OpEventGetEventFailed_GetEventFailed_EvtInfo_AutoCreatedDemEvent_I2cDriver_I2C_E_BUS_ERROR
        OpEventGetMonitorStatus_GetMonitorStatus_EvtInfo_AutoCreatedDemEvent_DIO_E_REG_WRITE_VERIFY: RteEventRef=OpEventGetMonitorStatus_GetMonitorStatus_EvtInfo_AutoCreatedDemEvent_DIO_E_REG_WRITE_VERIFY
        OpEventGetEventFailed_GetEventFailed_EvtInfo_AutoCreatedDemEvent_DIO_E_REG_WRITE_VERIFY: RteEventRef=OpEventGetEventFailed_GetEventFailed_EvtInfo_AutoCreatedDemEvent_DIO_E_REG_WRITE_VERIFY
        OpEventGetEventFailed_GetEventFailed_EvtInfo_AutoCreatedDemEvent_I2cDriver_I2C_E_ADDRESSING_ERROR: RteEventRef=OpEventGetEventFailed_GetEventFailed_EvtInfo_AutoCreatedDemEvent_I2cDriver_I2C_E_ADDRESSING_ERROR
        OpEventGetEventStatus_GetEventStatus_EvtInfo_AutoCreatedDemEvent_DIO_E_REG_WRITE_VERIFY: RteEventRef=OpEventGetEventStatus_GetEventStatus_EvtInfo_AutoCreatedDemEvent_DIO_E_REG_WRITE_VERIFY
        OpEventGetEventTested_GetEventTested_EvtInfo_AutoCreatedDemEvent_I2cDriver_I2C_E_ADDRESSING_ERROR: RteEventRef=OpEventGetEventTested_GetEventTested_EvtInfo_AutoCreatedDemEvent_I2cDriver_I2C_E_ADDRESSING_ERROR
        OpEventGetEventExtendedDataRecordEx_GetEventExtendedDataRecordEx_EvtInfo_AutoCreatedDemEvent_DIO_E_REG_WRITE_VERIFY: RteEventRef=OpEventGetEventExtendedDataRecordEx_GetEventExtendedDataRecordEx_EvtInfo_AutoCreatedDemEvent_DIO_E_REG_WRITE_VERIFY
        OpEventGetEventTested_GetEventTested_EvtInfo_AutoCreatedDemEvent_I2cDriver_I2C_E_BUS_ERROR: RteEventRef=OpEventGetEventTested_GetEventTested_EvtInfo_AutoCreatedDemEvent_I2cDriver_I2C_E_BUS_ERROR
        OpEventGetFaultDetectionCounter_GetFaultDetectionCounter_EvtInfo_AutoCreatedDemEvent_I2cDriver_I2C_E_ADDRESSING_ERROR: RteEventRef=OpEventGetFaultDetectionCounter_GetFaultDetectionCounter_EvtInfo_AutoCreatedDemEvent_I2cDriver_I2C_E_ADDRESSING_ERROR
        OpEventGetEventTested_GetEventTested_EvtInfo_AutoCreatedDemEvent_I2cDriver_I2C_E_ARBITRATION_ERROR: RteEventRef=OpEventGetEventTested_GetEventTested_EvtInfo_AutoCreatedDemEvent_I2cDriver_I2C_E_ARBITRATION_ERROR
        OpEventGetEventExtendedDataRecordEx_GetEventExtendedDataRecordEx_EvtInfo_AutoCreatedDemEvent_I2cDriver_I2C_E_BUS_ERROR: RteEventRef=OpEventGetEventExtendedDataRecordEx_GetEventExtendedDataRecordEx_EvtInfo_AutoCreatedDemEvent_I2cDriver_I2C_E_BUS_ERROR
        OpEventGetEventStatus_GetEventStatus_EvtInfo_AutoCreatedDemEvent_I2cDriver_I2C_E_ADDRESSING_ERROR: RteEventRef=OpEventGetEventStatus_GetEventStatus_EvtInfo_AutoCreatedDemEvent_I2cDriver_I2C_E_ADDRESSING_ERROR
        OpEventGetEventExtendedDataRecordEx_GetEventExtendedDataRecordEx_EvtInfo_AutoCreatedDemEvent_I2cDriver_I2C_E_ARBITRATION_ERROR: RteEventRef=OpEventGetEventExtendedDataRecordEx_GetEventExtendedDataRecordEx_EvtInfo_AutoCreatedDemEvent_I2cDriver_I2C_E_ARBITRATION_ERROR
        OpEventGetEventTested_GetEventTested_EvtInfo_AutoCreatedDemEvent_ICU_E_REG_WRITE_VERIFY: RteEventRef=OpEventGetEventTested_GetEventTested_EvtInfo_AutoCreatedDemEvent_ICU_E_REG_WRITE_VERIFY
        OpEventGetDTCOfEvent_GetDTCOfEvent_EvtInfo_AutoCreatedDemEvent_ICU_E_REG_WRITE_VERIFY: RteEventRef=OpEventGetDTCOfEvent_GetDTCOfEvent_EvtInfo_AutoCreatedDemEvent_ICU_E_REG_WRITE_VERIFY
        OpEventGetEventFreezeFrameDataEx_GetEventFreezeFrameDataEx_EvtInfo_AutoCreatedDemEvent_ICU_E_REG_WRITE_VERIFY: RteEventRef=OpEventGetEventFreezeFrameDataEx_GetEventFreezeFrameDataEx_EvtInfo_AutoCreatedDemEvent_ICU_E_REG_WRITE_VERIFY
        OpEventGetEventUdsStatus_GetEventUdsStatus_EvtInfo_AutoCreatedDemEvent_ICU_E_REG_WRITE_VERIFY: RteEventRef=OpEventGetEventUdsStatus_GetEventUdsStatus_EvtInfo_AutoCreatedDemEvent_ICU_E_REG_WRITE_VERIFY
        OpEventGetEventFailed_GetEventFailed_EvtInfo_AutoCreatedDemEvent_ICU_E_REG_WRITE_VERIFY: RteEventRef=OpEventGetEventFailed_GetEventFailed_EvtInfo_AutoCreatedDemEvent_ICU_E_REG_WRITE_VERIFY
        OpEventGetEventEnableCondition_GetEventEnableCondition_EvtInfo_AutoCreatedDemEvent_ICU_E_REG_WRITE_VERIFY: RteEventRef=OpEventGetEventEnableCondition_GetEventEnableCondition_EvtInfo_AutoCreatedDemEvent_ICU_E_REG_WRITE_VERIFY
        OpEventGetDebouncingOfEvent_GetDebouncingOfEvent_EvtInfo_AutoCreatedDemEvent_ICU_E_REG_WRITE_VERIFY: RteEventRef=OpEventGetDebouncingOfEvent_GetDebouncingOfEvent_EvtInfo_AutoCreatedDemEvent_ICU_E_REG_WRITE_VERIFY
        OpEventGetEventExtendedDataRecordEx_GetEventExtendedDataRecordEx_EvtInfo_AutoCreatedDemEvent_ICU_E_REG_WRITE_VERIFY: RteEventRef=OpEventGetEventExtendedDataRecordEx_GetEventExtendedDataRecordEx_EvtInfo_AutoCreatedDemEvent_ICU_E_REG_WRITE_VERIFY
        OpEventGetFaultDetectionCounter_GetFaultDetectionCounter_EvtInfo_AutoCreatedDemEvent_ICU_E_REG_WRITE_VERIFY: RteEventRef=OpEventGetFaultDetectionCounter_GetFaultDetectionCounter_EvtInfo_AutoCreatedDemEvent_ICU_E_REG_WRITE_VERIFY
        OpEventGetEventStatus_GetEventStatus_EvtInfo_AutoCreatedDemEvent_ICU_E_REG_WRITE_VERIFY: RteEventRef=OpEventGetEventStatus_GetEventStatus_EvtInfo_AutoCreatedDemEvent_ICU_E_REG_WRITE_VERIFY
        OpEventGetMonitorStatus_GetMonitorStatus_EvtInfo_AutoCreatedDemEvent_ICU_E_REG_WRITE_VERIFY: RteEventRef=OpEventGetMonitorStatus_GetMonitorStatus_EvtInfo_AutoCreatedDemEvent_ICU_E_REG_WRITE_VERIFY
        OpEventGetDebouncingOfEvent_GetDebouncingOfEvent_EvtInfo_AutoCreatedDemEvent_ADC_E_REG_WRITE_VERIFY: RteEventRef=OpEventGetDebouncingOfEvent_GetDebouncingOfEvent_EvtInfo_AutoCreatedDemEvent_ADC_E_REG_WRITE_VERIFY
        OpEventGetEventFailed_GetEventFailed_EvtInfo_AutoCreatedDemEvent_ADC_E_QUEUE_FULL: RteEventRef=OpEventGetEventFailed_GetEventFailed_EvtInfo_AutoCreatedDemEvent_ADC_E_QUEUE_FULL
        OpEventGetEventUdsStatus_GetEventUdsStatus_EvtInfo_AutoCreatedDemEvent_ADC_E_LOOP_TIMEOUT: RteEventRef=OpEventGetEventUdsStatus_GetEventUdsStatus_EvtInfo_AutoCreatedDemEvent_ADC_E_LOOP_TIMEOUT
        OpEventGetEventTested_GetEventTested_EvtInfo_AutoCreatedDemEvent_ADC_E_REG_WRITE_VERIFY: RteEventRef=OpEventGetEventTested_GetEventTested_EvtInfo_AutoCreatedDemEvent_ADC_E_REG_WRITE_VERIFY
        OpEventGetEventFreezeFrameDataEx_GetEventFreezeFrameDataEx_EvtInfo_AutoCreatedDemEvent_ADC_E_REG_WRITE_VERIFY: RteEventRef=OpEventGetEventFreezeFrameDataEx_GetEventFreezeFrameDataEx_EvtInfo_AutoCreatedDemEvent_ADC_E_REG_WRITE_VERIFY
        OpEventGetEventExtendedDataRecordEx_GetEventExtendedDataRecordEx_EvtInfo_AutoCreatedDemEvent_ADC_E_REG_WRITE_VERIFY: RteEventRef=OpEventGetEventExtendedDataRecordEx_GetEventExtendedDataRecordEx_EvtInfo_AutoCreatedDemEvent_ADC_E_REG_WRITE_VERIFY
        OpEventGetEventStatus_GetEventStatus_EvtInfo_AutoCreatedDemEvent_ADC_E_REG_WRITE_VERIFY: RteEventRef=OpEventGetEventStatus_GetEventStatus_EvtInfo_AutoCreatedDemEvent_ADC_E_REG_WRITE_VERIFY
        OpEventGetEventStatus_GetEventStatus_EvtInfo_AutoCreatedDemEvent_ADC_E_QUEUE_FULL: RteEventRef=OpEventGetEventStatus_GetEventStatus_EvtInfo_AutoCreatedDemEvent_ADC_E_QUEUE_FULL
        OpEventGetDebouncingOfEvent_GetDebouncingOfEvent_EvtInfo_AutoCreatedDemEvent_ADC_E_QUEUE_FULL: RteEventRef=OpEventGetDebouncingOfEvent_GetDebouncingOfEvent_EvtInfo_AutoCreatedDemEvent_ADC_E_QUEUE_FULL
        OpEventGetDebouncingOfEvent_GetDebouncingOfEvent_EvtInfo_AutoCreatedDemEvent_ADC_E_LOOP_TIMEOUT: RteEventRef=OpEventGetDebouncingOfEvent_GetDebouncingOfEvent_EvtInfo_AutoCreatedDemEvent_ADC_E_LOOP_TIMEOUT
        OpEventGetEventFreezeFrameDataEx_GetEventFreezeFrameDataEx_EvtInfo_AutoCreatedDemEvent_ADC_E_QUEUE_FULL: RteEventRef=OpEventGetEventFreezeFrameDataEx_GetEventFreezeFrameDataEx_EvtInfo_AutoCreatedDemEvent_ADC_E_QUEUE_FULL
        OpEventGetEventFreezeFrameDataEx_GetEventFreezeFrameDataEx_EvtInfo_AutoCreatedDemEvent_ADC_E_LOOP_TIMEOUT: RteEventRef=OpEventGetEventFreezeFrameDataEx_GetEventFreezeFrameDataEx_EvtInfo_AutoCreatedDemEvent_ADC_E_LOOP_TIMEOUT
        OpEventGetEventTested_GetEventTested_EvtInfo_AutoCreatedDemEvent_ADC_E_LOOP_TIMEOUT: RteEventRef=OpEventGetEventTested_GetEventTested_EvtInfo_AutoCreatedDemEvent_ADC_E_LOOP_TIMEOUT
        OpEventGetEventStatus_GetEventStatus_EvtInfo_AutoCreatedDemEvent_ADC_E_LOOP_TIMEOUT: RteEventRef=OpEventGetEventStatus_GetEventStatus_EvtInfo_AutoCreatedDemEvent_ADC_E_LOOP_TIMEOUT
        OpEventGetMonitorStatus_GetMonitorStatus_EvtInfo_AutoCreatedDemEvent_ADC_E_QUEUE_FULL: RteEventRef=OpEventGetMonitorStatus_GetMonitorStatus_EvtInfo_AutoCreatedDemEvent_ADC_E_QUEUE_FULL
        OpEventGetMonitorStatus_GetMonitorStatus_EvtInfo_AutoCreatedDemEvent_ADC_E_REG_WRITE_VERIFY: RteEventRef=OpEventGetMonitorStatus_GetMonitorStatus_EvtInfo_AutoCreatedDemEvent_ADC_E_REG_WRITE_VERIFY
        OpEventGetEventTested_GetEventTested_EvtInfo_AutoCreatedDemEvent_ADC_E_QUEUE_FULL: RteEventRef=OpEventGetEventTested_GetEventTested_EvtInfo_AutoCreatedDemEvent_ADC_E_QUEUE_FULL
        OpEventGetEventExtendedDataRecordEx_GetEventExtendedDataRecordEx_EvtInfo_AutoCreatedDemEvent_ADC_E_LOOP_TIMEOUT: RteEventRef=OpEventGetEventExtendedDataRecordEx_GetEventExtendedDataRecordEx_EvtInfo_AutoCreatedDemEvent_ADC_E_LOOP_TIMEOUT
        OpEventGetEventExtendedDataRecordEx_GetEventExtendedDataRecordEx_EvtInfo_AutoCreatedDemEvent_ADC_E_QUEUE_FULL: RteEventRef=OpEventGetEventExtendedDataRecordEx_GetEventExtendedDataRecordEx_EvtInfo_AutoCreatedDemEvent_ADC_E_QUEUE_FULL
        OpEventGetEventEnableCondition_GetEventEnableCondition_EvtInfo_AutoCreatedDemEvent_ADC_E_QUEUE_FULL: RteEventRef=OpEventGetEventEnableCondition_GetEventEnableCondition_EvtInfo_AutoCreatedDemEvent_ADC_E_QUEUE_FULL
        OpEventGetFaultDetectionCounter_GetFaultDetectionCounter_EvtInfo_AutoCreatedDemEvent_ADC_E_REG_WRITE_VERIFY: RteEventRef=OpEventGetFaultDetectionCounter_GetFaultDetectionCounter_EvtInfo_AutoCreatedDemEvent_ADC_E_REG_WRITE_VERIFY
        OpEventGetEventFailed_GetEventFailed_EvtInfo_AutoCreatedDemEvent_ADC_E_LOOP_TIMEOUT: RteEventRef=OpEventGetEventFailed_GetEventFailed_EvtInfo_AutoCreatedDemEvent_ADC_E_LOOP_TIMEOUT
        OpEventGetDTCOfEvent_GetDTCOfEvent_EvtInfo_AutoCreatedDemEvent_ADC_E_QUEUE_FULL: RteEventRef=OpEventGetDTCOfEvent_GetDTCOfEvent_EvtInfo_AutoCreatedDemEvent_ADC_E_QUEUE_FULL
        OpEventGetEventFailed_GetEventFailed_EvtInfo_AutoCreatedDemEvent_ADC_E_REG_WRITE_VERIFY: RteEventRef=OpEventGetEventFailed_GetEventFailed_EvtInfo_AutoCreatedDemEvent_ADC_E_REG_WRITE_VERIFY
        OpEventGetEventEnableCondition_GetEventEnableCondition_EvtInfo_AutoCreatedDemEvent_ADC_E_REG_WRITE_VERIFY: RteEventRef=OpEventGetEventEnableCondition_GetEventEnableCondition_EvtInfo_AutoCreatedDemEvent_ADC_E_REG_WRITE_VERIFY
        OpEventGetEventUdsStatus_GetEventUdsStatus_EvtInfo_AutoCreatedDemEvent_ADC_E_QUEUE_FULL: RteEventRef=OpEventGetEventUdsStatus_GetEventUdsStatus_EvtInfo_AutoCreatedDemEvent_ADC_E_QUEUE_FULL
        OpEventGetFaultDetectionCounter_GetFaultDetectionCounter_EvtInfo_AutoCreatedDemEvent_ADC_E_QUEUE_FULL: RteEventRef=OpEventGetFaultDetectionCounter_GetFaultDetectionCounter_EvtInfo_AutoCreatedDemEvent_ADC_E_QUEUE_FULL
        OpEventGetFaultDetectionCounter_GetFaultDetectionCounter_EvtInfo_AutoCreatedDemEvent_ADC_E_LOOP_TIMEOUT: RteEventRef=OpEventGetFaultDetectionCounter_GetFaultDetectionCounter_EvtInfo_AutoCreatedDemEvent_ADC_E_LOOP_TIMEOUT
        OpEventGetMonitorStatus_GetMonitorStatus_EvtInfo_AutoCreatedDemEvent_ADC_E_LOOP_TIMEOUT: RteEventRef=OpEventGetMonitorStatus_GetMonitorStatus_EvtInfo_AutoCreatedDemEvent_ADC_E_LOOP_TIMEOUT
        OpEventGetDTCOfEvent_GetDTCOfEvent_EvtInfo_AutoCreatedDemEvent_ADC_E_REG_WRITE_VERIFY: RteEventRef=OpEventGetDTCOfEvent_GetDTCOfEvent_EvtInfo_AutoCreatedDemEvent_ADC_E_REG_WRITE_VERIFY
        OpEventGetEventEnableCondition_GetEventEnableCondition_EvtInfo_AutoCreatedDemEvent_ADC_E_LOOP_TIMEOUT: RteEventRef=OpEventGetEventEnableCondition_GetEventEnableCondition_EvtInfo_AutoCreatedDemEvent_ADC_E_LOOP_TIMEOUT
        OpEventGetDTCOfEvent_GetDTCOfEvent_EvtInfo_AutoCreatedDemEvent_ADC_E_LOOP_TIMEOUT: RteEventRef=OpEventGetDTCOfEvent_GetDTCOfEvent_EvtInfo_AutoCreatedDemEvent_ADC_E_LOOP_TIMEOUT
        OpEventGetEventUdsStatus_GetEventUdsStatus_EvtInfo_AutoCreatedDemEvent_ADC_E_REG_WRITE_VERIFY: RteEventRef=OpEventGetEventUdsStatus_GetEventUdsStatus_EvtInfo_AutoCreatedDemEvent_ADC_E_REG_WRITE_VERIFY
        OpEventSetEventStatus_SetEventStatus_Event_DTC_0x901001: RteEventRef=OpEventSetEventStatus_SetEventStatus_Event_DTC_0x901001
        OpEventGetDTCOfEvent_GetDTCOfEvent_Event_DTC_0x901c01: RteEventRef=OpEventGetDTCOfEvent_GetDTCOfEvent_Event_DTC_0x901c01
        OpEventGetFaultDetectionCounter_GetFaultDetectionCounter_Event_DTC_0x901f01: RteEventRef=OpEventGetFaultDetectionCounter_GetFaultDetectionCounter_Event_DTC_0x901f01
        OpEventGetFaultDetectionCounter_GetFaultDetectionCounter_Event_DTC_0x901101: RteEventRef=OpEventGetFaultDetectionCounter_GetFaultDetectionCounter_Event_DTC_0x901101
        OpEventGetEventTested_GetEventTested_Event_DTC_0x901b01: RteEventRef=OpEventGetEventTested_GetEventTested_Event_DTC_0x901b01
        OpEventGetEventStatus_GetEventStatus_Event_DTC_0x901b01: RteEventRef=OpEventGetEventStatus_GetEventStatus_Event_DTC_0x901b01
        OpEventGetEventExtendedDataRecordEx_GetEventExtendedDataRecordEx_EvtInfo_DTC_0x901001: RteEventRef=OpEventGetEventExtendedDataRecordEx_GetEventExtendedDataRecordEx_EvtInfo_DTC_0x901001
        OpEventGetEventExtendedDataRecordEx_GetEventExtendedDataRecordEx_EvtInfo_DTC_0x901501: RteEventRef=OpEventGetEventExtendedDataRecordEx_GetEventExtendedDataRecordEx_EvtInfo_DTC_0x901501
        OpEventGetEventTested_GetEventTested_Event_DTC_0x901301: RteEventRef=OpEventGetEventTested_GetEventTested_Event_DTC_0x901301
        OpEventGetEventUdsStatus_GetEventUdsStatus_EvtInfo_DTC_0x901101: RteEventRef=OpEventGetEventUdsStatus_GetEventUdsStatus_EvtInfo_DTC_0x901101
        OpEventGetEventFailed_GetEventFailed_EvtInfo_DTC_0x901c01: RteEventRef=OpEventGetEventFailed_GetEventFailed_EvtInfo_DTC_0x901c01
        OpEventGetEventUdsStatus_GetEventUdsStatus_EvtInfo_DTC_0x901201: RteEventRef=OpEventGetEventUdsStatus_GetEventUdsStatus_EvtInfo_DTC_0x901201
        OpEventGetEventTested_GetEventTested_EvtInfo_DTC_0x901001: RteEventRef=OpEventGetEventTested_GetEventTested_EvtInfo_DTC_0x901001
        OpEventGetEventUdsStatus_GetEventUdsStatus_EvtInfo_DTC_0x901c01: RteEventRef=OpEventGetEventUdsStatus_GetEventUdsStatus_EvtInfo_DTC_0x901c01
        OpEventGetEventStatus_GetEventStatus_EvtInfo_DTC_0x901e01: RteEventRef=OpEventGetEventStatus_GetEventStatus_EvtInfo_DTC_0x901e01
        OpEventGetEventFreezeFrameDataEx_GetEventFreezeFrameDataEx_EvtInfo_DTC_0x901801: RteEventRef=OpEventGetEventFreezeFrameDataEx_GetEventFreezeFrameDataEx_EvtInfo_DTC_0x901801
        OpEventGetEventTested_GetEventTested_EvtInfo_DTC_0x901401: RteEventRef=OpEventGetEventTested_GetEventTested_EvtInfo_DTC_0x901401
        OpEventSetEventStatus_SetEventStatus_Event_DTC_0x901501: RteEventRef=OpEventSetEventStatus_SetEventStatus_Event_DTC_0x901501
        OpEventGetEventUdsStatus_GetEventUdsStatus_EvtInfo_DTC_0x901b01: RteEventRef=OpEventGetEventUdsStatus_GetEventUdsStatus_EvtInfo_DTC_0x901b01
        OpEventGetEventFailed_GetEventFailed_Event_DTC_0x901901: RteEventRef=OpEventGetEventFailed_GetEventFailed_Event_DTC_0x901901
        OpEventGetEventExtendedDataRecordEx_GetEventExtendedDataRecordEx_Event_DTC_0x901001: RteEventRef=OpEventGetEventExtendedDataRecordEx_GetEventExtendedDataRecordEx_Event_DTC_0x901001
        OpEventGetEventFailed_GetEventFailed_EvtInfo_DTC_0x901101: RteEventRef=OpEventGetEventFailed_GetEventFailed_EvtInfo_DTC_0x901101
        OpEventGetDTCOfEvent_GetDTCOfEvent_EvtInfo_DTC_0x902101: RteEventRef=OpEventGetDTCOfEvent_GetDTCOfEvent_EvtInfo_DTC_0x902101
        OpEventGetEventExtendedDataRecordEx_GetEventExtendedDataRecordEx_EvtInfo_DTC_0x901f01: RteEventRef=OpEventGetEventExtendedDataRecordEx_GetEventExtendedDataRecordEx_EvtInfo_DTC_0x901f01
        OpEventGetEventTested_GetEventTested_EvtInfo_DTC_0x901a01: RteEventRef=OpEventGetEventTested_GetEventTested_EvtInfo_DTC_0x901a01
        OpEventResetEventStatus_ResetEventStatus_Event_DTC_0x902001: RteEventRef=OpEventResetEventStatus_ResetEventStatus_Event_DTC_0x902001
        OpEventGetEventTested_GetEventTested_EvtInfo_DTC_0x901501: RteEventRef=OpEventGetEventTested_GetEventTested_EvtInfo_DTC_0x901501
        OpEventResetEventStatus_ResetEventStatus_Event_DTC_0x901501: RteEventRef=OpEventResetEventStatus_ResetEventStatus_Event_DTC_0x901501
        OpEventResetEventStatus_ResetEventStatus_Event_DTC_0x901a01: RteEventRef=OpEventResetEventStatus_ResetEventStatus_Event_DTC_0x901a01
        OpEventGetEventExtendedDataRecordEx_GetEventExtendedDataRecordEx_EvtInfo_DTC_0x901201: RteEventRef=OpEventGetEventExtendedDataRecordEx_GetEventExtendedDataRecordEx_EvtInfo_DTC_0x901201
        OpEventGetEventFailed_GetEventFailed_Event_DTC_0x901801: RteEventRef=OpEventGetEventFailed_GetEventFailed_Event_DTC_0x901801
        OpEventGetEventFailed_GetEventFailed_EvtInfo_DTC_0x902001: RteEventRef=OpEventGetEventFailed_GetEventFailed_EvtInfo_DTC_0x902001
        OpEventResetEventDebounceStatus_ResetEventDebounceStatus_Event_DTC_0x901d01: RteEventRef=OpEventResetEventDebounceStatus_ResetEventDebounceStatus_Event_DTC_0x901d01
        OpEventGetEventFailed_GetEventFailed_Event_DTC_0x902101: RteEventRef=OpEventGetEventFailed_GetEventFailed_Event_DTC_0x902101
        OpEventGetEventTested_GetEventTested_Event_DTC_0x901c01: RteEventRef=OpEventGetEventTested_GetEventTested_Event_DTC_0x901c01
        OpEventGetEventExtendedDataRecordEx_GetEventExtendedDataRecordEx_EvtInfo_DTC_0x901301: RteEventRef=OpEventGetEventExtendedDataRecordEx_GetEventExtendedDataRecordEx_EvtInfo_DTC_0x901301
        OpEventGetEventStatus_GetEventStatus_EvtInfo_DTC_0x901701: RteEventRef=OpEventGetEventStatus_GetEventStatus_EvtInfo_DTC_0x901701
        OpEventGetDTCOfEvent_GetDTCOfEvent_Event_DTC_0x902001: RteEventRef=OpEventGetDTCOfEvent_GetDTCOfEvent_Event_DTC_0x902001
        OpEventGetMonitorStatus_GetMonitorStatus_EvtInfo_DTC_0x901801: RteEventRef=OpEventGetMonitorStatus_GetMonitorStatus_EvtInfo_DTC_0x901801
        OpEventGetEventExtendedDataRecordEx_GetEventExtendedDataRecordEx_EvtInfo_DTC_0x901d01: RteEventRef=OpEventGetEventExtendedDataRecordEx_GetEventExtendedDataRecordEx_EvtInfo_DTC_0x901d01
        OpEventGetEventStatus_GetEventStatus_EvtInfo_DTC_0x901c01: RteEventRef=OpEventGetEventStatus_GetEventStatus_EvtInfo_DTC_0x901c01
        OpEventGetFaultDetectionCounter_GetFaultDetectionCounter_Event_DTC_0x901201: RteEventRef=OpEventGetFaultDetectionCounter_GetFaultDetectionCounter_Event_DTC_0x901201
        OpEventResetEventDebounceStatus_ResetEventDebounceStatus_Event_DTC_0x901001: RteEventRef=OpEventResetEventDebounceStatus_ResetEventDebounceStatus_Event_DTC_0x901001
        OpEventGetEventStatus_GetEventStatus_EvtInfo_DTC_0x901b01: RteEventRef=OpEventGetEventStatus_GetEventStatus_EvtInfo_DTC_0x901b01
        OpEventGetFaultDetectionCounter_GetFaultDetectionCounter_EvtInfo_DTC_0x901d01: RteEventRef=OpEventGetFaultDetectionCounter_GetFaultDetectionCounter_EvtInfo_DTC_0x901d01
        OpEventGetEventTested_GetEventTested_Event_DTC_0x901201: RteEventRef=OpEventGetEventTested_GetEventTested_Event_DTC_0x901201
        OpEventGetEventUdsStatus_GetEventUdsStatus_Event_DTC_0x901201: RteEventRef=OpEventGetEventUdsStatus_GetEventUdsStatus_Event_DTC_0x901201
        OpEventGetEventFreezeFrameDataEx_GetEventFreezeFrameDataEx_Event_DTC_0x901501: RteEventRef=OpEventGetEventFreezeFrameDataEx_GetEventFreezeFrameDataEx_Event_DTC_0x901501
        OpEventGetEventFreezeFrameDataEx_GetEventFreezeFrameDataEx_EvtInfo_DTC_0x901301: RteEventRef=OpEventGetEventFreezeFrameDataEx_GetEventFreezeFrameDataEx_EvtInfo_DTC_0x901301
        OpEventGetEventFailed_GetEventFailed_Event_DTC_0x901301: RteEventRef=OpEventGetEventFailed_GetEventFailed_Event_DTC_0x901301
        OpEventGetMonitorStatus_GetMonitorStatus_EvtInfo_DTC_0x901e01: RteEventRef=OpEventGetMonitorStatus_GetMonitorStatus_EvtInfo_DTC_0x901e01
        OpEventGetEventTested_GetEventTested_EvtInfo_DTC_0x901f01: RteEventRef=OpEventGetEventTested_GetEventTested_EvtInfo_DTC_0x901f01
        OpEventGetEventUdsStatus_GetEventUdsStatus_EvtInfo_DTC_0x902101: RteEventRef=OpEventGetEventUdsStatus_GetEventUdsStatus_EvtInfo_DTC_0x902101
        OpEventGetEventUdsStatus_GetEventUdsStatus_Event_DTC_0x901101: RteEventRef=OpEventGetEventUdsStatus_GetEventUdsStatus_Event_DTC_0x901101
        OpEventGetEventStatus_GetEventStatus_Event_DTC_0x901401: RteEventRef=OpEventGetEventStatus_GetEventStatus_Event_DTC_0x901401
        OpEventGetEventTested_GetEventTested_EvtInfo_DTC_0x901b01: RteEventRef=OpEventGetEventTested_GetEventTested_EvtInfo_DTC_0x901b01
        OpEventGetDTCOfEvent_GetDTCOfEvent_Event_DTC_0x901701: RteEventRef=OpEventGetDTCOfEvent_GetDTCOfEvent_Event_DTC_0x901701
        OpEventGetEventExtendedDataRecordEx_GetEventExtendedDataRecordEx_EvtInfo_DTC_0x901701: RteEventRef=OpEventGetEventExtendedDataRecordEx_GetEventExtendedDataRecordEx_EvtInfo_DTC_0x901701
        OpEventGetDTCOfEvent_GetDTCOfEvent_Event_DTC_0x901601: RteEventRef=OpEventGetDTCOfEvent_GetDTCOfEvent_Event_DTC_0x901601
        OpEventGetEventUdsStatus_GetEventUdsStatus_EvtInfo_DTC_0x901e01: RteEventRef=OpEventGetEventUdsStatus_GetEventUdsStatus_EvtInfo_DTC_0x901e01
        OpEventGetDebouncingOfEvent_GetDebouncingOfEvent_EvtInfo_DTC_0x901d01: RteEventRef=OpEventGetDebouncingOfEvent_GetDebouncingOfEvent_EvtInfo_DTC_0x901d01
        OpEventGetDTCOfEvent_GetDTCOfEvent_Event_DTC_0x901901: RteEventRef=OpEventGetDTCOfEvent_GetDTCOfEvent_Event_DTC_0x901901
        OpEventGetFaultDetectionCounter_GetFaultDetectionCounter_EvtInfo_DTC_0x901f01: RteEventRef=OpEventGetFaultDetectionCounter_GetFaultDetectionCounter_EvtInfo_DTC_0x901f01
        OpEventGetEventFailed_GetEventFailed_EvtInfo_DTC_0x901b01: RteEventRef=OpEventGetEventFailed_GetEventFailed_EvtInfo_DTC_0x901b01
        OpEventGetEventTested_GetEventTested_Event_DTC_0x901901: RteEventRef=OpEventGetEventTested_GetEventTested_Event_DTC_0x901901
        OpEventGetMonitorStatus_GetMonitorStatus_EvtInfo_DTC_0x901701: RteEventRef=OpEventGetMonitorStatus_GetMonitorStatus_EvtInfo_DTC_0x901701
        OpEventGetEventFailed_GetEventFailed_EvtInfo_DTC_0x902101: RteEventRef=OpEventGetEventFailed_GetEventFailed_EvtInfo_DTC_0x902101
        OpEventGetDTCOfEvent_GetDTCOfEvent_Event_DTC_0x901d01: RteEventRef=OpEventGetDTCOfEvent_GetDTCOfEvent_Event_DTC_0x901d01
        OpEventResetEventDebounceStatus_ResetEventDebounceStatus_Event_DTC_0x901501: RteEventRef=OpEventResetEventDebounceStatus_ResetEventDebounceStatus_Event_DTC_0x901501
        OpEventGetEventEnableCondition_GetEventEnableCondition_EvtInfo_DTC_0x901901: RteEventRef=OpEventGetEventEnableCondition_GetEventEnableCondition_EvtInfo_DTC_0x901901
        OpEventGetFaultDetectionCounter_GetFaultDetectionCounter_Event_DTC_0x901e01: RteEventRef=OpEventGetFaultDetectionCounter_GetFaultDetectionCounter_Event_DTC_0x901e01
        OpEventGetMonitorStatus_GetMonitorStatus_EvtInfo_DTC_0x901a01: RteEventRef=OpEventGetMonitorStatus_GetMonitorStatus_EvtInfo_DTC_0x901a01
        OpEventGetEventTested_GetEventTested_Event_DTC_0x901e01: RteEventRef=OpEventGetEventTested_GetEventTested_Event_DTC_0x901e01
        OpEventGetEventEnableCondition_GetEventEnableCondition_EvtInfo_DTC_0x901001: RteEventRef=OpEventGetEventEnableCondition_GetEventEnableCondition_EvtInfo_DTC_0x901001
        OpEventGetDTCOfEvent_GetDTCOfEvent_EvtInfo_DTC_0x901201: RteEventRef=OpEventGetDTCOfEvent_GetDTCOfEvent_EvtInfo_DTC_0x901201
        OpEventGetEventEnableCondition_GetEventEnableCondition_EvtInfo_DTC_0x901801: RteEventRef=OpEventGetEventEnableCondition_GetEventEnableCondition_EvtInfo_DTC_0x901801
        OpEventGetEventFreezeFrameDataEx_GetEventFreezeFrameDataEx_EvtInfo_DTC_0x901001: RteEventRef=OpEventGetEventFreezeFrameDataEx_GetEventFreezeFrameDataEx_EvtInfo_DTC_0x901001
        OpEventGetDTCOfEvent_GetDTCOfEvent_Event_DTC_0x901a01: RteEventRef=OpEventGetDTCOfEvent_GetDTCOfEvent_Event_DTC_0x901a01
        OpEventGetEventStatus_GetEventStatus_EvtInfo_DTC_0x902101: RteEventRef=OpEventGetEventStatus_GetEventStatus_EvtInfo_DTC_0x902101
        OpEventGetEventFreezeFrameDataEx_GetEventFreezeFrameDataEx_Event_DTC_0x901f01: RteEventRef=OpEventGetEventFreezeFrameDataEx_GetEventFreezeFrameDataEx_Event_DTC_0x901f01
        OpEventGetEventStatus_GetEventStatus_EvtInfo_DTC_0x901801: RteEventRef=OpEventGetEventStatus_GetEventStatus_EvtInfo_DTC_0x901801
        OpEventGetEventFreezeFrameDataEx_GetEventFreezeFrameDataEx_Event_DTC_0x901301: RteEventRef=OpEventGetEventFreezeFrameDataEx_GetEventFreezeFrameDataEx_Event_DTC_0x901301
        OpEventGetEventUdsStatus_GetEventUdsStatus_EvtInfo_DTC_0x901701: RteEventRef=OpEventGetEventUdsStatus_GetEventUdsStatus_EvtInfo_DTC_0x901701
        OpEventGetEventTested_GetEventTested_EvtInfo_DTC_0x901901: RteEventRef=OpEventGetEventTested_GetEventTested_EvtInfo_DTC_0x901901
        OpEventGetEventUdsStatus_GetEventUdsStatus_Event_DTC_0x901d01: RteEventRef=OpEventGetEventUdsStatus_GetEventUdsStatus_Event_DTC_0x901d01
        OpEventGetEventTested_GetEventTested_EvtInfo_DTC_0x902101: RteEventRef=OpEventGetEventTested_GetEventTested_EvtInfo_DTC_0x902101
        OpEventGetFaultDetectionCounter_GetFaultDetectionCounter_EvtInfo_DTC_0x901901: RteEventRef=OpEventGetFaultDetectionCounter_GetFaultDetectionCounter_EvtInfo_DTC_0x901901
        OpEventResetEventStatus_ResetEventStatus_Event_DTC_0x902101: RteEventRef=OpEventResetEventStatus_ResetEventStatus_Event_DTC_0x902101
        OpEventResetEventStatus_ResetEventStatus_Event_DTC_0x901601: RteEventRef=OpEventResetEventStatus_ResetEventStatus_Event_DTC_0x901601
        OpEventGetEventExtendedDataRecordEx_GetEventExtendedDataRecordEx_Event_DTC_0x901e01: RteEventRef=OpEventGetEventExtendedDataRecordEx_GetEventExtendedDataRecordEx_Event_DTC_0x901e01
        OpEventGetEventUdsStatus_GetEventUdsStatus_Event_DTC_0x901301: RteEventRef=OpEventGetEventUdsStatus_GetEventUdsStatus_Event_DTC_0x901301
        OpEventGetEventUdsStatus_GetEventUdsStatus_Event_DTC_0x901e01: RteEventRef=OpEventGetEventUdsStatus_GetEventUdsStatus_Event_DTC_0x901e01
        OpEventResetEventStatus_ResetEventStatus_Event_DTC_0x901c01: RteEventRef=OpEventResetEventStatus_ResetEventStatus_Event_DTC_0x901c01
        OpEventGetEventEnableCondition_GetEventEnableCondition_EvtInfo_DTC_0x901a01: RteEventRef=OpEventGetEventEnableCondition_GetEventEnableCondition_EvtInfo_DTC_0x901a01
        OpEventGetEventExtendedDataRecordEx_GetEventExtendedDataRecordEx_Event_DTC_0x901101: RteEventRef=OpEventGetEventExtendedDataRecordEx_GetEventExtendedDataRecordEx_Event_DTC_0x901101
        OpEventGetEventExtendedDataRecordEx_GetEventExtendedDataRecordEx_Event_DTC_0x901901: RteEventRef=OpEventGetEventExtendedDataRecordEx_GetEventExtendedDataRecordEx_Event_DTC_0x901901
        OpEventGetEventEnableCondition_GetEventEnableCondition_EvtInfo_DTC_0x901b01: RteEventRef=OpEventGetEventEnableCondition_GetEventEnableCondition_EvtInfo_DTC_0x901b01
        OpEventGetEventUdsStatus_GetEventUdsStatus_Event_DTC_0x901f01: RteEventRef=OpEventGetEventUdsStatus_GetEventUdsStatus_Event_DTC_0x901f01
        OpEventResetEventDebounceStatus_ResetEventDebounceStatus_Event_DTC_0x901201: RteEventRef=OpEventResetEventDebounceStatus_ResetEventDebounceStatus_Event_DTC_0x901201
        OpEventGetFaultDetectionCounter_GetFaultDetectionCounter_Event_DTC_0x901601: RteEventRef=OpEventGetFaultDetectionCounter_GetFaultDetectionCounter_Event_DTC_0x901601
        OpEventResetEventStatus_ResetEventStatus_Event_DTC_0x901e01: RteEventRef=OpEventResetEventStatus_ResetEventStatus_Event_DTC_0x901e01
        OpEventGetDebouncingOfEvent_GetDebouncingOfEvent_EvtInfo_DTC_0x901801: RteEventRef=OpEventGetDebouncingOfEvent_GetDebouncingOfEvent_EvtInfo_DTC_0x901801
        OpEventGetEventEnableCondition_GetEventEnableCondition_EvtInfo_DTC_0x901601: RteEventRef=OpEventGetEventEnableCondition_GetEventEnableCondition_EvtInfo_DTC_0x901601
        OpEventGetEventFailed_GetEventFailed_Event_DTC_0x901401: RteEventRef=OpEventGetEventFailed_GetEventFailed_Event_DTC_0x901401
        OpEventGetEventStatus_GetEventStatus_Event_DTC_0x901301: RteEventRef=OpEventGetEventStatus_GetEventStatus_Event_DTC_0x901301
        OpEventGetEventTested_GetEventTested_Event_DTC_0x901601: RteEventRef=OpEventGetEventTested_GetEventTested_Event_DTC_0x901601
        OpEventResetEventStatus_ResetEventStatus_Event_DTC_0x901f01: RteEventRef=OpEventResetEventStatus_ResetEventStatus_Event_DTC_0x901f01
        OpEventGetDebouncingOfEvent_GetDebouncingOfEvent_EvtInfo_DTC_0x901201: RteEventRef=OpEventGetDebouncingOfEvent_GetDebouncingOfEvent_EvtInfo_DTC_0x901201
        OpEventGetEventFailed_GetEventFailed_EvtInfo_DTC_0x901001: RteEventRef=OpEventGetEventFailed_GetEventFailed_EvtInfo_DTC_0x901001
        OpEventSetEventStatus_SetEventStatus_Event_DTC_0x901701: RteEventRef=OpEventSetEventStatus_SetEventStatus_Event_DTC_0x901701
        OpEventGetEventFailed_GetEventFailed_EvtInfo_DTC_0x901a01: RteEventRef=OpEventGetEventFailed_GetEventFailed_EvtInfo_DTC_0x901a01
        OpEventGetEventFailed_GetEventFailed_EvtInfo_DTC_0x901f01: RteEventRef=OpEventGetEventFailed_GetEventFailed_EvtInfo_DTC_0x901f01
        OpEventGetEventExtendedDataRecordEx_GetEventExtendedDataRecordEx_EvtInfo_DTC_0x901101: RteEventRef=OpEventGetEventExtendedDataRecordEx_GetEventExtendedDataRecordEx_EvtInfo_DTC_0x901101
        OpEventGetEventFailed_GetEventFailed_EvtInfo_DTC_0x901201: RteEventRef=OpEventGetEventFailed_GetEventFailed_EvtInfo_DTC_0x901201
        OpEventGetEventFailed_GetEventFailed_Event_DTC_0x902001: RteEventRef=OpEventGetEventFailed_GetEventFailed_Event_DTC_0x902001
        OpEventGetEventExtendedDataRecordEx_GetEventExtendedDataRecordEx_Event_DTC_0x901a01: RteEventRef=OpEventGetEventExtendedDataRecordEx_GetEventExtendedDataRecordEx_Event_DTC_0x901a01
        OpEventGetEventFailed_GetEventFailed_EvtInfo_DTC_0x901401: RteEventRef=OpEventGetEventFailed_GetEventFailed_EvtInfo_DTC_0x901401
        OpEventResetEventStatus_ResetEventStatus_Event_DTC_0x901101: RteEventRef=OpEventResetEventStatus_ResetEventStatus_Event_DTC_0x901101
        OpEventResetEventStatus_ResetEventStatus_Event_DTC_0x901301: RteEventRef=OpEventResetEventStatus_ResetEventStatus_Event_DTC_0x901301
        OpEventGetFaultDetectionCounter_GetFaultDetectionCounter_Event_DTC_0x901c01: RteEventRef=OpEventGetFaultDetectionCounter_GetFaultDetectionCounter_Event_DTC_0x901c01
        OpEventGetFaultDetectionCounter_GetFaultDetectionCounter_Event_DTC_0x901a01: RteEventRef=OpEventGetFaultDetectionCounter_GetFaultDetectionCounter_Event_DTC_0x901a01
        OpEventGetEventTested_GetEventTested_EvtInfo_DTC_0x902001: RteEventRef=OpEventGetEventTested_GetEventTested_EvtInfo_DTC_0x902001
        OpEventGetEventTested_GetEventTested_Event_DTC_0x901801: RteEventRef=OpEventGetEventTested_GetEventTested_Event_DTC_0x901801
        OpEventResetEventDebounceStatus_ResetEventDebounceStatus_Event_DTC_0x901901: RteEventRef=OpEventResetEventDebounceStatus_ResetEventDebounceStatus_Event_DTC_0x901901
        OpEventGetEventEnableCondition_GetEventEnableCondition_EvtInfo_DTC_0x901301: RteEventRef=OpEventGetEventEnableCondition_GetEventEnableCondition_EvtInfo_DTC_0x901301
        OpEventGetMonitorStatus_GetMonitorStatus_EvtInfo_DTC_0x901901: RteEventRef=OpEventGetMonitorStatus_GetMonitorStatus_EvtInfo_DTC_0x901901
        OpEventSetEventStatus_SetEventStatus_Event_DTC_0x901e01: RteEventRef=OpEventSetEventStatus_SetEventStatus_Event_DTC_0x901e01
        OpEventGetMonitorStatus_GetMonitorStatus_EvtInfo_DTC_0x901101: RteEventRef=OpEventGetMonitorStatus_GetMonitorStatus_EvtInfo_DTC_0x901101
        OpEventGetDTCOfEvent_GetDTCOfEvent_Event_DTC_0x901e01: RteEventRef=OpEventGetDTCOfEvent_GetDTCOfEvent_Event_DTC_0x901e01
        OpEventGetEventStatus_GetEventStatus_Event_DTC_0x901901: RteEventRef=OpEventGetEventStatus_GetEventStatus_Event_DTC_0x901901
        OpEventGetEventFreezeFrameDataEx_GetEventFreezeFrameDataEx_EvtInfo_DTC_0x901501: RteEventRef=OpEventGetEventFreezeFrameDataEx_GetEventFreezeFrameDataEx_EvtInfo_DTC_0x901501
        OpEventResetEventDebounceStatus_ResetEventDebounceStatus_Event_DTC_0x902101: RteEventRef=OpEventResetEventDebounceStatus_ResetEventDebounceStatus_Event_DTC_0x902101
        OpEventGetDebouncingOfEvent_GetDebouncingOfEvent_EvtInfo_DTC_0x901a01: RteEventRef=OpEventGetDebouncingOfEvent_GetDebouncingOfEvent_EvtInfo_DTC_0x901a01
        OpEventSetEventStatus_SetEventStatus_Event_DTC_0x901101: RteEventRef=OpEventSetEventStatus_SetEventStatus_Event_DTC_0x901101
        OpEventGetFaultDetectionCounter_GetFaultDetectionCounter_Event_DTC_0x901701: RteEventRef=OpEventGetFaultDetectionCounter_GetFaultDetectionCounter_Event_DTC_0x901701
        OpEventGetFaultDetectionCounter_GetFaultDetectionCounter_EvtInfo_DTC_0x901c01: RteEventRef=OpEventGetFaultDetectionCounter_GetFaultDetectionCounter_EvtInfo_DTC_0x901c01
        OpEventGetEventFreezeFrameDataEx_GetEventFreezeFrameDataEx_Event_DTC_0x902101: RteEventRef=OpEventGetEventFreezeFrameDataEx_GetEventFreezeFrameDataEx_Event_DTC_0x902101
        OpEventResetEventStatus_ResetEventStatus_Event_DTC_0x901d01: RteEventRef=OpEventResetEventStatus_ResetEventStatus_Event_DTC_0x901d01
        OpEventGetEventFreezeFrameDataEx_GetEventFreezeFrameDataEx_EvtInfo_DTC_0x901701: RteEventRef=OpEventGetEventFreezeFrameDataEx_GetEventFreezeFrameDataEx_EvtInfo_DTC_0x901701
        OpEventGetEventStatus_GetEventStatus_Event_DTC_0x901701: RteEventRef=OpEventGetEventStatus_GetEventStatus_Event_DTC_0x901701
        OpEventGetFaultDetectionCounter_GetFaultDetectionCounter_EvtInfo_DTC_0x902101: RteEventRef=OpEventGetFaultDetectionCounter_GetFaultDetectionCounter_EvtInfo_DTC_0x902101
        OpEventGetEventFreezeFrameDataEx_GetEventFreezeFrameDataEx_Event_DTC_0x901e01: RteEventRef=OpEventGetEventFreezeFrameDataEx_GetEventFreezeFrameDataEx_Event_DTC_0x901e01
        OpEventGetEventEnableCondition_GetEventEnableCondition_EvtInfo_DTC_0x901e01: RteEventRef=OpEventGetEventEnableCondition_GetEventEnableCondition_EvtInfo_DTC_0x901e01
        OpEventGetEventFreezeFrameDataEx_GetEventFreezeFrameDataEx_EvtInfo_DTC_0x901b01: RteEventRef=OpEventGetEventFreezeFrameDataEx_GetEventFreezeFrameDataEx_EvtInfo_DTC_0x901b01
        OpEventGetEventExtendedDataRecordEx_GetEventExtendedDataRecordEx_EvtInfo_DTC_0x901b01: RteEventRef=OpEventGetEventExtendedDataRecordEx_GetEventExtendedDataRecordEx_EvtInfo_DTC_0x901b01
        OpEventSetEventStatus_SetEventStatus_Event_DTC_0x901301: RteEventRef=OpEventSetEventStatus_SetEventStatus_Event_DTC_0x901301
        OpEventGetFaultDetectionCounter_GetFaultDetectionCounter_EvtInfo_DTC_0x901001: RteEventRef=OpEventGetFaultDetectionCounter_GetFaultDetectionCounter_EvtInfo_DTC_0x901001
        OpEventSetEventStatus_SetEventStatus_Event_DTC_0x901c01: RteEventRef=OpEventSetEventStatus_SetEventStatus_Event_DTC_0x901c01
        OpEventGetEventUdsStatus_GetEventUdsStatus_EvtInfo_DTC_0x901f01: RteEventRef=OpEventGetEventUdsStatus_GetEventUdsStatus_EvtInfo_DTC_0x901f01
        OpEventGetDTCOfEvent_GetDTCOfEvent_Event_DTC_0x901201: RteEventRef=OpEventGetDTCOfEvent_GetDTCOfEvent_Event_DTC_0x901201
        OpEventGetEventExtendedDataRecordEx_GetEventExtendedDataRecordEx_EvtInfo_DTC_0x901e01: RteEventRef=OpEventGetEventExtendedDataRecordEx_GetEventExtendedDataRecordEx_EvtInfo_DTC_0x901e01
        OpEventGetEventExtendedDataRecordEx_GetEventExtendedDataRecordEx_Event_DTC_0x901501: RteEventRef=OpEventGetEventExtendedDataRecordEx_GetEventExtendedDataRecordEx_Event_DTC_0x901501
        OpEventGetDTCOfEvent_GetDTCOfEvent_Event_DTC_0x901401: RteEventRef=OpEventGetDTCOfEvent_GetDTCOfEvent_Event_DTC_0x901401
        OpEventGetEventTested_GetEventTested_Event_DTC_0x901d01: RteEventRef=OpEventGetEventTested_GetEventTested_Event_DTC_0x901d01
        OpEventGetEventUdsStatus_GetEventUdsStatus_Event_DTC_0x902001: RteEventRef=OpEventGetEventUdsStatus_GetEventUdsStatus_Event_DTC_0x902001
        OpEventGetMonitorStatus_GetMonitorStatus_EvtInfo_DTC_0x901501: RteEventRef=OpEventGetMonitorStatus_GetMonitorStatus_EvtInfo_DTC_0x901501
        OpEventGetFaultDetectionCounter_GetFaultDetectionCounter_EvtInfo_DTC_0x901e01: RteEventRef=OpEventGetFaultDetectionCounter_GetFaultDetectionCounter_EvtInfo_DTC_0x901e01
        OpEventResetEventDebounceStatus_ResetEventDebounceStatus_Event_DTC_0x901a01: RteEventRef=OpEventResetEventDebounceStatus_ResetEventDebounceStatus_Event_DTC_0x901a01
        OpEventGetDebouncingOfEvent_GetDebouncingOfEvent_EvtInfo_DTC_0x901c01: RteEventRef=OpEventGetDebouncingOfEvent_GetDebouncingOfEvent_EvtInfo_DTC_0x901c01
        OpEventGetEventStatus_GetEventStatus_Event_DTC_0x901501: RteEventRef=OpEventGetEventStatus_GetEventStatus_Event_DTC_0x901501
        OpEventGetEventEnableCondition_GetEventEnableCondition_EvtInfo_DTC_0x901201: RteEventRef=OpEventGetEventEnableCondition_GetEventEnableCondition_EvtInfo_DTC_0x901201
        OpEventGetEventTested_GetEventTested_EvtInfo_DTC_0x901801: RteEventRef=OpEventGetEventTested_GetEventTested_EvtInfo_DTC_0x901801
        OpEventGetEventUdsStatus_GetEventUdsStatus_Event_DTC_0x901801: RteEventRef=OpEventGetEventUdsStatus_GetEventUdsStatus_Event_DTC_0x901801
        OpEventGetEventTested_GetEventTested_Event_DTC_0x902001: RteEventRef=OpEventGetEventTested_GetEventTested_Event_DTC_0x902001
        OpEventGetEventExtendedDataRecordEx_GetEventExtendedDataRecordEx_Event_DTC_0x901301: RteEventRef=OpEventGetEventExtendedDataRecordEx_GetEventExtendedDataRecordEx_Event_DTC_0x901301
        OpEventGetDTCOfEvent_GetDTCOfEvent_EvtInfo_DTC_0x901001: RteEventRef=OpEventGetDTCOfEvent_GetDTCOfEvent_EvtInfo_DTC_0x901001
        OpEventGetFaultDetectionCounter_GetFaultDetectionCounter_EvtInfo_DTC_0x901501: RteEventRef=OpEventGetFaultDetectionCounter_GetFaultDetectionCounter_EvtInfo_DTC_0x901501
        OpEventGetMonitorStatus_GetMonitorStatus_EvtInfo_DTC_0x901401: RteEventRef=OpEventGetMonitorStatus_GetMonitorStatus_EvtInfo_DTC_0x901401
        OpEventGetMonitorStatus_GetMonitorStatus_EvtInfo_DTC_0x901c01: RteEventRef=OpEventGetMonitorStatus_GetMonitorStatus_EvtInfo_DTC_0x901c01
        OpEventGetEventTested_GetEventTested_EvtInfo_DTC_0x901c01: RteEventRef=OpEventGetEventTested_GetEventTested_EvtInfo_DTC_0x901c01
        OpEventGetEventFailed_GetEventFailed_Event_DTC_0x901701: RteEventRef=OpEventGetEventFailed_GetEventFailed_Event_DTC_0x901701
        OpEventGetEventStatus_GetEventStatus_EvtInfo_DTC_0x901101: RteEventRef=OpEventGetEventStatus_GetEventStatus_EvtInfo_DTC_0x901101
        OpEventGetEventStatus_GetEventStatus_EvtInfo_DTC_0x901001: RteEventRef=OpEventGetEventStatus_GetEventStatus_EvtInfo_DTC_0x901001
        OpEventGetFaultDetectionCounter_GetFaultDetectionCounter_EvtInfo_DTC_0x901101: RteEventRef=OpEventGetFaultDetectionCounter_GetFaultDetectionCounter_EvtInfo_DTC_0x901101
        OpEventGetEventExtendedDataRecordEx_GetEventExtendedDataRecordEx_EvtInfo_DTC_0x901901: RteEventRef=OpEventGetEventExtendedDataRecordEx_GetEventExtendedDataRecordEx_EvtInfo_DTC_0x901901
        OpEventGetMonitorStatus_GetMonitorStatus_EvtInfo_DTC_0x901d01: RteEventRef=OpEventGetMonitorStatus_GetMonitorStatus_EvtInfo_DTC_0x901d01
        OpEventGetEventEnableCondition_GetEventEnableCondition_EvtInfo_DTC_0x901701: RteEventRef=OpEventGetEventEnableCondition_GetEventEnableCondition_EvtInfo_DTC_0x901701
