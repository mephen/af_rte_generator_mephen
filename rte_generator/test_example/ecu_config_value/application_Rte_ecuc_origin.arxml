[part 3 of 3: package /ActiveEcuC]
AUTOSAR XML (schema 00048)
package /ActiveEcuC  (continued)
  module config Rte: implementation-config-variant=VARIANT-POST-BUILD-SELECTABLE, module-description=Rte_Impl  (continued)
    9 x RteBswModuleInstance:
      CanIf: RteBswImplementationRef=CanIf_Impl, RteBswModuleConfigurationRef=CanIf
        8 x RteBswExclusiveAreaImpl:
          CANIF_EXCLUSIVE_AREA_0: RteExclusiveAreaImplMechanism=CUSTOM, RteBswExclusiveAreaRef=CANIF_EXCLUSIVE_AREA_0
          CANIF_EXCLUSIVE_AREA_{1..7}: RteExclusiveAreaImplMechanism=ALL_INTERRUPT_BLOCKING, RteBswExclusiveAreaRef=CANIF_EXCLUSIVE_AREA_{1..7}
      CanNm: RteBswImplementationRef=CanNm_Impl, RteBswModuleConfigurationRef=CanNm
        CanNm_MainFunctionTimingEvent0 (RteBswEventToTaskMapping):
          RteBswImmediateRestart = false
          RteBswPositionInTask = 6
          RteBswEventRef = CanNm_MainFunctionTimingEvent0
          RteBswMappedToTaskRef = OsTask_BswMainFunctions
          RteBswUsedOsEventRef = Rte_Ev_Cyclic2_OsTask_BswMainFunctions_0_10ms
          RteBswUsedOsAlarmRef = Rte_Al_TE2_OsTask_BswMainFunctions_0_10ms
        7 x RteBswExclusiveAreaImpl, all with RteExclusiveAreaImplMechanism=ALL_INTERRUPT_BLOCKING:
          CANNM_EXCLUSIVE_AREA_{0..6}: RteBswExclusiveAreaRef=CANNM_EXCLUSIVE_AREA_{0..6}
      CanSM: RteBswImplementationRef=CanSM_Impl, RteBswModuleConfigurationRef=CanSM
        CanSM_MainFunctionTimingEvent0 (RteBswEventToTaskMapping):
          RteBswImmediateRestart = false
          RteBswPositionInTask = 7
          RteBswEventRef = CanSM_MainFunctionTimingEvent0
          RteBswMappedToTaskRef = OsTask_BswMainFunctions
          RteBswUsedOsEventRef = Rte_Ev_Cyclic2_OsTask_BswMainFunctions_0_10ms
          RteBswUsedOsAlarmRef = Rte_Al_TE2_OsTask_BswMainFunctions_0_10ms
        6 x RteBswExclusiveAreaImpl:
          CANSM_EXCLUSIVE_AREA_1: RteExclusiveAreaImplMechanism=CUSTOM, RteBswExclusiveAreaRef=CANSM_EXCLUSIVE_AREA_1
          CANSM_EXCLUSIVE_AREA_2: RteExclusiveAreaImplMechanism=ALL_INTERRUPT_BLOCKING, RteBswExclusiveAreaRef=CANSM_EXCLUSIVE_AREA_2
          CANSM_EXCLUSIVE_AREA_3: RteExclusiveAreaImplMechanism=ALL_INTERRUPT_BLOCKING, RteBswExclusiveAreaRef=CANSM_EXCLUSIVE_AREA_3
          CANSM_EXCLUSIVE_AREA_4: RteExclusiveAreaImplMechanism=CUSTOM, RteBswExclusiveAreaRef=CANSM_EXCLUSIVE_AREA_4
          CANSM_EXCLUSIVE_AREA_5: RteExclusiveAreaImplMechanism=ALL_INTERRUPT_BLOCKING, RteBswExclusiveAreaRef=CANSM_EXCLUSIVE_AREA_5
          CANSM_EXCLUSIVE_AREA_6: RteExclusiveAreaImplMechanism=ALL_INTERRUPT_BLOCKING, RteBswExclusiveAreaRef=CANSM_EXCLUSIVE_AREA_6
      CanTp: RteBswImplementationRef=CanTp_Impl, RteBswModuleConfigurationRef=CanTp
        CanTp_MainFunctionTimingEvent0 (RteBswEventToTaskMapping):
          RteBswImmediateRestart = false
          RteBswPositionInTask = 0
          RteBswEventRef = CanTp_MainFunctionTimingEvent0
          RteBswMappedToTaskRef = OsTask_BswMainFunctions
          RteBswUsedOsEventRef = Rte_Ev_Run_CanTp_CanTp_MainFunction
          RteBswUsedOsAlarmRef = Rte_Al_TE_CanTp_CanTp_MainFunction
        CANTP_EXCLUSIVE_AREA_0 (RteBswExclusiveAreaImpl): RteExclusiveAreaImplMechanism=CUSTOM, RteBswExclusiveAreaRef=CANTP_EXCLUSIVE_AREA_0
      Com: RteBswImplementationRef=Com_Impl, RteBswModuleConfigurationRef=Com
        Com_MainFunctionTxTimingEvent0 (RteBswEventToTaskMapping):
          RteBswImmediateRestart = false
          RteBswPositionInTask = 9
          RteBswEventRef = Com_MainFunctionTxTimingEvent0
          RteBswMappedToTaskRef = OsTask_BswMainFunctions
          RteBswUsedOsEventRef = Rte_Ev_Cyclic2_OsTask_BswMainFunctions_0_10ms
          RteBswUsedOsAlarmRef = Rte_Al_TE2_OsTask_BswMainFunctions_0_10ms
        Com_MainFunctionRxTimingEvent0 (RteBswEventToTaskMapping):
          RteBswImmediateRestart = false
          RteBswPositionInTask = 8
          RteBswEventRef = Com_MainFunctionRxTimingEvent0
          RteBswMappedToTaskRef = OsTask_BswMainFunctions
          RteBswUsedOsEventRef = Rte_Ev_Cyclic2_OsTask_BswMainFunctions_0_10ms
          RteBswUsedOsAlarmRef = Rte_Al_TE2_OsTask_BswMainFunctions_0_10ms
        3 x RteBswExclusiveAreaImpl, all with RteExclusiveAreaImplMechanism=ALL_INTERRUPT_BLOCKING:
          COM_EXCLUSIVE_AREA_TX: RteBswExclusiveAreaRef=COM_EXCLUSIVE_AREA_TX
          COM_EXCLUSIVE_AREA_RX: RteBswExclusiveAreaRef=COM_EXCLUSIVE_AREA_RX
          COM_EXCLUSIVE_AREA_BOTH: RteBswExclusiveAreaRef=COM_EXCLUSIVE_AREA_BOTH
      ComM: RteBswImplementationRef=ComM_Impl, RteBswModuleConfigurationRef=ComM
        ComM_MainFunction_0TimingEvent0 (RteBswEventToTaskMapping):
          RteBswImmediateRestart = false
          RteBswPositionInTask = 17
          RteBswEventRef = ComM_MainFunction_0TimingEvent0
          RteBswMappedToTaskRef = OsTask_BswMainFunctions
          RteBswUsedOsEventRef = Rte_Ev_Cyclic2_OsTask_BswMainFunctions_0_20ms
          RteBswUsedOsAlarmRef = Rte_Al_TE2_OsTask_BswMainFunctions_0_20ms
        COMM_EXCLUSIVE_AREA_0 (RteBswExclusiveAreaImpl): RteExclusiveAreaImplMechanism=ALL_INTERRUPT_BLOCKING, RteBswExclusiveAreaRef=COMM_EXCLUSIVE_AREA_0
        COMM_EXCLUSIVE_AREA_1 (RteBswExclusiveAreaImpl): RteExclusiveAreaImplMechanism=CUSTOM, RteBswExclusiveAreaRef=COMM_EXCLUSIVE_AREA_1
      Dcm: RteBswImplementationRef=Dcm_Impl, RteBswModuleConfigurationRef=Dcm
        Dcm_MainFunctionTimingEvent0 (RteBswEventToTaskMapping):
          RteBswImmediateRestart = false
          RteBswPositionInTask = 11
          RteBswEventRef = Dcm_MainFunctionTimingEvent0
          RteBswMappedToTaskRef = OsTask_BswMainFunctions
          RteBswUsedOsEventRef = Rte_Ev_Cyclic2_OsTask_BswMainFunctions_0_10ms
          RteBswUsedOsAlarmRef = Rte_Al_TE2_OsTask_BswMainFunctions_0_10ms
        DCM_EXCLUSIVE_AREA_0 (RteBswExclusiveAreaImpl): RteExclusiveAreaImplMechanism=ALL_INTERRUPT_BLOCKING, RteBswExclusiveAreaRef=DCM_EXCLUSIVE_AREA_0
      Nm: RteBswImplementationRef=Nm_Impl, RteBswModuleConfigurationRef=Nm
        NM_EXCLUSIVE_AREA_0 (RteBswExclusiveAreaImpl): RteExclusiveAreaImplMechanism=ALL_INTERRUPT_BLOCKING, RteBswExclusiveAreaRef=NM_EXCLUSIVE_AREA_0
        NM_EXCLUSIVE_AREA_1 (RteBswExclusiveAreaImpl): RteExclusiveAreaImplMechanism=ALL_INTERRUPT_BLOCKING, RteBswExclusiveAreaRef=NM_EXCLUSIVE_AREA_1
      PduR: RteBswImplementationRef=PduR_Impl, RteBswModuleConfigurationRef=PduR
        PDUR_EXCLUSIVE_AREA_0 (RteBswExclusiveAreaImpl): RteExclusiveAreaImplMechanism=ALL_INTERRUPT_BLOCKING, RteBswExclusiveAreaRef=PDUR_EXCLUSIVE_AREA_0
    Dcm_EcuSwComposition (RteSwComponentInstance): RteSoftwareComponentInstanceRef=Dcm
      7 x RteEventToTaskMapping, all with RteImmediateRestart=false:
        Timer_Dcm_MainFunction: RtePositionInTask=11, RteEventRef=Timer_Dcm_MainFunction, RteMappedToTaskRef=OsTask_BswMainFunctions, RteUsedOsEventRef=Rte_Ev_Cyclic2_OsTask_BswMainFunctions_0_10ms, RteUsedOsAlarmRef=Rte_Al_TE2_OsTask_BswMainFunctions_0_10ms
        OpEventGetActiveProtocol_GetActiveProtocol_DCMServices: RteEventRef=OpEventGetActiveProtocol_GetActiveProtocol_DCMServices
        OpEventGetSesCtrlType_GetSesCtrlType_DCMServices: RteEventRef=OpEventGetSesCtrlType_GetSesCtrlType_DCMServices
        OpEventResetToDefaultSession_ResetToDefaultSession_DCMServices: RteEventRef=OpEventResetToDefaultSession_ResetToDefaultSession_DCMServices
        OpEventSetActiveDiagnostic_SetActiveDiagnostic_DCMServices: RteEventRef=OpEventSetActiveDiagnostic_SetActiveDiagnostic_DCMServices
        OpEventGetRequestKind_GetRequestKind_DCMServices: RteEventRef=OpEventGetRequestKind_GetRequestKind_DCMServices
        OpEventGetSecurityLevel_GetSecurityLevel_DCMServices: RteEventRef=OpEventGetSecurityLevel_GetSecurityLevel_DCMServices
    CanTrcv (RteBswModuleInstance): RteBswImplementationRef=CanTrcv_Impl, RteBswModuleConfigurationRef=CanTrcv
      CanTrcv_30_Tja1043_MainFunctionTimingEvent0 (RteBswEventToTaskMapping):
        RteBswImmediateRestart = false
        RteBswPositionInTask = 12
        RteBswEventRef = CanTrcv_30_Tja1043_MainFunctionTimingEvent0
        RteBswMappedToTaskRef = OsTask_BswMainFunctions
        RteBswUsedOsEventRef = Rte_Ev_Cyclic2_OsTask_BswMainFunctions_0_10ms
        RteBswUsedOsAlarmRef = Rte_Al_TE2_OsTask_BswMainFunctions_0_10ms
      CANTRCV_30_TJA1043_EXCLUSIVE_AREA_0 (RteBswExclusiveAreaImpl): RteExclusiveAreaImplMechanism=ALL_INTERRUPT_BLOCKING, RteBswExclusiveAreaRef=CANTRCV_30_TJA1043_EXCLUSIVE_AREA_0
    CddHeadUnitInterface_EcuSwComposition (RteSwComponentInstance): RteSoftwareComponentInstanceRef=CddHeadUnitInterface
      3 x RteEventToTaskMapping, all with RteImmediateRestart=false:
        MST_CddHeadUnitInterface_Init_0: RtePositionInTask=33, RteEventRef=MST_CddHeadUnitInterface_Init_0, RteMappedToTaskRef=OsTask_ApplInitDeInit, RteUsedOsEventRef=Rte_Ev_OnExit_OsTask_ApplInitDeInit_SwcDisplayControl_PpSwcDispCtrlDisplayMode_Mode_UNINIT
        OIT_PpRsCddHeadUnitInterfaceSimulateResetTrigger_Start_PpRsCddHeadUnitInterfaceSimulateResetTrigger_Start: RteEventRef=OIT_PpRsCddHeadUnitInterfaceSimulateResetTrigger_Start_PpRsCddHeadUnitInterfaceSimulateResetTrigger_Start
        OIT_PpCddHeadUnitInterfaceVersionInfo_GetVersionInfo_PpCddHeadUnitInterfaceVersionInfo_GetVersionInfo: RteEventRef=OIT_PpCddHeadUnitInterfaceVersionInfo_GetVersionInfo_PpCddHeadUnitInterfaceVersionInfo_GetVersionInfo
      EACddHUIfDeviceAccess (RteExclusiveAreaImplementation):
        RteExclusiveAreaImplMechanism = OS_RESOURCE
        RteExclusiveAreaRef = EACddHUIfDeviceAccess
        RteExclusiveAreaOsResourceRef = Rte_Res_CddHeadUnitInterface_EACddHUIfDeviceAccess
      6 x RteEventToTaskMapping, all with RteImmediateRestart=false:
        OIT_PpCddHUIfDeviceAccess_SetDeviceAccess_PpCddHUIfDeviceAccess_SetDeviceAccess: RteEventRef=OIT_PpCddHUIfDeviceAccess_SetDeviceAccess_PpCddHUIfDeviceAccess_SetDeviceAccess
        DRT_Runnable_PpCddBtnButtonStatus_status: RtePositionInTask=36, RteEventRef=DRT_Runnable_PpCddBtnButtonStatus_status, RteMappedToTaskRef=OsTask_Communication, RteUsedOsEventRef=Rte_Ev_Run_CddHeadUnitInterface_CddHUIf_ProcessButtonStatus
        TMTCddHUIfOnButtonHold: RteCyclicTriggerImplementation=None, RtePositionInTask=6, RteEventRef=TMTCddHUIfOnButtonHold, RteMappedToTaskRef=OsTask_Touch, RteUsedOsEventRef=Rte_Ev_Run1_CddHeadUnitInterface_CddHUIf_OnButtonHold
        TMTCddHUIfOnZrResetComplete: RteCyclicTriggerImplementation=None, RtePositionInTask=7, RteEventRef=TMTCddHUIfOnZrResetComplete, RteMappedToTaskRef=OsTask_Touch, RteUsedOsEventRef=Rte_Ev_Run1_CddHeadUnitInterface_CddHUIf_OnZrResetComplete
        MST_CddHUIf_Deinit_0: RtePositionInTask=67, RteEventRef=MST_CddHUIf_Deinit_0, RteMappedToTaskRef=OsTask_ApplInitDeInit, RteUsedOsEventRef=Rte_Ev_OnEntry_OsTask_ApplInitDeInit_SwcDisplayControl_PpSwcDispCtrlDisplayMode_Mode_UNINIT
        MST_CddHUIf_Init_1: RtePositionInTask=33, RteEventRef=MST_CddHUIf_Init_1, RteMappedToTaskRef=OsTask_ApplInitDeInit, RteUsedOsEventRef=Rte_Ev_OnExit_OsTask_ApplInitDeInit_SwcDisplayControl_PpSwcDispCtrlDisplayMode_Mode_OFF
    CddHeadUnitInterface (RteSwComponentType): RteComponentTypeRef=CddHeadUnitInterface, RteImplementationRef=CddHeadUnitInterface_Implementation
      ComponentTypeCalibration (RteComponentTypeCalibration): RteCalibrationSupportEnabled=false
    CddWatchdogInterface_EcuSwComposition (RteSwComponentInstance): RteSoftwareComponentInstanceRef=CddWatchdogInterface
      13 x RteEventToTaskMapping, all with RteImmediateRestart=false:
        OIT_PpWatchdogControl_GetWatchdogPeriod_PpWatchdogControl_GetWatchdogPeriod: RteEventRef=OIT_PpWatchdogControl_GetWatchdogPeriod_PpWatchdogControl_GetWatchdogPeriod
        OIT_PpWatchdogControl_SetWatchdogPeriod_PpWatchdogControl_SetWatchdogPeriod: RteEventRef=OIT_PpWatchdogControl_SetWatchdogPeriod_PpWatchdogControl_SetWatchdogPeriod
        OIT_PpCddWatchdogInterfaceVersionInfo_GetVersionInfo_PpCddWatchdogInterfaceVersionInfo_GetVersionInfo: RteEventRef=OIT_PpCddWatchdogInterfaceVersionInfo_GetVersionInfo_PpCddWatchdogInterfaceVersionInfo_GetVersionInfo
        OIT_PpWatchdogControl_TriggerWatchdog_PpWatchdogControl_TriggerWatchdog: RteEventRef=OIT_PpWatchdogControl_TriggerWatchdog_PpWatchdogControl_TriggerWatchdog
        OIT_PpCddWdgIfDeviceAccess_SetDeviceAccess_PpCddWdgIfDeviceAccess_SetDeviceAccess: RteEventRef=OIT_PpCddWdgIfDeviceAccess_SetDeviceAccess_PpCddWdgIfDeviceAccess_SetDeviceAccess
        MSECddWdgIfInit_0: RtePositionInTask=34, RteEventRef=MSECddWdgIfInit_0, RteMappedToTaskRef=OsTask_ApplInitDeInit, RteUsedOsEventRef=Rte_Ev_OnExit_OsTask_ApplInitDeInit_SwcDisplayControl_PpSwcDispCtrlDisplayMode_Mode_UNINIT
        MSECddWdgIfInit_1: RtePositionInTask=34, RteEventRef=MSECddWdgIfInit_1, RteMappedToTaskRef=OsTask_ApplInitDeInit, RteUsedOsEventRef=Rte_Ev_OnExit_OsTask_ApplInitDeInit_SwcDisplayControl_PpSwcDispCtrlDisplayMode_Mode_OFF
        OIT_PpRsCddWdgIfWatchdogTriggering_Stop_PpRsCddWdgIfWatchdogTriggering_Stop: RteEventRef=OIT_PpRsCddWdgIfWatchdogTriggering_Stop_PpRsCddWdgIfWatchdogTriggering_Stop
        OIT_PpRsCddWdgIfWatchdogTriggering_Start_PpRsCddWdgIfWatchdogTriggering_Start: RteEventRef=OIT_PpRsCddWdgIfWatchdogTriggering_Start_PpRsCddWdgIfWatchdogTriggering_Start
        OIT_PpRsCddWdgIfSimulateWatchdogPeriod_Stop_PpRsCddWdgIfSimulateWatchdogPeriod_Stop: RteEventRef=OIT_PpRsCddWdgIfSimulateWatchdogPeriod_Stop_PpRsCddWdgIfSimulateWatchdogPeriod_Stop
        OIT_PpRsCddWdgIfSimulateWatchdogPeriod_Start_PpRsCddWdgIfSimulateWatchdogPeriod_Start: RteEventRef=OIT_PpRsCddWdgIfSimulateWatchdogPeriod_Start_PpRsCddWdgIfSimulateWatchdogPeriod_Start
        BECddWdgIfTriggerWatchDogs_001: RtePositionInTask=1, RteEventRef=BECddWdgIfTriggerWatchDogs, RteMappedToTaskRef=OsTask_Background
        BECddWdgIfTriggerWatchDogs: RtePositionInTask=1, RteEventRef=BECddWdgIfTriggerWatchDogs, RteMappedToTaskRef=OsTask_Background
    CddWatchdogInterface (RteSwComponentType): RteComponentTypeRef=CddWatchdogInterface, RteImplementationRef=CddWatchdogInterface_Implementation
      ComponentTypeCalibration (RteComponentTypeCalibration): RteCalibrationSupportEnabled=false
    CddDeserializerTIDS90Ux948_EcuSwComposition (RteSwComponentInstance): RteSoftwareComponentInstanceRef=CddDeserializerTIDS90Ux948
      14 x RteEventToTaskMapping, all with RteImmediateRestart=false:
        TMT_CddDeserializerTIDS90Ux948_MainFunction: RtePositionInTask=19, RteEventRef=TECddDserMainFunction, RteMappedToTaskRef=OsTask_ApplMainFunctions, RteUsedOsEventRef=Rte_Ev_Cyclic_OsTask_ApplMainFunctions_0_1ms, RteUsedOsAlarmRef=Rte_Al_TE_OsTask_ApplMainFunctions_0_1ms
        MST_CddDeserializerTIDS90Ux948_Init_0: RtePositionInTask=11, RteEventRef=MSECddDserInit_0, RteMappedToTaskRef=OsTask_ApplInitDeInit, RteUsedOsEventRef=Rte_Ev_OnExit_OsTask_ApplInitDeInit_SwcDisplayControl_PpSwcDispCtrlDisplayMode_Mode_UNINIT
        OIT_PpDeserializerTestPattern_SetTestPattern_PpDeserializerTestPattern_SetTestPattern: RteEventRef=OIT_PpDeserializerTestPattern_SetTestPattern_PpDeserializerTestPattern_SetTestPattern
        TMT_CddDeserializerTIDS90Ux948_InitRegisters: RtePositionInTask=1, RteEventRef=TECddDserPowerControl, RteMappedToTaskRef=OsTask_ApplTimedInitDeInit, RteUsedOsEventRef=Rte_Ev_Cyclic_OsTask_ApplTimedInitDeInit_0_1ms, RteUsedOsAlarmRef=Rte_Al_TE_OsTask_ApplTimedInitDeInit_0_1ms
        OIT_PpCddDeserializerTIDS90Ux948VersionInfo_GetVersionInfo_PpCddDeserializerTIDS90Ux948VersionInfo_GetVersionInfo: RteEventRef=OIT_PpCddDeserializerTIDS90Ux948VersionInfo_GetVersionInfo_PpCddDeserializerTIDS90Ux948VersionInfo_GetVersionInfo
        OIT_PpRsCddDeserializerTIDS90Ux948Read_Start_PpRsCddDeserializerTIDS90Ux948Read_Start: RteEventRef=OIT_PpRsCddDeserializerTIDS90Ux948Read_Start_PpRsCddDeserializerTIDS90Ux948Read_Start
        OIT_PpRsCddDeserializerTIDS90Ux948Write_Start_PpRsCddDeserializerTIDS90Ux948Write_Start: RteEventRef=OIT_PpRsCddDeserializerTIDS90Ux948Write_Start_PpRsCddDeserializerTIDS90Ux948Write_Start
        OIT_PpRsCddDeserializerTIDS90Ux948LvdsLockSimulation_Stop_PpRsCddDeserializerTIDS90Ux948LvdsLockSimulation_Stop: RteEventRef=OIT_PpRsCddDeserializerTIDS90Ux948LvdsLockSimulation_Stop_PpRsCddDeserializerTIDS90Ux948LvdsLockSimulation_Stop
        OIT_PpRsCddDeserializerTIDS90Ux948LvdsLockSimulation_Start_PpRsCddDeserializerTIDS90Ux948LvdsLockSimulation_Start: RteEventRef=OIT_PpRsCddDeserializerTIDS90Ux948LvdsLockSimulation_Start_PpRsCddDeserializerTIDS90Ux948LvdsLockSimulation_Start
        DRT_CddDser_OnModeRequest_PpCddDeserModeRequest_requestedMode: RtePositionInTask=10, RteEventRef=DRECddDserSwcDispCtrlModeReq, RteMappedToTaskRef=OsTask_ApplMainFunctions, RteUsedOsEventRef=Rte_Ev_Run_CddDeserializerTIDS90Ux948_CddDser_ProcessSwcDispCtrlModeReq
        OIT_PpCddBstrDeviceAccess_SetDeviceAccess_PpCddBstrDeviceAccess_SetDeviceAccess: RteEventRef=OIT_PpCddBstrDeviceAccess_SetDeviceAccess_PpCddBstrDeviceAccess_SetDeviceAccess
        MST_CddDser_DeInit_0: RtePositionInTask=66, RteEventRef=MSECddDserDeinit, RteMappedToTaskRef=OsTask_ApplInitDeInit, RteUsedOsEventRef=Rte_Ev_OnEntry_OsTask_ApplInitDeInit_SwcDisplayControl_PpSwcDispCtrlDisplayMode_Mode_UNINIT
        MST_CddDser_Init_1: RtePositionInTask=11, RteEventRef=MSECddDserInit, RteMappedToTaskRef=OsTask_ApplInitDeInit, RteUsedOsEventRef=Rte_Ev_OnExit_OsTask_ApplInitDeInit_SwcDisplayControl_PpSwcDispCtrlDisplayMode_Mode_OFF
        MST_CddDser_OnEntryDcmDefaultSession_0: RtePositionInTask=4, RteEventRef=MSECddDserOnEnterDefaultSession, RteMappedToTaskRef=OsTask_DcmSessionChanges, RteUsedOsEventRef=Rte_Ev_OnEntry_OsTask_DcmSessionChanges_Dcm_DcmDiagnosticSessionControl_DcmDiagnosticSessionControl_DEFAULT_SESSION
    CddDeserializerTIDS90Ux948 (RteSwComponentType): RteComponentTypeRef=CddDeserializerTIDS90Ux948, RteImplementationRef=CddDeserializerTIDS90Ux948_Implementation
      ComponentTypeCalibration (RteComponentTypeCalibration): RteCalibrationSupportEnabled=false
    CddTouchCypressGen7_EcuSwComposition (RteSwComponentInstance): RteSoftwareComponentInstanceRef=CddTouchCypressGen7
      9 x RteEventToTaskMapping, all with RteImmediateRestart=false:
        OIT_PpRsCddTouchCypressGen7MtkMode_RequestResults_PpRsCddTouchCypressGen7MtkMode_RequestResults: RtePositionInTask=14, RteCyclicTriggerImplementation=None, RteEventRef=OIT_PpRsCddTouchCypressGen7MtkMode_RequestResults_PpRsCddTouchCypressGen7MtkMode_RequestResults
        TESwcTouchTimeout: RteCyclicTriggerImplementation=None, RtePositionInTask=4, RteEventRef=TECddTouchTimeout, RteMappedToTaskRef=OsTask_ApplMainFunctions, RteUsedOsEventRef=Rte_Ev_Run1_CddTouchCypressGen7_CddTouch_Timeout
        OIT_PpCddTouchCypressGen7VersionInfo_GetVersionInfo_PpCddTouchCypressGen7VersionInfo_GetVersionInfo: RteEventRef=OIT_PpCddTouchCypressGen7VersionInfo_GetVersionInfo_PpCddTouchCypressGen7VersionInfo_GetVersionInfo
        DRECddTouchModeReq_mode: RtePositionInTask=11, RteEventRef=DRECddTouchModeReq_mode, RteMappedToTaskRef=OsTask_ApplMainFunctions, RteUsedOsEventRef=Rte_Ev_Run_CddTouchCypressGen7_CddTouch_ModeReq
        OIT_PpCddTouchDeviceAccess_SetDeviceAccess_PpCddTouchDeviceAccess_SetDeviceAccess: RteEventRef=OIT_PpCddTouchDeviceAccess_SetDeviceAccess_PpCddTouchDeviceAccess_SetDeviceAccess
        DRECddTouchModeReq_reqActive: RtePositionInTask=11, RteEventRef=DRECddTouchModeReq_reqActive, RteMappedToTaskRef=OsTask_ApplMainFunctions, RteUsedOsEventRef=Rte_Ev_Run_CddTouchCypressGen7_CddTouch_ModeReq
        OIT_PpCddTouchSimulation_Stop_PpCddTouchSimulation_Stop: RteEventRef=OIT_PpCddTouchSimulation_Stop_PpCddTouchSimulation_Stop
        OIT_PpCddTouchSimulation_SendData_PpCddTouchSimulation_SendData: RteEventRef=OIT_PpCddTouchSimulation_SendData_PpCddTouchSimulation_SendData
        OIT_PpCddTouchSimulation_Start_PpCddTouchSimulation_Start: RteEventRef=OIT_PpCddTouchSimulation_Start_PpCddTouchSimulation_Start
      EACddTouchComm (RteExclusiveAreaImplementation): RteExclusiveAreaImplMechanism=OS_INTERRUPT_BLOCKING, RteExclusiveAreaRef=EACddTouchComm
      14 x RteEventToTaskMapping, all with RteImmediateRestart=false:
        OIT_CddTouch_PpRsCddTouchWrite_Start_PpRsCddTouchWrite_Start: RteEventRef=OIT_CddTouch_PpRsCddTouchWrite_Start_PpRsCddTouchWrite_Start
        OIT_CddTouch_PpRsCddTouchCalibrateTouchSensor_Start_PpRsCddTouchCalibrateTouchSensor_Start: RteEventRef=OIT_CddTouch_PpRsCddTouchCalibrateTouchSensor_Start_PpRsCddTouchCalibrateTouchSensor_Start
        OIT_CddTouch_PpDsCddTouchSliderTouchConfiguration_WriteData_PpDsCddTouchSliderTouchConfiguration_WriteData: RteEventRef=OIT_CddTouch_PpDsCddTouchSliderTouchConfiguration_WriteData_PpDsCddTouchSliderTouchConfiguration_WriteData
        OIT_CddTouch_PpDsCddTouchSliderTouchConfiguration_ReadData_PpDsCddTouchSliderTouchConfiguration_ReadData: RteEventRef=OIT_CddTouch_PpDsCddTouchSliderTouchConfiguration_ReadData_PpDsCddTouchSliderTouchConfiguration_ReadData
        OIT_CddTouch_PpRsCddTouchGetRamParameter_Start_PpRsCddTouchGetRamParameter_Start: RteEventRef=OIT_CddTouch_PpRsCddTouchGetRamParameter_Start_PpRsCddTouchGetRamParameter_Start
        OIT_CddTouch_PpRsCddTouchRead_Start_PpRsCddTouchRead_Start: RteEventRef=OIT_CddTouch_PpRsCddTouchRead_Start_PpRsCddTouchRead_Start
        OIT_CddTouch_PpRsCddTouchCypressGen7MtkMode_Stop_PpRsCddTouchCypressGen7MtkMode_Stop: RteEventRef=OIT_CddTouch_PpRsCddTouchCypressGen7MtkMode_Stop_PpRsCddTouchCypressGen7MtkMode_Stop
        OIT_CddTouch_PpRsCddTouchCypressGen7MtkMode_Start_PpRsCddTouchCypressGen7MtkMode_Start: RteEventRef=OIT_CddTouch_PpRsCddTouchCypressGen7MtkMode_Start_PpRsCddTouchCypressGen7MtkMode_Start
        OIT_CddTouch_PpDsCddTouchDisplayTouchConfiguration_WriteData_PpDsCddTouchDisplayTouchConfiguration_WriteData: RteEventRef=OIT_CddTouch_PpDsCddTouchDisplayTouchConfiguration_WriteData_PpDsCddTouchDisplayTouchConfiguration_WriteData
        OIT_CddTouch_PpDsCddTouchDisplayTouchConfiguration_ReadData_PpDsCddTouchDisplayTouchConfiguration_ReadData: RteEventRef=OIT_CddTouch_PpDsCddTouchDisplayTouchConfiguration_ReadData_PpDsCddTouchDisplayTouchConfiguration_ReadData
        OIT_CddTouch_PpRsCddTouchSetRamParameter_Start_PpRsCddTouchSetRamParameter_Start: RteEventRef=OIT_CddTouch_PpRsCddTouchSetRamParameter_Start_PpRsCddTouchSetRamParameter_Start
        MSECddTouchDefaultSession: RtePositionInTask=12, RteEventRef=MSECddTouchDefaultSession, RteMappedToTaskRef=OsTask_DcmSessionChanges, RteUsedOsEventRef=Rte_Ev_OnEntry_OsTask_DcmSessionChanges_Dcm_DcmDiagnosticSessionControl_DcmDiagnosticSessionControl_DEFAULT_SESSION
        MSECddTouchInit_2: RtePositionInTask=9, RteEventRef=MSECddTouchInit_2, RteUsedOsEventRef=Rte_Ev_OnExit_OsTask_ApplInitDeInit_SwcDisplayControl_PpSwcDispCtrlDisplayMode_Mode_UNINIT, RteMappedToTaskRef=OsTask_ApplInitDeInit
        MSECddTouchInit_1: RtePositionInTask=9, RteEventRef=MSECddTouchInit_1, RteUsedOsEventRef=Rte_Ev_OnExit_OsTask_ApplInitDeInit_SwcDisplayControl_PpSwcDispCtrlDisplayMode_Mode_OFF, RteMappedToTaskRef=OsTask_ApplInitDeInit
      EACddTouchMode (RteExclusiveAreaImplementation):
        RteExclusiveAreaImplMechanism = OS_RESOURCE
        RteExclusiveAreaRef = EACddTouchMode
        RteExclusiveAreaOsResourceRef = Rte_Res_CddTouchCypressGen7_EACddTouchMode
      EACddTouchTrigger (RteExclusiveAreaImplementation):
        RteExclusiveAreaImplMechanism = OS_RESOURCE
        RteExclusiveAreaRef = EACddTouchTrigger
        RteExclusiveAreaOsResourceRef = Rte_Res_CddTouchCypressGen7_EACddTouchTrigger
      MSECddTouchDeInit_001 (RteEventToTaskMapping):
        RteImmediateRestart = false
        RtePositionInTask = 70
        RteEventRef = MSECddTouchDeInit
        RteMappedToTaskRef = OsTask_ApplInitDeInit
        RteUsedOsEventRef = Rte_Ev_OnEntry_OsTask_ApplInitDeInit_SwcDisplayControl_PpSwcDispCtrlDisplayMode_Mode_UNINIT
      TECddTouchMainFunction (RteEventToTaskMapping):
        RteImmediateRestart = false
        RtePositionInTask = 16
        RteEventRef = TECddTouchMainFunction
        RteUsedOsAlarmRef = Rte_Al_TE_OsTask_ApplMainFunctions_0_1ms
        RteUsedOsEventRef = Rte_Ev_Cyclic_OsTask_ApplMainFunctions_0_1ms
        RteMappedToTaskRef = OsTask_ApplMainFunctions
    CddTouchCypressGen7 (RteSwComponentType): RteComponentTypeRef=CddTouchCypressGen7, RteImplementationRef=CddTouchCypressGen7_Implementation
      ComponentTypeCalibration (RteComponentTypeCalibration): RteCalibrationSupportEnabled=false
    3 x RteSwComponentInstance:
      CddDownloadManager_EcuSwComposition: RteSoftwareComponentInstanceRef=CddDownloadManager
        34 x RteEventToTaskMapping, all with RteImmediateRestart=false:
          TMT_CddDownloadManager_MainFunction: RtePositionInTask=35, RteEventRef=TECddDlMngrMainFunction, RteMappedToTaskRef=OsTask_ApplMainFunctions, RteUsedOsEventRef=Rte_Ev_Cyclic_OsTask_ApplMainFunctions_0_10ms, RteUsedOsAlarmRef=Rte_Al_TE_OsTask_ApplMainFunctions_0_10ms
          MST_CddDownloadManager_OnEntryDcmDefaultSession_0: RtePositionInTask=2, RteEventRef=MSECddDlMngrOnEntryDcmDefaultSession, RteMappedToTaskRef=OsTask_DcmSessionChanges, RteUsedOsEventRef=Rte_Ev_OnEntry_OsTask_DcmSessionChanges_Dcm_DcmDiagnosticSessionControl_DcmDiagnosticSessionControl_DEFAULT_SESSION
          MST_CddDownloadManager_OnEntryDcmProgrammingSession_0: RtePositionInTask=0, RteEventRef=MSECddDlMngrOnEntryDcmProgrammingSession, RteMappedToTaskRef=OsTask_DcmSessionChanges, RteUsedOsEventRef=Rte_Ev_Run_CddDownloadManager_CddDlMngr_OnEntryProgrammingSession
          MST_CddDownloadManager_OnExitDcmProgrammingSession_0: RtePositionInTask=1, RteEventRef=MSECddDlMngrOnExitDcmProgrammingSession, RteMappedToTaskRef=OsTask_DcmSessionChanges, RteUsedOsEventRef=Rte_Ev_Run_CddDownloadManager_CddDlMngr_OnExitProgrammingSession
          MST_CddDownloadManager_Init_0: RtePositionInTask=37, RteEventRef=MSECddDlMngrInit_0, RteMappedToTaskRef=OsTask_ApplInitDeInit, RteUsedOsEventRef=Rte_Ev_OnExit_OsTask_ApplInitDeInit_SwcDisplayControl_PpSwcDispCtrlDisplayMode_Mode_UNINIT
          OIT_PpCddDownloadManagerVersionInfo_GetVersionInfo_PpCddDownloadManagerVersionInfo_GetVersionInfo: RteEventRef=OIT_PpSwcDownloadManagerVersionInfo_GetVersionInfo_PpSwcDownloadManagerVersionInfo_GetVersionInfo
          OIT_DataServices_ECUProgrammingInformation_Read_Info_ConditionCheckRead_DataServices_ECUProgrammingInformation_Read_Info87B3EC14: RteEventRef=OIT_DataServices_ECUProgrammingInformation_Read_Info_ConditionCheckRead_DataServices_ECUProgrammingInformation_Read_Info87B3EC14
          OIT_DataServices_ECUProgrammingInformation_Read_Info_ReadData_DataServices_ECUProgrammingInformation_Read_Info_ReadData: RteEventRef=OIT_DataServices_ECUProgrammingInformation_Read_Info_ReadData_DataServices_ECUProgrammingInformation_Read_Info_ReadData
          OIT_DataServices_ProgrammingPreconditions_Read_ProgrammingPreconditions_ConditionCheckRead_DataServices_ProgrammingPrecoB0EB405E: RteEventRef=OIT_DataServices_ProgrammingPreconditions_Read_ProgrammingPreconditions_ConditionCheckRead_DataServices_ProgrammingPrecoB0EB405E
          OIT_DataServices_ProgrammingPreconditions_Read_ProgrammingPreconditions_ReadData_DataServices_ProgrammingPreconditions_R8723A711: RteEventRef=OIT_DataServices_ProgrammingPreconditions_Read_ProgrammingPreconditions_ReadData_DataServices_ProgrammingPreconditions_R8723A711
          OIT_DataServices_FDS_Project_Data_Read_Data_ConditionCheckRead_DataServices_FDS_Project_Data_Read_Data_ConditionCheckRead: RteEventRef=OIT_DataServices_FDS_Project_Data_Read_Data_ConditionCheckRead_DataServices_FDS_Project_Data_Read_Data_ConditionCheckRead
          OIT_DataServices_FDS_Project_Data_Read_Data_ReadData_DataServices_FDS_Project_Data_Read_Data_ReadData: RteEventRef=OIT_DataServices_FDS_Project_Data_Read_Data_ReadData_DataServices_FDS_Project_Data_Read_Data_ReadData
          OIT_PpDsSwcDlMngrVWLogicalBlockLockValue_ConditionCheckRead_PpDsSwcDlMngrVWLogicalBlockLockValue_ConditionCheckRead: RteEventRef=OIT_PpDsSwcDlMngrVWLogicalBlockLockValue_ConditionCheckRead_PpDsSwcDlMngrVWLogicalBlockLockValue_ConditionCheckRead
          OIT_PpDsSwcDlMngrVWLogicalBlockLockValue_ReadData_PpDsSwcDlMngrVWLogicalBlockLockValue_ReadData: RteEventRef=OIT_PpDsSwcDlMngrVWLogicalBlockLockValue_ReadData_PpDsSwcDlMngrVWLogicalBlockLockValue_ReadData
          OIT_PpDsSwcDlMngrVWLogicalBlockVersion_ConditionCheckRead_PpDsSwcDlMngrVWLogicalBlockVersion_ConditionCheckRead: RteEventRef=OIT_PpDsSwcDlMngrVWLogicalBlockVersion_ConditionCheckRead_PpDsSwcDlMngrVWLogicalBlockVersion_ConditionCheckRead
          OIT_PpDsSwcDlMngrVWLogicalBlockVersion_ReadData_PpDsSwcDlMngrVWLogicalBlockVersion_ReadData: RteEventRef=OIT_PpDsSwcDlMngrVWLogicalBlockVersion_ReadData_PpDsSwcDlMngrVWLogicalBlockVersion_ReadData
          OIT_PpDsSwcDlMngrFingerprintLogicalBlock_ConditionCheckRead_PpDsSwcDlMngrFingerprintLogicalBlock_ConditionCheckRead: RteEventRef=OIT_PpDsSwcDlMngrFingerprintLogicalBlock_ConditionCheckRead_PpDsSwcDlMngrFingerprintLogicalBlock_ConditionCheckRead
          OIT_PpDsSwcDlMngrFingerprintLogicalBlock_ReadData_PpDsSwcDlMngrFingerprintLogicalBlock_ReadData: RteEventRef=OIT_PpDsSwcDlMngrFingerprintLogicalBlock_ReadData_PpDsSwcDlMngrFingerprintLogicalBlock_ReadData
          OIT_PpDsSwcDlMngrVWLogicalBlockDowngradeVersions_ConditionCheckRead_PpDsSwcDlMngrVWLogicalBlockDowngradeVersions_ConditiDDC8ADC4: RteEventRef=OIT_PpDsSwcDlMngrVWLogicalBlockDowngradeVersions_ConditionCheckRead_PpDsSwcDlMngrVWLogicalBlockDowngradeVersions_ConditiDDC8ADC4
          OIT_PpDsSwcDlMngrVWLogicalBlockDowngradeVersions_ReadData_PpDsSwcDlMngrVWLogicalBlockDowngradeVersions_ReadData: RteEventRef=OIT_PpDsSwcDlMngrVWLogicalBlockDowngradeVersions_ReadData_PpDsSwcDlMngrVWLogicalBlockDowngradeVersions_ReadData
          OIT_PpDsSwcDlMngrVWLogicalBlockCounterOfProgrammingAttempts_ConditionCheckRead_PpDsSwcDlMngrVWLogicalBlockCounterOfProgrE8CD8D5E: RteEventRef=OIT_PpDsSwcDlMngrVWLogicalBlockCounterOfProgrammingAttempts_ConditionCheckRead_PpDsSwcDlMngrVWLogicalBlockCounterOfProgrE8CD8D5E
          OIT_PpDsSwcDlMngrVWLogicalBlockCounterOfProgrammingAttempts_ReadData_PpDsSwcDlMngrVWLogicalBlockCounterOfProgrammingAtteF74EF37D: RteEventRef=OIT_PpDsSwcDlMngrVWLogicalBlockCounterOfProgrammingAttempts_ReadData_PpDsSwcDlMngrVWLogicalBlockCounterOfProgrammingAtteF74EF37D
          OIT_PpDsSwcDlMngrFingerprint_WriteData_PpDsSwcDlMngrFingerprint_WriteData: RteEventRef=OIT_PpDsSwcDlMngrFingerprint_WriteData_PpDsSwcDlMngrFingerprint_WriteData
          OIT_PpDsSwcDlMngrFingerprint_ConditionCheckRead_PpDsSwcDlMngrFingerprint_ConditionCheckRead: RteEventRef=OIT_PpDsSwcDlMngrFingerprint_ConditionCheckRead_PpDsSwcDlMngrFingerprint_ConditionCheckRead
          OIT_PpDsSwcDlMngrFingerprint_ReadData_PpDsSwcDlMngrFingerprint_ReadData: RteEventRef=OIT_PpDsSwcDlMngrFingerprint_ReadData_PpDsSwcDlMngrFingerprint_ReadData
          MST_CddDownloadManager_Init_1: RtePositionInTask=37, RteEventRef=MSECddDlMngrInit_1, RteMappedToTaskRef=OsTask_ApplInitDeInit, RteUsedOsEventRef=Rte_Ev_OnExit_OsTask_ApplInitDeInit_SwcDisplayControl_PpSwcDispCtrlDisplayMode_Mode_OFF
          OIT_PpDsCddDlMngrBootloaderTPBlocksize_WriteData_PpDsCddDlMngrBootloaderTPBlocksize_WriteData: RteEventRef=OIT_PpDsCddDlMngrBootloaderTPBlocksize_WriteData_PpDsCddDlMngrBootloaderTPBlocksize_WriteData
          OIT_PpDsCddDlMngrBootloaderTPBlocksize_ConditionCheckRead_PpDsCddDlMngrBootloaderTPBlocksize_ConditionCheckRead: RteEventRef=OIT_PpDsCddDlMngrBootloaderTPBlocksize_ConditionCheckRead_PpDsCddDlMngrBootloaderTPBlocksize_ConditionCheckRead
          OIT_PpDsCddDlMngrBootloaderTPBlocksize_ReadData_PpDsCddDlMngrBootloaderTPBlocksize_ReadData: RteEventRef=OIT_PpDsCddDlMngrBootloaderTPBlocksize_ReadData_PpDsCddDlMngrBootloaderTPBlocksize_ReadData
          OIT_PpRsCddDlMngrCheckMemory_Start_PpRsCddDlMngrCheckMemory_Start: RteEventRef=OIT_PpRsCddDlMngrCheckMemory_Start_PpRsCddDlMngrCheckMemory_Start
          OIT_PpRsCddDlMngrCheckProgrammingPreconditions_Start_PpRsCddDlMngrCheckProgrammingPreconditions_Start: RteEventRef=OIT_PpRsCddDlMngrCheckProgrammingPreconditions_Start_PpRsCddDlMngrCheckProgrammingPreconditions_Start
          OIT_PpRsCddDlMngrVerifyPartialChecksum_Start_PpRsCddDlMngrVerifyPartialChecksum_Start: RteEventRef=OIT_PpRsCddDlMngrVerifyPartialChecksum_Start_PpRsCddDlMngrVerifyPartialChecksum_Start
          OIT_PpRsCddDlMngrEraseMemory_Start_PpRsCddDlMngrEraseMemory_Start: RteEventRef=OIT_PpRsCddDlMngrEraseMemory_Start_PpRsCddDlMngrEraseMemory_Start
          OIT_PpRsCddDlMngrCheckProgrammingDependencies_Start_PpRsCddDlMngrCheckProgrammingDependencies_Start: RteEventRef=OIT_PpRsCddDlMngrCheckProgrammingDependencies_Start_PpRsCddDlMngrCheckProgrammingDependencies_Start
      CddCodeFlashAccess_EcuSwComposition: RteSoftwareComponentInstanceRef=CddCodeFlashAccess
        6 x RteEventToTaskMapping, all with RteImmediateRestart=false:
          OIT_PpCodeFlashAccess_Erase_PiCddCodeFlashAccessCodeFlashAccess_Erase: RteEventRef=OIT_PpCodeFlashAccess_Erase_PiCddCodeFlashAccessCodeFlashAccess_Erase
          OIT_PpCodeFlashAccess_GetResetVector_PiCddCodeFlashAccessCodeFlashAccess_GetResetVector: RteEventRef=OIT_PpCodeFlashAccess_GetResetVector_PiCddCodeFlashAccessCodeFlashAccess_GetResetVector
          OIT_PpCodeFlashAccess_GetStatus_PiCddCodeFlashAccessCodeFlashAccess_GetStatus: RteEventRef=OIT_PpCodeFlashAccess_GetStatus_PiCddCodeFlashAccessCodeFlashAccess_GetStatus
          OIT_PpCodeFlashAccess_SetResetVector_PiCddCodeFlashAccessCodeFlashAccess_SetResetVector: RteEventRef=OIT_PpCodeFlashAccess_SetResetVector_PiCddCodeFlashAccessCodeFlashAccess_SetResetVector
          OIT_PpCodeFlashAccess_Write_PiCddCodeFlashAccessCodeFlashAccess_Write: RteEventRef=OIT_PpCodeFlashAccess_Write_PiCddCodeFlashAccessCodeFlashAccess_Write
          OIT_PpCddCodeFlashAccessVersionInfo_GetVersionInfo_PpCddCodeFlashAccessVersionInfo_GetVersionInfo: RteEventRef=OIT_PpCddCodeFlashAccessVersionInfo_GetVersionInfo_PpCddCodeFlashAccessVersionInfo_GetVersionInfo
        EACddCodeFlashAccessFlash (RteExclusiveAreaImplementation): RteExclusiveAreaImplMechanism=ALL_INTERRUPT_BLOCKING, RteExclusiveAreaRef=EACddCodeFlashAccessFlash
        IECddCodeFlashAccessInit (RteEventToTaskMapping): RteImmediateRestart=false, RtePositionInTask=4, RteEventRef=IECddCodeFlashAccessInit, RteMappedToTaskRef=OsTask_ApplInitDeInit
        OIT_CddCfa_ReadResetVector_PpDsCddCodeFlashAccessReadResetVector_ReadData (RteEventToTaskMapping): RteImmediateRestart=false, RteEventRef=OIT_CddCfa_ReadResetVector_PpDsCddCodeFlashAccessReadResetVector_ReadData
      CddEcuDownload_EcuSwComposition: RteSoftwareComponentInstanceRef=CddEcuDownload
        19 x RteEventToTaskMapping, all with RteImmediateRestart=false:
          TMT_CddEcuDownload_MainFunction: RtePositionInTask=33, RteEventRef=TECddEcuDlMainFunction, RteMappedToTaskRef=OsTask_ApplMainFunctions, RteUsedOsEventRef=Rte_Ev_Cyclic_OsTask_ApplMainFunctions_0_10ms, RteUsedOsAlarmRef=Rte_Al_TE_OsTask_ApplMainFunctions_0_10ms
          OIT_PpApplication1Download_GetSlaveState_PpApplication1Download_GetSlaveState: RteEventRef=OIT_PpApplication1Download_GetSlaveState_PpApplication1Download_GetSlaveState
          OIT_PpApplication1Download_Validate_PpApplication1Download_Validate: RteEventRef=OIT_PpApplication1Download_Validate_PpApplication1Download_Validate
          OIT_PpApplication1Download_ProcessData_PpApplication1Download_ProcessData: RteEventRef=OIT_PpApplication1Download_ProcessData_PpApplication1Download_ProcessData
          OIT_PpApplication1Download_Erase_PpApplication1Download_Erase: RteEventRef=OIT_PpApplication1Download_Erase_PpApplication1Download_Erase
          OIT_PpApplication2Download_GetSlaveState_PpApplication2Download_GetSlaveState: RteEventRef=OIT_PpApplication2Download_GetSlaveState_PpApplication2Download_GetSlaveState
          OIT_PpApplication2Download_Validate_PpApplication2Download_Validate: RteEventRef=OIT_PpApplication2Download_Validate_PpApplication2Download_Validate
          OIT_PpApplication2Download_ProcessData_PpApplication2Download_ProcessData: RteEventRef=OIT_PpApplication2Download_ProcessData_PpApplication2Download_ProcessData
          OIT_PpApplication2Download_Erase_PpApplication2Download_Erase: RteEventRef=OIT_PpApplication2Download_Erase_PpApplication2Download_Erase
          OIT_PpApplication1Download_GetSlaveSizeInBytes_PpApplication1Download_GetSlaveSizeInBytes: RteEventRef=OIT_PpApplication1Download_GetSlaveSizeInBytes_PpApplication1Download_GetSlaveSizeInBytes
          OIT_PpApplication2Download_GetSlaveSizeInBytes_PpApplication2Download_GetSlaveSizeInBytes: RteEventRef=OIT_PpApplication2Download_GetSlaveSizeInBytes_PpApplication2Download_GetSlaveSizeInBytes
          MST_CddEcuDownload_Init_0: RtePositionInTask=36, RteEventRef=MSECddEcuDlInit_0, RteMappedToTaskRef=OsTask_ApplInitDeInit, RteUsedOsEventRef=Rte_Ev_OnExit_OsTask_ApplInitDeInit_SwcDisplayControl_PpSwcDispCtrlDisplayMode_Mode_UNINIT
          OIT_PpCddEcuDownloadVersionInfo_GetVersionInfo_PpCddEcuDownloadVersionInfo_GetVersionInfo: RteEventRef=OIT_PpCddEcuDownloadVersionInfo_GetVersionInfo_PpCddEcuDownloadVersionInfo_GetVersionInfo
          OIT_PpApplication1Download_GetSlaveCRC32State_PpApplication1Download_GetSlaveCRC32State: RteEventRef=OIT_PpApplication1Download_GetSlaveCRC32State_PpApplication1Download_GetSlaveCRC32State
          OIT_PpApplication2Download_GetSlaveCRC32State_PpApplication2Download_GetSlaveCRC32State: RteEventRef=OIT_PpApplication2Download_GetSlaveCRC32State_PpApplication2Download_GetSlaveCRC32State
          OIT_PpApplication2Download_CalculateCRC32_PpApplication2Download_CalculateCRC32: RteEventRef=OIT_PpApplication2Download_CalculateCRC32_PpApplication2Download_CalculateCRC32
          OIT_PpApplication1Download_CalculateCRC32_PpApplication1Download_CalculateCRC32: RteEventRef=OIT_PpApplication1Download_CalculateCRC32_PpApplication1Download_CalculateCRC32
          MST_CddEcuDownload_Init_1: RtePositionInTask=36, RteEventRef=MSECddEcuDlInit_1, RteMappedToTaskRef=OsTask_ApplInitDeInit, RteUsedOsEventRef=Rte_Ev_OnExit_OsTask_ApplInitDeInit_SwcDisplayControl_PpSwcDispCtrlDisplayMode_Mode_OFF
          OIT_PpSparePartNumber_Get_PpSparePartNumber_Get: RteEventRef=OIT_PpSparePartNumber_Get_PpSparePartNumber_Get
    3 x RteSwComponentType:
      CddDownloadManager: RteComponentTypeRef=CddDownloadManager, RteImplementationRef=SwcDownloadManager_Implementation
        ComponentTypeCalibration (RteComponentTypeCalibration): RteCalibrationSupportEnabled=false
      CddCodeFlashAccess: RteComponentTypeRef=CddCodeFlashAccess, RteImplementationRef=CddCodeFlashAccess_Implementation
        ComponentTypeCalibration (RteComponentTypeCalibration): RteCalibrationSupportEnabled=false
      CddEcuDownload: RteComponentTypeRef=CddEcuDownload, RteImplementationRef=CddEcuDownload_Implementation
        ComponentTypeCalibration (RteComponentTypeCalibration): RteCalibrationSupportEnabled=false
    CddPanelHimaxHx8249B_EcuSwComposition (RteSwComponentInstance): RteSoftwareComponentInstanceRef=CddPanelHimaxHx8249B
      19 x RteEventToTaskMapping, all with RteImmediateRestart=false:
        TMT_CddPanelHimaxHx8249B_MainFunction: RtePositionInTask=36, RteEventRef=TECddPnlMainFunction, RteMappedToTaskRef=OsTask_ApplMainFunctions, RteUsedOsEventRef=Rte_Ev_Cyclic_OsTask_ApplMainFunctions_0_10ms, RteUsedOsAlarmRef=Rte_Al_TE_OsTask_ApplMainFunctions_0_10ms
        OIT_PpRsCddPanelHimaxHx8249BWrite_Start_PpRsCddPanelHimaxHx8249BWrite_Start: RteEventRef=OIT_PpRsCddPanelHimaxHx8249BWrite_Start_PpRsCddPanelHimaxHx8249BWrite_Start
        OIT_PpRsCddPanelHimaxHx8249BVcomSimulation_Stop_PpRsCddPanelHimaxHx8249BVcomSimulation_Stop: RteEventRef=OIT_PpRsCddPanelHimaxHx8249BVcomSimulation_Stop_PpRsCddPanelHimaxHx8249BVcomSimulation_Stop
        OIT_PpRsCddPanelHimaxHx8249BVcomSimulation_Start_PpRsCddPanelHimaxHx8249BVcomSimulation_Start: RteEventRef=OIT_PpRsCddPanelHimaxHx8249BVcomSimulation_Start_PpRsCddPanelHimaxHx8249BVcomSimulation_Start
        OIT_PpRsCddPanelHimaxHx8249BRead_Start_PpRsCddPanelHimaxHx8249BRead_Start: RteEventRef=OIT_PpRsCddPanelHimaxHx8249BRead_Start_PpRsCddPanelHimaxHx8249BRead_Start
        OIT_PpRsCddPanelHimaxHx8249BGammaVoltageSetting_Stop_PpRsCddPanelHimaxHx8249BGammaVoltageSetting_Stop: RteEventRef=OIT_PpRsCddPanelHimaxHx8249BGammaVoltageSetting_Stop_PpRsCddPanelHimaxHx8249BGammaVoltageSetting_Stop
        OIT_PpRsCddPanelHimaxHx8249BGammaVoltageSetting_Start_PpRsCddPanelHimaxHx8249BGammaVoltageSetting_Start: RteEventRef=OIT_PpRsCddPanelHimaxHx8249BGammaVoltageSetting_Start_PpRsCddPanelHimaxHx8249BGammaVoltageSetting_Start
        OIT_PpRsCddPanelHimaxHx8249BGammaSimulation_Stop_PpRsCddPanelHimaxHx8249BGammaSimulation_Stop: RteEventRef=OIT_PpRsCddPanelHimaxHx8249BGammaSimulation_Stop_PpRsCddPanelHimaxHx8249BGammaSimulation_Stop
        OIT_PpRsCddPanelHimaxHx8249BGammaSimulation_Start_PpRsCddPanelHimaxHx8249BGammaSimulation_Start: RteEventRef=OIT_PpRsCddPanelHimaxHx8249BGammaSimulation_Start_PpRsCddPanelHimaxHx8249BGammaSimulation_Start
        OIT_PpPanelTestPattern_SetTestPattern_PpPanelTestPattern_SetTestPattern: RteEventRef=OIT_PpPanelTestPattern_SetTestPattern_PpPanelTestPattern_SetTestPattern
        OIT_PpPanelGammaCorrection_SetMinMaxGamma_PpPanelGammaCorrection_SetMinMaxGamma: RteEventRef=OIT_PpPanelGammaCorrection_SetMinMaxGamma_PpPanelGammaCorrection_SetMinMaxGamma
        OIT_PpCddPanelHimaxHx8249BVersionInfo_GetVersionInfo_PpCddPanelHimaxHx8249BVersionInfo_GetVersionInfo: RteEventRef=OIT_PpCddPanelHimaxHx8249BVersionInfo_GetVersionInfo_PpCddPanelHimaxHx8249BVersionInfo_GetVersionInfo
        TMT_CddPanelHimaxHx8249B_PowerControl: RtePositionInTask=5, RteEventRef=TECddPnlPowerControl, RteMappedToTaskRef=OsTask_ApplTimedInitDeInit, RteUsedOsEventRef=Rte_Ev_Cyclic_OsTask_ApplTimedInitDeInit_0_1ms, RteUsedOsAlarmRef=Rte_Al_TE_OsTask_ApplTimedInitDeInit_0_1ms
        DRT_CddPanelHimaxHx8249B_ProcessRequestedMode_PpCddPanelModeRequest_requestedMode: RtePositionInTask=9, RteEventRef=DRECddPnlSwcDispCtrlModeReq, RteMappedToTaskRef=OsTask_ApplMainFunctions, RteUsedOsEventRef=Rte_Ev_Run_CddPanelHimaxHx8249B_CddPnl_ProcessSwcDispCtrolModeReq
        MST_CddPnl_Init_0: RtePositionInTask=10, RteEventRef=MSECddPnlInit_0, RteMappedToTaskRef=OsTask_ApplInitDeInit, RteUsedOsEventRef=Rte_Ev_OnExit_OsTask_ApplInitDeInit_SwcDisplayControl_PpSwcDispCtrlDisplayMode_Mode_UNINIT
        OIT_PpCddPnlDeviceAccess_SetDeviceAccess_PpCddPnlDeviceAccess_SetDeviceAccess: RteEventRef=OIT_PpCddPnlDeviceAccess_SetDeviceAccess_PpCddPnlDeviceAccess_SetDeviceAccess
        MST_CddPnl_DeInit_0: RtePositionInTask=69, RteEventRef=MSECddPnlDeInit, RteMappedToTaskRef=OsTask_ApplInitDeInit, RteUsedOsEventRef=Rte_Ev_OnEntry_OsTask_ApplInitDeInit_SwcDisplayControl_PpSwcDispCtrlDisplayMode_Mode_UNINIT
        MST_CddPnl_Init_1: RtePositionInTask=10, RteEventRef=MSECddPnlInit_1, RteMappedToTaskRef=OsTask_ApplInitDeInit, RteUsedOsEventRef=Rte_Ev_OnExit_OsTask_ApplInitDeInit_SwcDisplayControl_PpSwcDispCtrlDisplayMode_Mode_OFF
        MST_CddPnl_OnEntryDcmDefaultSession_0: RtePositionInTask=6, RteEventRef=MSECddPnlDcmOnEntryDefaultSession, RteMappedToTaskRef=OsTask_DcmSessionChanges, RteUsedOsEventRef=Rte_Ev_OnEntry_OsTask_DcmSessionChanges_Dcm_DcmDiagnosticSessionControl_DcmDiagnosticSessionControl_DEFAULT_SESSION
    CddPanelHimaxHx8249B (RteSwComponentType): RteComponentTypeRef=CddPanelHimaxHx8249B, RteImplementationRef=CddPanelHimaxHx8249B_Implementation
      ComponentTypeCalibration (RteComponentTypeCalibration): RteCalibrationSupportEnabled=false
    CddSliderBackLightTiSN1903001_EcuSwComposition (RteSwComponentInstance): RteSoftwareComponentInstanceRef=CddSliderBackLightTiSN1903001
      20 x RteEventToTaskMapping, all with RteImmediateRestart=false:
        TMT_CddSliderBackLightTiSN1903001_MainFunction: RtePositionInTask=38, RteEventRef=TECddSldrMainFunction, RteMappedToTaskRef=OsTask_ApplMainFunctions, RteUsedOsEventRef=Rte_Ev_Cyclic_OsTask_ApplMainFunctions_0_10ms, RteUsedOsAlarmRef=Rte_Al_TE_OsTask_ApplMainFunctions_0_10ms
        TMT_CddSliderBackLightTiSN1903001_PowerControl: RtePositionInTask=3, RteEventRef=TECddSldrPowerControl, RteMappedToTaskRef=OsTask_ApplTimedInitDeInit, RteUsedOsEventRef=Rte_Ev_Cyclic_OsTask_ApplTimedInitDeInit_0_1ms, RteUsedOsAlarmRef=Rte_Al_TE_OsTask_ApplTimedInitDeInit_0_1ms
        OIT_PpRsCddSliderBackLightTiSN1903001Write_Start_PpRsCddSliderBackLightTiSN1903001Write_Start: RteEventRef=OIT_PpRsCddSliderBackLightTiSN1903001Write_Start_PpRsCddSliderBackLightTiSN1903001Write_Start
        OIT_PpDsCddSliderBackLightTiSN1903001BacklightDutyCycle_ConditionCheckRead_PpDsCddSliderBackLightTiSN1903001BacklightDutC36DEF60: RteEventRef=OIT_PpDsCddSliderBackLightTiSN1903001BacklightDutyCycle_ConditionCheckRead_PpDsCddSliderBackLightTiSN1903001BacklightDutC36DEF60
        OIT_PpDsCddSliderBackLightTiSN1903001BacklightDutyCycle_ReadData_PpDsCddSliderBackLightTiSN1903001BacklightDutyCycle_ReadData: RteEventRef=OIT_PpDsCddSliderBackLightTiSN1903001BacklightDutyCycle_ReadData_PpDsCddSliderBackLightTiSN1903001BacklightDutyCycle_ReadData
        OIT_PpRsCddSliderBackLightTiSN1903001BacklightLedCurrentSimulation_Stop_PpRsCddSliderBackLightTiSN1903001BacklightLedCurA9DD8D0A: RteEventRef=OIT_PpRsCddSliderBackLightTiSN1903001BacklightLedCurrentSimulation_Stop_PpRsCddSliderBackLightTiSN1903001BacklightLedCurA9DD8D0A
        OIT_PpRsCddSliderBackLightTiSN1903001BacklightLedCurrentSimulation_Start_PpRsCddSliderBackLightTiSN1903001BacklightLedCu6A1FD97A: RteEventRef=OIT_PpRsCddSliderBackLightTiSN1903001BacklightLedCurrentSimulation_Start_PpRsCddSliderBackLightTiSN1903001BacklightLedCu6A1FD97A
        OIT_PpCddSldrDeviceAccess_SetDeviceAccess_PpCddSldrDeviceAccess_SetDeviceAccess: RteEventRef=OIT_PpCddSldrDeviceAccess_SetDeviceAccess_PpCddSldrDeviceAccess_SetDeviceAccess
        OIT_CddSldr_GetVersionInfo_PiBaseClassVersionInfo_GetVersionInfo: RteEventRef=OIT_CddSldr_GetVersionInfo_PiBaseClassVersionInfo_GetVersionInfo
        DRECddSldrSwcDispCtrlModeReq: RtePositionInTask=65, RteEventRef=DRECddSldrSwcDispCtrlModeReq, RteMappedToTaskRef=OsTask_ApplMainFunctions, RteUsedOsEventRef=Rte_Ev_Run_CddSliderBackLightTiSN1903001_CddSldr_ProcessSwcDispCtrlModeReq
        TECddSldrOnWriteSeqReady: RtePositionInTask=68, RteCyclicTriggerImplementation=None, RteEventRef=TECddSldrOnWriteSeqReady, RteMappedToTaskRef=OsTask_ApplMainFunctions, RteUsedOsEventRef=Rte_Ev_Run1_CddSliderBackLightTiSN1903001_CddSldr_OnWriteSeqReady
        TECddSldrOnReadSeqReady: RtePositionInTask=70, RteCyclicTriggerImplementation=None, RteEventRef=TECddSldrOnReadSeqReady, RteMappedToTaskRef=OsTask_ApplMainFunctions, RteUsedOsEventRef=Rte_Ev_Run1_CddSliderBackLightTiSN1903001_CddSldr_OnReadSeqReady
        OIT_CddSldr_GetDutyCycle_PpCddSldrBacklightControl_GetDutyCycle: RteEventRef=OIT_CddSldr_GetDutyCycle_PpCddSldrBacklightControl_GetDutyCycle
        OIT_CddSldr_SetDutyCycle_PpCddSldrBacklightControl_SetDutyCycle: RteEventRef=OIT_CddSldr_SetDutyCycle_PpCddSldrBacklightControl_SetDutyCycle
        OIT_PpRsCddSldrSimDutyCycle_Stop_PpRsCddSldrSimDutyCycle_Stop: RteEventRef=OIT_PpRsCddSldrSimDutyCycle_Stop_PpRsCddSldrSimDutyCycle_Stop
        OIT_PpRsCddSldrSimDutyCycle_Start_PpRsCddSldrSimDutyCycle_Start: RteEventRef=OIT_PpRsCddSldrSimDutyCycle_Start_PpRsCddSldrSimDutyCycle_Start
        OIT_PpRsCddSliderBackLightTiSN1903001Read_Start_PpRsCddSldrReadRegister_Start: RteEventRef=OIT_PpRsCddSliderBackLightTiSN1903001Read_Start_PpRsCddSldrReadRegister_Start
        MST_CddSldr_Init_1: RtePositionInTask=41, RteEventRef=MST_CddSldr_Init_0, RteMappedToTaskRef=OsTask_ApplInitDeInit, RteUsedOsEventRef=Rte_Ev_OnExit_OsTask_ApplInitDeInit_SwcDisplayControl_PpSwcDispCtrlDisplayMode_Mode_UNINIT
        MST_CddSldr_Init_2: RtePositionInTask=41, RteEventRef=MST_CddSldr_Init_1, RteMappedToTaskRef=OsTask_ApplInitDeInit, RteUsedOsEventRef=Rte_Ev_OnExit_OsTask_ApplInitDeInit_SwcDisplayControl_PpSwcDispCtrlDisplayMode_Mode_OFF
        MST_CddSldr_Deinit_1: RtePositionInTask=46, RteEventRef=MST_CddSldr_Deinit_1, RteMappedToTaskRef=OsTask_ApplInitDeInit, RteUsedOsEventRef=Rte_Ev_OnEntry_OsTask_ApplInitDeInit_SwcDisplayControl_PpSwcDispCtrlDisplayMode_Mode_UNINIT
      EACddSldrBuffers (RteExclusiveAreaImplementation):
        RteExclusiveAreaImplMechanism = OS_RESOURCE
        RteExclusiveAreaRef = EACddSldrBuffer
        RteExclusiveAreaOsResourceRef = Rte_Res_CddSliderBackLightTiSN1903001_EACddSldrBuffer
    CddSliderBackLightTiSN1903001 (RteSwComponentType): RteComponentTypeRef=CddSliderBackLightTiSN1903001, RteImplementationRef=CddSliderBackLightTiSN1903001_Implementation
      ComponentTypeCalibration (RteComponentTypeCalibration): RteCalibrationSupportEnabled=false
    CddNvMManager_EcuSwComposition (RteSwComponentInstance): RteSoftwareComponentInstanceRef=CddNvMManager
      76 x RteEventToTaskMapping, all with RteImmediateRestart=false:
        DRT_CddNvMManager_BlockCounterApplication1Update_PpBlockCounterApplication1_blockCounter: RtePositionInTask=0, RteEventRef=DRT_CddNvMManager_BlockCounterApplication1Update_PpBlockCounterApplication1_blockCounter, RteMappedToTaskRef=OsTask_NvmAccess, RteUsedOsEventRef=Rte_Ev_Run1_CddNvMManager_CddNvMManager_BlockCounterApplication1Update
        DRT_CddNvMManager_BlockCounterApplication2Update_PpBlockCounterApplication2_blockCounter: RtePositionInTask=1, RteEventRef=DRT_CddNvMManager_BlockCounterApplication2Update_PpBlockCounterApplication2_blockCounter, RteMappedToTaskRef=OsTask_NvmAccess, RteUsedOsEventRef=Rte_Ev_Run1_CddNvMManager_CddNvMManager_BlockCounterApplication2Update
        DRT_CddNvMManager_BlockCounterNonVolatileMemoryUpdate_PpBlockCounterNonVolatileMemory_blockCounter: RtePositionInTask=2, RteEventRef=DRT_CddNvMManager_BlockCounterNonVolatileMemoryUpdate_PpBlockCounterNonVolatileMemory_blockCounter, RteMappedToTaskRef=OsTask_NvmAccess, RteUsedOsEventRef=Rte_Ev_Run1_CddNvMManager_CddNvMManager_BlockCounterNonVolatileMemoryUpdate
        DRT_CddNvMManager_BlockCounterReserved2Update_PpBlockCounterReserved2_blockCounter: RtePositionInTask=3, RteEventRef=DRT_CddNvMManager_BlockCounterReserved2Update_PpBlockCounterReserved2_blockCounter, RteMappedToTaskRef=OsTask_NvmAccess, RteUsedOsEventRef=Rte_Ev_Run1_CddNvMManager_CddNvMManager_BlockCounterReserved2Update
        DRT_CddNvMManager_BlockCounterTouchBackupUpdate_PpBlockCounterTouchBackup_blockCounter: RtePositionInTask=4, RteEventRef=DRT_CddNvMManager_BlockCounterTouchBackupUpdate_PpBlockCounterTouchBackup_blockCounter, RteMappedToTaskRef=OsTask_NvmAccess, RteUsedOsEventRef=Rte_Ev_Run1_CddNvMManager_CddNvMManager_BlockCounterTouchBackupUpdate
        MST_CddNvMManager_DeInit_0: RtePositionInTask=75, RteEventRef=MST_CddNvMManager_DeInit_0, RteMappedToTaskRef=OsTask_ApplInitDeInit, RteUsedOsEventRef=Rte_Ev_OnEntry_OsTask_ApplInitDeInit_SwcDisplayControl_PpSwcDispCtrlDisplayMode_Mode_UNINIT
        DRT_CddNvMManager_DeratingCountUpdate_PpDeratingCount_deratingCount: RtePositionInTask=5, RteEventRef=DRT_CddNvMManager_DeratingCountUpdate_PpDeratingCount_deratingCount, RteMappedToTaskRef=OsTask_NvmAccess, RteUsedOsEventRef=Rte_Ev_Run1_CddNvMManager_CddNvMManager_DeratingCountUpdate
        DRT_CddNvMManager_DowngradeProtectionGlobalVersionNumberUpdate_PpDowngradeProtectionGlobalVersionNumber_versionNumber: RtePositionInTask=6, RteEventRef=DRT_CddNvMManager_DowngradeProtectionGlobalVersionNumberUpdate_PpDowngradeProtectionGlobalVersionNumber_versionNumber, RteMappedToTaskRef=OsTask_NvmAccess, RteUsedOsEventRef=Rte_Ev_Run1_CddNvMManager_CddNvMManager_DowngradeProtectionGlobalVersionNumberUpdate
        DRT_CddNvMManager_DowngradeProtectionVersionApplication1Update_PpDowngradeProtectionVersionApplication1_downgradeProtectE530DDC0: RtePositionInTask=7, RteEventRef=DRT_CddNvMManager_DowngradeProtectionVersionApplication1Update_PpDowngradeProtectionVersionApplication1_downgradeProtectE530DDC0, RteMappedToTaskRef=OsTask_NvmAccess, RteUsedOsEventRef=Rte_Ev_Run1_CddNvMManager_CddNvMManager_DowngradeProtectionVersionApplication1Update
        DRT_CddNvMManager_DowngradeProtectionVersionApplication2Update_PpDowngradeProtectionVersionApplication2_downgradeProtect387C9401: RtePositionInTask=8, RteEventRef=DRT_CddNvMManager_DowngradeProtectionVersionApplication2Update_PpDowngradeProtectionVersionApplication2_downgradeProtect387C9401, RteMappedToTaskRef=OsTask_NvmAccess, RteUsedOsEventRef=Rte_Ev_Run1_CddNvMManager_CddNvMManager_DowngradeProtectionVersionApplication2Update
        DRT_CddNvMManager_DowngradeProtectionVersionNonVolatileMemoryUpdate_PpDowngradeProtectionVersionNonVolatileMemory_downgr90AC586F: RtePositionInTask=9, RteEventRef=DRT_CddNvMManager_DowngradeProtectionVersionNonVolatileMemoryUpdate_PpDowngradeProtectionVersionNonVolatileMemory_downgr90AC586F, RteMappedToTaskRef=OsTask_NvmAccess, RteUsedOsEventRef=Rte_Ev_Run1_CddNvMManager_CddNvMManager_DowngradeProtectionVersionNonVolatileMemoryUpdate
        DRT_CddNvMManager_DowngradeProtectionVersionReserved2Update_PpDowngradeProtectionVersionReserved2_downgradeProtectionVersion: RtePositionInTask=10, RteEventRef=DRT_CddNvMManager_DowngradeProtectionVersionReserved2Update_PpDowngradeProtectionVersionReserved2_downgradeProtectionVersion, RteMappedToTaskRef=OsTask_NvmAccess, RteUsedOsEventRef=Rte_Ev_Run1_CddNvMManager_CddNvMManager_DowngradeProtectionVersionReserved2Update
        DRT_CddNvMManager_DowngradeProtectionVersionTouchBackupUpdate_PpDowngradeProtectionVersionTouchBackup_downgradeProtectionVersion: RtePositionInTask=11, RteEventRef=DRT_CddNvMManager_DowngradeProtectionVersionTouchBackupUpdate_PpDowngradeProtectionVersionTouchBackup_downgradeProtectionVersion, RteMappedToTaskRef=OsTask_NvmAccess, RteUsedOsEventRef=Rte_Ev_Run1_CddNvMManager_CddNvMManager_DowngradeProtectionVersionTouchBackupUpdate
        DRT_CddNvMManager_DeratingCountUpdate_1_PpEcuInfo_ecuInfo: RtePositionInTask=12, RteEventRef=DRT_CddNvMManager_DeratingCountUpdate_1_PpEcuInfo_ecuInfo, RteMappedToTaskRef=OsTask_NvmAccess, RteUsedOsEventRef=Rte_Ev_Run1_CddNvMManager_CddNvMManager_EcuInfoUpdate
        DRT_CddNvMManager_ErrorCounters_PpErrorCounters_errorCounters: RtePositionInTask=13, RteEventRef=DRT_CddNvMManager_ErrorCounters_PpErrorCounters_errorCounters, RteMappedToTaskRef=OsTask_NvmAccess, RteUsedOsEventRef=Rte_Ev_Run1_CddNvMManager_CddNvMManager_ErrorCountersUpdate
        DRT_CddNvMManager_ErrorTrace_PpErrorTrace_errorTrace: RtePositionInTask=14, RteEventRef=DRT_CddNvMManager_ErrorTrace_PpErrorTrace_errorTrace, RteMappedToTaskRef=OsTask_NvmAccess, RteUsedOsEventRef=Rte_Ev_Run1_CddNvMManager_CddNvMManager_ErrorTraceUpdate
        DRT_CddNvMManager_FingerPrintApplication1Update_PpFingerPrintApplication1_fingerPrint: RtePositionInTask=15, RteEventRef=DRT_CddNvMManager_FingerPrintApplication1Update_PpFingerPrintApplication1_fingerPrint, RteMappedToTaskRef=OsTask_NvmAccess, RteUsedOsEventRef=Rte_Ev_Run1_CddNvMManager_CddNvMManager_FingerPrintApplication1Update
        DRT_CddNvMManager_FingerPrintApplication2Update_PpFingerPrintApplication2_fingerPrint: RtePositionInTask=16, RteEventRef=DRT_CddNvMManager_FingerPrintApplication2Update_PpFingerPrintApplication2_fingerPrint, RteMappedToTaskRef=OsTask_NvmAccess, RteUsedOsEventRef=Rte_Ev_Run1_CddNvMManager_CddNvMManager_FingerPrintApplication2Update
        DRT_CddNvMManager_FingerPrintNonVolatileMemoryUpdate_PpFingerPrintNonVolatileMemory_fingerPrint: RtePositionInTask=17, RteEventRef=DRT_CddNvMManager_FingerPrintNonVolatileMemoryUpdate_PpFingerPrintNonVolatileMemory_fingerPrint, RteMappedToTaskRef=OsTask_NvmAccess, RteUsedOsEventRef=Rte_Ev_Run1_CddNvMManager_CddNvMManager_FingerPrintNonVolatileMemoryUpdate
        DRT_CddNvMManager_FingerPrintReserved2Update_PpFingerPrintReserved2_fingerPrint: RtePositionInTask=18, RteEventRef=DRT_CddNvMManager_FingerPrintReserved2Update_PpFingerPrintReserved2_fingerPrint, RteMappedToTaskRef=OsTask_NvmAccess, RteUsedOsEventRef=Rte_Ev_Run1_CddNvMManager_CddNvMManager_FingerPrintReserved2Update
        DRT_CddNvMManager_FingerPrintTouchBackupUpdate_PpFingerPrintTouchBackup_fingerPrint: RtePositionInTask=19, RteEventRef=DRT_CddNvMManager_FingerPrintTouchBackupUpdate_PpFingerPrintTouchBackup_fingerPrint, RteMappedToTaskRef=OsTask_NvmAccess, RteUsedOsEventRef=Rte_Ev_Run1_CddNvMManager_CddNvMManager_FingerPrintTouchBackupUpdate
        CddNvMManager_InitEvent: RtePositionInTask=0, RteEventRef=CddNvMManager_InitEvent, RteMappedToTaskRef=OsTask_ApplInitDeInit
        CddNvMManager_InitTwo_InitEvent: RtePositionInTask=3, RteEventRef=CddNvMManager_InitTwo_InitEvent, RteMappedToTaskRef=OsTask_ApplInitDeInit
        TMT_CddNvMManager_MainFunction: RtePositionInTask=24, RteEventRef=TMT_CddNvMManager_MainFunction, RteMappedToTaskRef=OsTask_ApplMainFunctions, RteUsedOsEventRef=Rte_Ev_Cyclic_OsTask_ApplMainFunctions_0_10ms, RteUsedOsAlarmRef=Rte_Al_TE_OsTask_ApplMainFunctions_0_10ms
        DRT_CddNvMManager_MinimumSeveritiesUpdate_PpMinimumSeverities_minimumSeverities: RtePositionInTask=20, RteEventRef=DRT_CddNvMManager_MinimumSeveritiesUpdate_PpMinimumSeverities_minimumSeverities, RteMappedToTaskRef=OsTask_NvmAccess, RteUsedOsEventRef=Rte_Ev_Run1_CddNvMManager_CddNvMManager_MinimumSeveritiesUpdate
        DRT_CddNvMManager_TemperatureMinMaxUpdate_PpTemperatureMinMax_data: RtePositionInTask=21, RteEventRef=DRT_CddNvMManager_TemperatureMinMaxUpdate_PpTemperatureMinMax_data, RteMappedToTaskRef=OsTask_NvmAccess, RteUsedOsEventRef=Rte_Ev_Run1_CddNvMManager_CddNvMManager_TemperatureMinMaxUpdate
        TMT_CddNvMManager_Verify: RtePositionInTask=19, RteEventRef=TMT_CddNvMManager_Verify, RteMappedToTaskRef=OsTask_ApplVerify, RteUsedOsEventRef=Rte_Ev_Cyclic_OsTask_ApplVerify_0_10ms, RteUsedOsAlarmRef=Rte_Al_TE_OsTask_ApplVerify_0_10ms
        DRT_CddNvMManager_VerifyModeUpdate_PpVerifyMode_verifyMode: RtePositionInTask=23, RteEventRef=DRT_CddNvMManager_VerifyModeUpdate_PpVerifyMode_verifyMode, RteMappedToTaskRef=OsTask_NvmAccess, RteUsedOsEventRef=Rte_Ev_Run1_CddNvMManager_CddNvMManager_VerifyModeUpdate
        DRT_CddNvMManager_VoltageMinMaxUpdate_PpVoltageMinMax_data: RtePositionInTask=22, RteEventRef=DRT_CddNvMManager_VoltageMinMaxUpdate_PpVoltageMinMax_data, RteMappedToTaskRef=OsTask_NvmAccess, RteUsedOsEventRef=Rte_Ev_Run1_CddNvMManager_CddNvMManager_VoltageMinMaxUpdate
        OIT_PpNvMBlock_GetNvmWriteResult_PpNvMBlock_GetNvmWriteResult: RteEventRef=OIT_PpNvMBlock_GetNvmWriteResult_PpNvMBlock_GetNvmWriteResult
        OIT_PpNvMBlock_NvmWriteRequest_PpNvMBlock_NvmWriteRequest: RteEventRef=OIT_PpNvMBlock_NvmWriteRequest_PpNvMBlock_NvmWriteRequest
        OIT_PpNvMDownload_Erase_PpNvMDownload_Erase: RteEventRef=OIT_PpNvMDownload_Erase_PpNvMDownload_Erase
        OIT_PpNvMDownload_GetSlaveSizeInBytes_PpNvMDownload_GetSlaveSizeInBytes: RteEventRef=OIT_PpNvMDownload_GetSlaveSizeInBytes_PpNvMDownload_GetSlaveSizeInBytes
        OIT_PpNvMDownload_GetSlaveState_PpNvMDownload_GetSlaveState: RteEventRef=OIT_PpNvMDownload_GetSlaveState_PpNvMDownload_GetSlaveState
        OIT_PpNvMDownload_ProcessData_PpNvMDownload_ProcessData: RteEventRef=OIT_PpNvMDownload_ProcessData_PpNvMDownload_ProcessData
        OIT_PpNvMDownload_Validate_PpNvMDownload_Validate: RteEventRef=OIT_PpNvMDownload_Validate_PpNvMDownload_Validate
        OIT_PpRsCddNvmManagerGetEepromBlockSizes_Start_PpRsCddNvmManagerGetEepromBlockSizes_Start: RteEventRef=OIT_PpRsCddNvmManagerGetEepromBlockSizes_Start_PpRsCddNvmManagerGetEepromBlockSizes_Start
        OIT_PpRsCddNvmManagerEepromStateSimulation_Stop_PpRsCddNvmManagerEepromStateSimulation_Stop: RteEventRef=OIT_PpRsCddNvmManagerEepromStateSimulation_Stop_PpRsCddNvmManagerEepromStateSimulation_Stop
        OIT_PpRsCddNvmManagerEepromStateSimulation_Start_PpRsCddNvmManagerEepromStateSimulation_Start: RteEventRef=OIT_PpRsCddNvmManagerEepromStateSimulation_Start_PpRsCddNvmManagerEepromStateSimulation_Start
        OIT_PpRsCddNvmManagerEepromDataWrite_Start_PpRsCddNvmManagerEepromDataWrite_Start: RteEventRef=OIT_PpRsCddNvmManagerEepromDataWrite_Start_PpRsCddNvmManagerEepromDataWrite_Start
        OIT_PpRsCddNvmManagerEepromDataRead_Start_PpRsCddNvmManagerEepromDataRead_Start: RteEventRef=OIT_PpRsCddNvmManagerEepromDataRead_Start_PpRsCddNvmManagerEepromDataRead_Start
        OIT_PpRsCddNvmManagerDataToUart_Start_PpRsCddNvmManagerDataToUart_Start: RteEventRef=OIT_PpRsCddNvmManagerDataToUart_Start_PpRsCddNvmManagerDataToUart_Start
        OIT_PpRsCddNvmManagerCopyNvData_Start_PpRsCddNvmManagerCopyNvData_Start: RteEventRef=OIT_PpRsCddNvmManagerCopyNvData_Start_PpRsCddNvmManagerCopyNvData_Start
        DRT_Runnable_PpLogisticData_data: RtePositionInTask=24, RteEventRef=DRT_Runnable_PpLogisticData_data, RteMappedToTaskRef=OsTask_NvmAccess, RteUsedOsEventRef=Rte_Ev_Run1_CddNvMManager_PpCddNvmManagerLogisticsData_Update
        OIT_PpCddNvMManagerVersionInfo_GetVersionInfo_PpCddNvMManagerVersionInfo_GetVersionInfo: RteEventRef=OIT_PpCddNvMManagerVersionInfo_GetVersionInfo_PpCddNvMManagerVersionInfo_GetVersionInfo
        DRT_CddNvMManager_SwcComHandlerTxEventCntrsUpdate_PpSwcComHandlerTxEventCntrs_data: RtePositionInTask=28, RteEventRef=DRT_CddNvMManager_SwcComHandlerTxEventCntrsUpdate_PpSwcComHandlerTxEventCntrs_data, RteMappedToTaskRef=OsTask_NvmAccess, RteUsedOsEventRef=Rte_Ev_Run1_CddNvMManager_CddNvMManager_SwcComHandlerTxEventCntrsUpdate
        DRT_CddNvMManager_SwcComHandlerTxBlockCntrsUpdate_PpSwcComHandlerTxBlockCntrs_data: RtePositionInTask=27, RteEventRef=DRT_CddNvMManager_SwcComHandlerTxBlockCntrsUpdate_PpSwcComHandlerTxBlockCntrs_data, RteMappedToTaskRef=OsTask_NvmAccess, RteUsedOsEventRef=Rte_Ev_Run1_CddNvMManager_CddNvMManager_SwcComHandlerTxBlockCntrsUpdate
        DRT_CddNvMManager_CddWakeupDetectResetCntrsUpdate_PpCddWakeupDetectionResetCntrs_data: RtePositionInTask=25, RteEventRef=DRT_CddNvMManager_CddWakeupDetectResetCntrsUpdate_PpCddWakeupDetectionResetCntrs_data, RteMappedToTaskRef=OsTask_NvmAccess, RteUsedOsEventRef=Rte_Ev_Run1_CddNvMManager_CddNvMManager_CddWUDetNvmDataUpdate
        OIT_PpDsCddNvMManagerDiagEepromWriteCounter_WriteData_PpDsCddNvMManagerDiagEepromWriteCounter_WriteData: RteEventRef=OIT_PpDsCddNvMManagerDiagEepromWriteCounter_WriteData_PpDsCddNvMManagerDiagEepromWriteCounter_WriteData
        OIT_PpDsCddNvMManagerDiagEepromWriteCounter_ConditionCheckRead_PpDsCddNvMManagerDiagEepromWriteCounter_ConditionCheckRead: RteEventRef=OIT_PpDsCddNvMManagerDiagEepromWriteCounter_ConditionCheckRead_PpDsCddNvMManagerDiagEepromWriteCounter_ConditionCheckRead
        OIT_PpDsCddNvMManagerDiagEepromWriteCounter_ReadData_PpDsCddNvMManagerDiagEepromWriteCounter_ReadData: RteEventRef=OIT_PpDsCddNvMManagerDiagEepromWriteCounter_ReadData_PpDsCddNvMManagerDiagEepromWriteCounter_ReadData
        DRT_CddNvMManager_DimmingConfigurationUpdate_PpSwcDimDimNvData_data: RtePositionInTask=29, RteEventRef=DRT_CddNvMManager_DimmingConfigurationUpdate_PpSwcDimDimNvData_data, RteMappedToTaskRef=OsTask_NvmAccess, RteUsedOsEventRef=Rte_Ev_Run1_CddNvMManager_CddNvMManager_DimmingConfigurationUpdate
        DRT_CddNvMManager_SwcHwcCfgDataUpdate_PpSwcHWRHWRCfg_data: RtePositionInTask=30, RteEventRef=DRT_CddNvMManager_SwcHwcCfgDataUpdate_PpSwcHWRHWRCfg_data, RteMappedToTaskRef=OsTask_NvmAccess, RteUsedOsEventRef=Rte_Ev_Run1_CddNvMManager_CddNvMManager_SwcHwrCfgDataUpdate
        DRT_CddNvMManager_BlockCounterApplication1Update_1_PpSwcDlMngrVersionHistory_data: RtePositionInTask=31, RteEventRef=DRT_CddNvMManager_BlockCounterApplication1Update_1_PpSwcDlMngrVersionHistory_data, RteMappedToTaskRef=OsTask_NvmAccess, RteUsedOsEventRef=Rte_Ev_Run1_CddNvMManager_CddNvMManager_SwcDlMngrVerionHistoryUpdate
        OIT_PpNvMDownload_GetSlaveCRC32State_PpNvMDownload_GetSlaveCRC32State: RteEventRef=OIT_PpNvMDownload_GetSlaveCRC32State_PpNvMDownload_GetSlaveCRC32State
        OIT_PpNvMDownload_CalculateCRC32_PpNvMDownload_CalculateCRC32: RteEventRef=OIT_PpNvMDownload_CalculateCRC32_PpNvMDownload_CalculateCRC32
        OIT_PpDsCddNvmManagerNvmSliderDimLut_WriteData_PpDsCddNvmManagerNvmSliderDimLut_WriteData: RteEventRef=OIT_PpDsCddNvmManagerNvmSliderDimLut_WriteData_PpDsCddNvmManagerNvmSliderDimLut_WriteData
        OIT_PpDsCddNvmManagerNvmSliderDimLut_ConditionCheckRead_PpDsCddNvmManagerNvmSliderDimLut_ConditionCheckRead: RteEventRef=OIT_PpDsCddNvmManagerNvmSliderDimLut_ConditionCheckRead_PpDsCddNvmManagerNvmSliderDimLut_ConditionCheckRead
        OIT_PpDsCddNvmManagerNvmSliderDimLut_ReadData_PpDsCddNvmManagerNvmSliderDimLut_ReadData: RteEventRef=OIT_PpDsCddNvmManagerNvmSliderDimLut_ReadData_PpDsCddNvmManagerNvmSliderDimLut_ReadData
        OIT_PpDsCddNvmManagerNvmDisplayDimLutDay_WriteData_PpDsCddNvmManagerNvmDisplayDimLutDay_WriteData: RteEventRef=OIT_PpDsCddNvmManagerNvmDisplayDimLutDay_WriteData_PpDsCddNvmManagerNvmDisplayDimLutDay_WriteData
        OIT_PpDsCddNvmManagerNvmDisplayDimLutDay_ConditionCheckRead_PpDsCddNvmManagerNvmDisplayDimLutDay_ConditionCheckRead: RteEventRef=OIT_PpDsCddNvmManagerNvmDisplayDimLutDay_ConditionCheckRead_PpDsCddNvmManagerNvmDisplayDimLutDay_ConditionCheckRead
        OIT_PpDsCddNvmManagerNvmDisplayDimLutDay_ReadData_PpDsCddNvmManagerNvmDisplayDimLutDay_ReadData: RteEventRef=OIT_PpDsCddNvmManagerNvmDisplayDimLutDay_ReadData_PpDsCddNvmManagerNvmDisplayDimLutDay_ReadData
        OIT_PpDsCddNvmManagerNvmDisplayDimLutNight_WriteData_PpDsCddNvmManagerNvmDisplayDimLutNight_WriteData: RteEventRef=OIT_PpDsCddNvmManagerNvmDisplayDimLutNight_WriteData_PpDsCddNvmManagerNvmDisplayDimLutNight_WriteData
        OIT_PpDsCddNvmManagerNvmDisplayDimLutNight_ConditionCheckRead_PpDsCddNvmManagerNvmDisplayDimLutNight_ConditionCheckRead: RteEventRef=OIT_PpDsCddNvmManagerNvmDisplayDimLutNight_ConditionCheckRead_PpDsCddNvmManagerNvmDisplayDimLutNight_ConditionCheckRead
        OIT_PpDsCddNvmManagerNvmDisplayDimLutNight_ReadData_PpDsCddNvmManagerNvmDisplayDimLutNight_ReadData: RteEventRef=OIT_PpDsCddNvmManagerNvmDisplayDimLutNight_ReadData_PpDsCddNvmManagerNvmDisplayDimLutNight_ReadData
        DRT_CddNvMManager_TouchDeviceCfgUpdate_PpCddTouchDeviceCfg_data: RtePositionInTask=32, RteEventRef=DRT_CddNvMManager_TouchDeviceCfgUpdate_PpCddTouchDeviceCfg_data, RteMappedToTaskRef=OsTask_NvmAccess, RteUsedOsEventRef=Rte_Ev_Run1_CddNvMManager_CddNvMManager_TouchDeviceCfgUpdate
        DRT_CddNvMManager_CddWUDetNvmData2Update_PpCddWUDetNvmData2_data: RtePositionInTask=26, RteEventRef=DRT_CddNvMManager_CddWUDetNvmData2Update_PpCddWUDetNvmData2_data, RteMappedToTaskRef=OsTask_NvmAccess, RteUsedOsEventRef=Rte_Ev_Run1_CddNvMManager_CddNvMManager_CddWUDetNvmData2Update
        DRT_CddNvMManager_BlockCounterApplication1Update_1_PpSwcComRxNvmData_data: RtePositionInTask=33, RteEventRef=DRT_CddNvMManager_BlockCounterApplication1Update_1_PpSwcComRxNvmData_data, RteMappedToTaskRef=OsTask_NvmAccess, RteUsedOsEventRef=Rte_Ev_Run1_CddNvMManager_CddNvMManager_SwcComRxNvmDataUpdate
        DRT_CddNvMManager_SecAttemptCntrsUpdate_PpSwcSecAccessSa2SecAttemptCntrs_cntrs: RtePositionInTask=34, RteEventRef=DRT_CddNvMManager_SecAttemptCntrsUpdate_PpSwcSecAccessSa2SecAttemptCntrs_cntrs, RteMappedToTaskRef=OsTask_NvmAccess, RteUsedOsEventRef=Rte_Ev_Run1_CddNvMManager_CddNvMManager_SecAttemptCntrsUpdate
        DRT_CddNvMManager_ProgInfoUpdate_PpSwcDlMngrProgInfo_data: RtePositionInTask=35, RteEventRef=DRT_CddNvMManager_ProgInfoUpdate_PpSwcDlMngrProgInfo_data, RteMappedToTaskRef=OsTask_NvmAccess, RteUsedOsEventRef=Rte_Ev_Run1_CddNvMManager_CddNvMManager_ProgInfoUpdate
        DRT_PpCddNvmManagerLogisticsData_Update_1_PpLogisticDataSparePartNumber_sparePartNumber: RtePositionInTask=36, RteEventRef=DRT_PpCddNvmManagerLogisticsData_Update_1_PpLogisticDataSparePartNumber_sparePartNumber, RteMappedToTaskRef=OsTask_NvmAccess, RteUsedOsEventRef=Rte_Ev_Run1_CddNvMManager_CddNvmManager_SparePartNumberUpdate
        DRT_CddNvMManager_DeratingCountUpdate_1_PpSwcDisplayInfoCfg_data: RtePositionInTask=37, RteEventRef=DRT_CddNvMManager_DeratingCountUpdate_1_PpSwcDisplayInfoCfg_data, RteMappedToTaskRef=OsTask_NvmAccess, RteUsedOsEventRef=Rte_Ev_Run1_CddNvMManager_CddNvMManager_DisplayInfoCfgUpdate
        DRT_CddNvMManager_HwrDlStateUpdate_PpCddHwrSwdlDlState_dlState: RtePositionInTask=77, RteEventRef=DRT_CddNvMManager_HwrDlStateUpdate_PpCddHwrSwdlDlState_dlState, RteMappedToTaskRef=OsTask_ApplMainFunctions, RteUsedOsEventRef=Rte_Ev_Run1_CddNvMManager_CddNvMManager_HwrDlStateUpdate
        MST_CddNvMManager_OnEntryDcmDefaultSession_0: RtePositionInTask=5, RteEventRef=MST_CddNvMManager_OnEntryDcmDefaultSession_0, RteMappedToTaskRef=OsTask_DcmSessionChanges, RteUsedOsEventRef=Rte_Ev_OnEntry_OsTask_DcmSessionChanges_Dcm_DcmDiagnosticSessionControl_DcmDiagnosticSessionControl_DEFAULT_SESSION
        OIT_PpCddNvMMSwdlVersionInfo_GetVersionInfo_PpCddNvMMSwdlVersionInfo_GetVersionInfo: RteEventRef=OIT_PpCddNvMMSwdlVersionInfo_GetVersionInfo_PpCddNvMMSwdlVersionInfo_GetVersionInfo
        DRT_CddNvMManager_SystemVersionUpdate_PpCddDlMngrSystemVersion_version: RtePositionInTask=38, RteEventRef=DRT_CddNvMManager_SystemVersionUpdate_PpCddDlMngrSystemVersion_version, RteMappedToTaskRef=OsTask_NvmAccess, RteUsedOsEventRef=Rte_Ev_Run_CddNvMManager_CddNvMManager_SystemVersionUpdate
    SwcTestInterface_EcuSwComposition (RteSwComponentInstance): RteSoftwareComponentInstanceRef=SwcTestInterface
      3 x RteEventToTaskMapping, all with RteImmediateRestart=false:
        TMT_SwcTestInterface_MainFunction: RtePositionInTask=37, RteEventRef=TMT_SwcTestInterface_MainFunction, RteMappedToTaskRef=OsTask_ApplMainFunctions, RteUsedOsEventRef=Rte_Ev_Cyclic_OsTask_ApplMainFunctions_0_10ms, RteUsedOsAlarmRef=Rte_Al_TE_OsTask_ApplMainFunctions_0_10ms
        MST_SwcTestInterface_DeInit_0: RtePositionInTask=63, RteEventRef=MST_SwcTestInterface_DeInit_0, RteMappedToTaskRef=OsTask_ApplInitDeInit, RteUsedOsEventRef=Rte_Ev_OnEntry_OsTask_ApplInitDeInit_SwcDisplayControl_PpSwcDispCtrlDisplayMode_Mode_UNINIT
        DRT_SwcTestInterface_ProcessRawTouchData_PpDisplayTouchData_fingerData: RtePositionInTask=39, RteEventRef=DRT_SwcTestInterface_ProcessRawTouchData_PpDisplayTouchData_fingerData, RteMappedToTaskRef=OsTask_ApplMainFunctions, RteUsedOsEventRef=Rte_Ev_Run2_SwcTestInterface_SwcTestIf_ProcessTouchData
      EASwcTestIfProxData (RteExclusiveAreaImplementation): RteExclusiveAreaImplMechanism=ALL_INTERRUPT_BLOCKING, RteExclusiveAreaRef=EASwcTestIfProxData
      EASwcTestIfTouchSimData (RteExclusiveAreaImplementation): RteExclusiveAreaImplMechanism=ALL_INTERRUPT_BLOCKING, RteExclusiveAreaRef=EASwcTestIfTouchSimData
      7 x RteEventToTaskMapping, all with RteImmediateRestart=false:
        OIT_PpSwcTestIfVersionInfo_GetVersionInfo_PpSwcTestIfVersionInfo_GetVersionInfo: RteEventRef=OIT_PpSwcTestIfVersionInfo_GetVersionInfo_PpSwcTestIfVersionInfo_GetVersionInfo
        OIT_SwcTestIf_DebugTraceData_PpSwcTestIfDebugTraceData_Data: RteEventRef=OIT_SwcTestIf_DebugTraceData_PpSwcTestIfDebugTraceData_Data
        DRT_SwcTestIf_ProcessTouchData_PpCddTouchSliderData_fingerData: RtePositionInTask=39, RteEventRef=DRT_SwcTestIf_ProcessTouchData_PpCddTouchSliderData_fingerData, RteMappedToTaskRef=OsTask_ApplMainFunctions, RteUsedOsEventRef=Rte_Ev_Run1_SwcTestInterface_SwcTestIf_ProcessTouchData
        MST_SwcTestIf_Init_0: RtePositionInTask=17, RteEventRef=MST_SwcTestIf_Init_0, RteMappedToTaskRef=OsTask_ApplInitDeInit, RteUsedOsEventRef=Rte_Ev_OnExit_OsTask_ApplInitDeInit_SwcDisplayControl_PpSwcDispCtrlDisplayMode_Mode_OFF
        MST_SwcTestIf_Init_1: RtePositionInTask=17, RteEventRef=MST_SwcTestIf_Init_1, RteMappedToTaskRef=OsTask_ApplInitDeInit, RteUsedOsEventRef=Rte_Ev_OnExit_OsTask_ApplInitDeInit_SwcDisplayControl_PpSwcDispCtrlDisplayMode_Mode_UNINIT
        OIT_SwcTestInterface_ProcessDebugTraceData_PpSwcTestIfDebugTraceData_Data: RteEventRef=OIT_SwcTestIf_DebugTraceData_PpSwcTestIfDebugTraceData_Data
        OIT_PpDsSwcTestInterface_DeveloperMode_WriteData_PpDsSwcTestInterface_DeveloperMode_WriteData: RteEventRef=OIT_PpDsSwcTestInterface_DeveloperMode_WriteData_PpDsSwcTestInterface_DeveloperMode_WriteData
      4 x RteExclusiveAreaImplementation, all with RteExclusiveAreaImplMechanism=ALL_INTERRUPT_BLOCKING:
        EASwcTestIfMemErrorData: RteExclusiveAreaRef=EASwcTestIfMemErrorData
        EASwcTestIfHidForwardData: RteExclusiveAreaRef=EASwcTestIfHidForwardData
        EASwcTestIfTouchData: RteExclusiveAreaRef=EASwcTestIfTouchData
        EASwcTestIfDebugData: RteExclusiveAreaRef=EASwcTestIfDebugData
      9 x RteEventToTaskMapping, all with RteImmediateRestart=false:
        OIT_PpDsSwcTestInterface_DeveloperMode_ReadData_PpDsSwcTestInterface_DeveloperMode_ReadData: RteEventRef=OIT_PpDsSwcTestInterface_DeveloperMode_ReadData_PpDsSwcTestInterface_DeveloperMode_ReadData
        OIT_PpSwcTestIfDevIfTxConfirmation_DevIfTxConfirmation_PpSwcTestIfDevIfTxConfirmation_DevIfTxConfirmation: RteEventRef=OIT_PpSwcTestIfDevIfTxConfirmation_DevIfTxConfirmation_PpSwcTestIfDevIfTxConfirmation_DevIfTxConfirmation
        OIT_PpSwcTestIfHidGetData_GetData_PpSwcTestIfHidGetData_GetData: RteEventRef=OIT_PpSwcTestIfHidGetData_GetData_PpSwcTestIfHidGetData_GetData
        OIT_PpSwcTestIfDevTpTxConfirmation_DevTpTxConfirmation_PpSwcTestIfDevTpTxConfirmation_DevTpTxConfirmation: RteEventRef=OIT_PpSwcTestIfDevTpTxConfirmation_DevTpTxConfirmation_PpSwcTestIfDevTpTxConfirmation_DevTpTxConfirmation
        OIT_PpSwcTestIfTxDataDevAbt03_Data_PpSwcTestIfTxDataDevAbt03_Data: RteEventRef=OIT_PpSwcTestIfTxDataDevAbt03_Data_PpSwcTestIfTxDataDevAbt03_Data
        OIT_PpSwcTestIfTxDataDevAbt01_Data_PpSwcTestIfTxDataDevAbt01_Data: RteEventRef=OIT_PpSwcTestIfTxDataDevAbt01_Data_PpSwcTestIfTxDataDevAbt01_Data
        OIT_PpSwcTestIfTxDataDevAbt02_Data_PpSwcTestIfTxDataDevAbt02_Data: RteEventRef=OIT_PpSwcTestIfTxDataDevAbt02_Data_PpSwcTestIfTxDataDevAbt02_Data
        OIT_PpSwcTestIfTxDataDevAbt04_Data_PpSwcTestIfTxDataDevAbt04_Data: RteEventRef=OIT_PpSwcTestIfTxDataDevAbt04_Data_PpSwcTestIfTxDataDevAbt04_Data
        OIT_PpRxDataDevAbt04_Data_PpRxDataDevAbt04_Data: RteEventRef=OIT_PpRxDataDevAbt04_Data_PpRxDataDevAbt04_Data
    SwcTestInterface (RteSwComponentType): RteComponentTypeRef=SwcTestInterface, RteImplementationRef=SwcTestInterface_Implementation
      ComponentTypeCalibration (RteComponentTypeCalibration): RteCalibrationSupportEnabled=false
    CddBist_EcuSwComposition (RteSwComponentInstance): RteSoftwareComponentInstanceRef=CddBist
      6 x RteEventToTaskMapping, all with RteImmediateRestart=false:
        MST_CddBist_Init_0: RtePositionInTask=12, RteEventRef=MST_CddBist_Init_0, RteMappedToTaskRef=OsTask_ApplInitDeInit, RteUsedOsEventRef=Rte_Ev_OnExit_OsTask_ApplInitDeInit_SwcDisplayControl_PpSwcDispCtrlDisplayMode_Mode_UNINIT
        TMT_CddBist_MainFunction: RtePositionInTask=21, RteEventRef=TMT_CddBist_MainFunction, RteMappedToTaskRef=OsTask_ApplMainFunctions, RteUsedOsEventRef=Rte_Ev_Cyclic_OsTask_ApplMainFunctions_0_10ms, RteUsedOsAlarmRef=Rte_Al_TE_OsTask_ApplMainFunctions_0_10ms
        OIT_PpRsCddBist_BistMode_Stop_PpRsCddBist_BistMode_Stop: RteEventRef=OIT_PpRsCddBist_BistMode_Stop_PpRsCddBist_BistMode_Stop
        OIT_PpRsCddBist_BistMode_Start_PpRsCddBist_BistMode_Start: RteEventRef=OIT_PpRsCddBist_BistMode_Start_PpRsCddBist_BistMode_Start
        OIT_PpCddBistVersionInfo_GetVersionInfo_PpCddBistVersionInfo_GetVersionInfo: RteEventRef=OIT_PpCddBistVersionInfo_GetVersionInfo_PpCddBistVersionInfo_GetVersionInfo
        MST_CddBist_Init_1: RtePositionInTask=12, RteEventRef=MST_CddBist_Init_1, RteMappedToTaskRef=OsTask_ApplInitDeInit, RteUsedOsEventRef=Rte_Ev_OnExit_OsTask_ApplInitDeInit_SwcDisplayControl_PpSwcDispCtrlDisplayMode_Mode_OFF
    CddBist (RteSwComponentType): RteComponentTypeRef=CddBist, RteImplementationRef=CddBist_Implementation
      ComponentTypeCalibration (RteComponentTypeCalibration): RteCalibrationSupportEnabled=false
    Can_0 (RteBswModuleInstance): RteBswImplementationRef=Can_Impl, RteBswModuleConfigurationRef=Can
      8 x RteBswExclusiveAreaImpl:
        CAN_EXCLUSIVE_AREA_{0..5}: RteExclusiveAreaImplMechanism=ALL_INTERRUPT_BLOCKING, RteBswExclusiveAreaRef=CAN_EXCLUSIVE_AREA_{0..5}
        CAN_EXCLUSIVE_AREA_6: RteExclusiveAreaImplMechanism=CUSTOM, RteBswExclusiveAreaRef=CAN_EXCLUSIVE_AREA_6
        CAN_EXCLUSIVE_AREA_7: RteExclusiveAreaImplMechanism=ALL_INTERRUPT_BLOCKING, RteBswExclusiveAreaRef=CAN_EXCLUSIVE_AREA_7
      3 x RteBswEventToTaskMapping, all with RteBswImmediateRestart=false, RteBswMappedToTaskRef=OsTask_BswMainFunctions, RteBswUsedOsEventRef=Rte_Ev_Cyclic2_OsTask_BswMainFunctions_0_10ms, RteBswUsedOsAlarmRef=Rte_Al_TE2_OsTask_BswMainFunctions_0_10ms:
        Can_MainFunction_BusOffTimingEvent0: RteBswPositionInTask=13, RteBswEventRef=Can_MainFunction_BusOffTimingEvent0
        Can_MainFunction_WakeupTimingEvent0: RteBswPositionInTask=15, RteBswEventRef=Can_MainFunction_WakeupTimingEvent0
        Can_MainFunction_ModeTimingEvent0: RteBswPositionInTask=14, RteBswEventRef=Can_MainFunction_ModeTimingEvent0
    I2c (RteBswModuleInstance): RteBswImplementationRef=I2c_Impl, RteBswModuleConfigurationRef=I2c
      I2c_MainFunctionTimingEvent0 (RteBswEventToTaskMapping):
        RteBswImmediateRestart = false
        RteBswPositionInTask = 16
        RteBswEventRef = I2c_MainFunctionTimingEvent0
        RteBswMappedToTaskRef = OsTask_BswMainFunctions
        RteBswUsedOsEventRef = Rte_Ev_Cyclic2_OsTask_BswMainFunctions_0_10ms
        RteBswUsedOsAlarmRef = Rte_Al_TE2_OsTask_BswMainFunctions_0_10ms
      I2C_EXCLUSIVE_AREA_0 (RteBswExclusiveAreaImpl): RteExclusiveAreaImplMechanism=ALL_INTERRUPT_BLOCKING, RteBswExclusiveAreaRef=I2C_EXCLUSIVE_AREA_0
      I2C_PERMGR_EXCLUSIVE_AREA_0 (RteBswExclusiveAreaImpl): RteExclusiveAreaImplMechanism=ALL_INTERRUPT_BLOCKING, RteBswExclusiveAreaRef=I2C_PERMGR_EXCLUSIVE_AREA_0
    SwcHidKeys_EcuSwComposition (RteSwComponentInstance): RteSoftwareComponentInstanceRef=SwcHidKeys
      11 x RteEventToTaskMapping, all with RteImmediateRestart=false:
        MST_SwcHidkeys_Init_0: RtePositionInTask=35, RteEventRef=MSESwcHidKeysInit, RteMappedToTaskRef=OsTask_ApplInitDeInit, RteUsedOsEventRef=Rte_Ev_OnEntry_OsTask_ApplInitDeInit_SwcDisplayControl_PpSwcDispCtrlDisplayMode_Mode_INIT
        MST_SwcHidkeys_DeInit_0: RtePositionInTask=76, RteEventRef=MSESwcHidKeysDeinit, RteMappedToTaskRef=OsTask_ApplInitDeInit, RteUsedOsEventRef=Rte_Ev_Run_SwcHidKeys_SwcHidKeys_DeInit
        TMT_SwcHidkeys_MainFunction: RtePositionInTask=62, RteEventRef=TESwcHidKeysMainFunction, RteMappedToTaskRef=OsTask_ApplMainFunctions, RteUsedOsEventRef=Rte_Ev_Cyclic_OsTask_ApplMainFunctions_0_10ms, RteUsedOsAlarmRef=Rte_Al_TE_OsTask_ApplMainFunctions_0_10ms
        DRT_SwcHidKeys_EvaluateButtonStatus_PpButtonStatus_status: RtePositionInTask=4, RteEventRef=DRESwcHidKeysButtonStatus, RteMappedToTaskRef=OsTask_Touch, RteUsedOsEventRef=Rte_Ev_Run_SwcHidKeys_SwcHidKeys_ProcessButtonStatus
        OIT_PpSwcHidKeysVersionInfo_GetVersionInfo_PpSwcHidKeysVersionInfo_GetVersionInfo: RteEventRef=OIT_PpSwcHidKeysVersionInfo_GetVersionInfo_PpSwcHidKeysVersionInfo_GetVersionInfo
        TESwcHidKeysTxConfTimeout: RteCyclicTriggerImplementation=None, RtePositionInTask=38, RteEventRef=TESwcHidKeysTxConfTimeout, RteUsedOsEventRef=Rte_Ev_Run1_SwcHidKeys_SwcHidKeys_TxConfirmationTimeout, RteMappedToTaskRef=OsTask_Communication
        TESwcHidKeysButtonHold: RteCyclicTriggerImplementation=None, RtePositionInTask=63, RteEventRef=TESwcHidKeysButtonHold, RteUsedOsEventRef=Rte_Ev_Run1_SwcHidKeys_SwcHidKeys_OnButtonHold, RteMappedToTaskRef=OsTask_ApplMainFunctions
        OIT_PpSwcHidKeysHidGetData_GetHidData_PpSwcHidKeysHidGetData_GetHidData: RteEventRef=OIT_PpSwcHidKeysHidGetData_GetHidData_PpSwcHidKeysHidGetData_GetHidData
        OIT_PpSwcHidKeysHidMessagePlausibilisation_ActiveDataTransmitting_PpSwcHidKeysHidMessagePlausibilisation_ActiveDataTransmitting: RteEventRef=OIT_PpSwcHidKeysHidMessagePlausibilisation_ActiveDataTransmitting_PpSwcHidKeysHidMessagePlausibilisation_ActiveDataTransmitting
        OIT_PpSwcHidKeysHidMessagePlausibilisation_CancelActiveData_PpSwcHidKeysHidMessagePlausibilisation_CancelActiveData: RteEventRef=OIT_PpSwcHidKeysHidMessagePlausibilisation_CancelActiveData_PpSwcHidKeysHidMessagePlausibilisation_CancelActiveData
        OIT_PpSwcHidKeysHidTxConfirmation_HidTxConfirmation_PpSwcHidKeysHidTxConfirmation_HidTxConfirmation: RteEventRef=OIT_PpSwcHidKeysHidTxConfirmation_HidTxConfirmation_PpSwcHidKeysHidTxConfirmation_HidTxConfirmation
    SwcHidKeys (RteSwComponentType): RteComponentTypeRef=SwcHidKeys, RteImplementationRef=SwcHidKeys_Implementation
      ComponentTypeCalibration (RteComponentTypeCalibration): RteCalibrationSupportEnabled=false
    CddHWRNXPRT1171_EcuSwComposition (RteSwComponentInstance): RteSoftwareComponentInstanceRef=CddHWRNXPRT1171
      9 x RteEventToTaskMapping, all with RteImmediateRestart=false:
        MST_CddHWRNXPRT1171_DeInit_0: RtePositionInTask=48, RteEventRef=MSECddHwrDeinit, RteMappedToTaskRef=OsTask_ApplInitDeInit, RteUsedOsEventRef=Rte_Ev_OnEntry_OsTask_ApplInitDeInit_SwcDisplayControl_PpSwcDispCtrlDisplayMode_Mode_UNINIT
        TMT_CddHWRNXPRT1171_MainFunction: RtePositionInTask=47, RteEventRef=TECddHwrMainFunction, RteMappedToTaskRef=OsTask_ApplMainFunctions, RteUsedOsEventRef=Rte_Ev_Cyclic_OsTask_ApplMainFunctions_0_10ms, RteUsedOsAlarmRef=Rte_Al_TE_OsTask_ApplMainFunctions_0_10ms
        DRT_CddHWRNXPRT1171_ProcessTouchData_PpTouchData_fingerData: RtePositionInTask=5, RteEventRef=DRECddHwrTouchData0, RteMappedToTaskRef=OsTask_Touch, RteUsedOsEventRef=Rte_Ev_OnRx_OsTask_Touch_CddTouchCypressGen7_PpCddTouchDisplayData_fingerData
        OIT_PpCddHWRNXPRT1171VersionInfo_GetVersionInfo_PpCddHWRNXPRT1171VersionInfo_GetVersionInfo: RteEventRef=OIT_PpCddHWRNXPRT1171VersionInfo_GetVersionInfo_PpCddHWRNXPRT1171VersionInfo_GetVersionInfo
        OIT_PpCddHwrDeviceAccess_SetDeviceAccess_PpCddHwrDeviceAccess_SetDeviceAccess: RteEventRef=OIT_PpCddHwrDeviceAccess_SetDeviceAccess_PpCddHwrDeviceAccess_SetDeviceAccess
        DRT_CddHWRNXPRT1171_OnModeRequest_PpCddHWRNXPRT1171ModeRequest_requestedMode: RtePositionInTask=12, RteEventRef=DRECddHwrSwcDispCtrlModeReq, RteMappedToTaskRef=OsTask_ApplMainFunctions, RteUsedOsEventRef=Rte_Ev_Run_CddHWRNXPRT1171_CddHwr_ProcessSwcDispCtrlModeReq
        MST_CddHWRNXPRT1171_Init_1: RtePositionInTask=14, RteEventRef=MSECddHwrInit0, RteMappedToTaskRef=OsTask_ApplInitDeInit, RteUsedOsEventRef=Rte_Ev_OnEntry_OsTask_ApplInitDeInit_SwcDisplayControl_PpSwcDispCtrlDisplayMode_Mode_INIT
        DRECddHwrSwUpdateReq: RtePositionInTask=44, RteEventRef=DRECddHwrSwUpdateReq, RteMappedToTaskRef=OsTask_ApplMainFunctions, RteUsedOsEventRef=Rte_Ev_Run_CddHWRNXPRT1171_CddHwr_ProcessSwUpdateReq
        TMT_CddHwr_OnUartRxReady: RteCyclicTriggerImplementation=None, RtePositionInTask=52, RteEventRef=TECddHwrOnUartRxReady, RteMappedToTaskRef=OsTask_ApplMainFunctions, RteUsedOsEventRef=Rte_Ev_Run1_CddHWRNXPRT1171_CddHwr_OnUartRxReady
      6 x RteExclusiveAreaImplementation, all with RteExclusiveAreaImplMechanism=OS_RESOURCE:
        EACddHwrRequestCtrl: RteExclusiveAreaRef=EACddHwrRequestCtrl, RteExclusiveAreaOsResourceRef=Rte_Res_CddHWRNXPRT1171_EACddHwrRequestCtrl
        EACddHwrCfgManager: RteExclusiveAreaRef=EACddHwrCfgManager, RteExclusiveAreaOsResourceRef=Rte_Res_CddHWRNXPRT1171_EACddHwrCfgManager
        EACddHwrCom: RteExclusiveAreaRef=EACddHwrCom, RteExclusiveAreaOsResourceRef=Rte_Res_CddHWRNXPRT1171_EACddHwrCom
        EACddHwrEventQueue: RteExclusiveAreaRef=EACddHwrEventQueue, RteExclusiveAreaOsResourceRef=Rte_Res_CddHWRNXPRT1171_EACddHwrEventQueue
        EACddHwrModes: RteExclusiveAreaRef=EACddHwrModes, RteExclusiveAreaOsResourceRef=Rte_Res_CddHWRNXPRT1171_EACddHwrModes
        EACddHwrMonitoring: RteExclusiveAreaRef=EACddHwrMonitoring, RteExclusiveAreaOsResourceRef=Rte_Res_CddHWRNXPRT1171_EACddHwrMonitoring
      44 x RteEventToTaskMapping, all with RteImmediateRestart=false:
        OIT_CddHwr_GetConfidenceThreshold_PpCddHwrHwrProperties_GetConfidenceThreshold: RteEventRef=OIT_CddHwr_GetConfidenceThreshold_PpCddHwrHwrProperties_GetConfidenceThreshold
        OIT_CddHwr_SetConfidenceThreshold_PpCddHwrHwrProperties_SetConfidenceThreshold: RteEventRef=OIT_CddHwr_SetConfidenceThreshold_PpCddHwrHwrProperties_SetConfidenceThreshold
        OIT_CddHwr_GetHWRNGramLength_PpCddHwrHwrProperties_GetHWRNGramLength: RteEventRef=OIT_CddHwr_GetHWRNGramLength_PpCddHwrHwrProperties_GetHWRNGramLength
        OIT_CddHwr_SetHWRNGramLength_PpCddHwrHwrProperties_SetHWRNGramLength: RteEventRef=OIT_CddHwr_SetHWRNGramLength_PpCddHwrHwrProperties_SetHWRNGramLength
        OIT_CddHwr_GetRecognitionStartTimer_PpCddHwrHwrProperties_GetRecognitionStartTimer: RteEventRef=OIT_CddHwr_GetRecognitionStartTimer_PpCddHwrHwrProperties_GetRecognitionStartTimer
        OIT_CddHwr_SetRecognitionStartTimer_PpCddHwrHwrProperties_SetRecognitionStartTimer: RteEventRef=OIT_CddHwr_SetRecognitionStartTimer_PpCddHwrHwrProperties_SetRecognitionStartTimer
        OIT_CddHwr_GetResultMaximumNumber_PpCddHwrHwrProperties_GetResultMaximumNumber: RteEventRef=OIT_CddHwr_GetResultMaximumNumber_PpCddHwrHwrProperties_GetResultMaximumNumber
        OIT_CddHwr_SetResultMaximumNumber_PpCddHwrHwrProperties_SetResultMaximumNumber: RteEventRef=OIT_CddHwr_SetResultMaximumNumber_PpCddHwrHwrProperties_SetResultMaximumNumber
        OIT_CddHwr_GetStrokeTimer_PpCddHwrHwrProperties_GetStrokeTimer: RteEventRef=OIT_CddHwr_GetStrokeTimer_PpCddHwrHwrProperties_GetStrokeTimer
        OIT_CddHwr_SetStrokeTimer_PpCddHwrHwrProperties_SetStrokeTimer: RteEventRef=OIT_CddHwr_SetStrokeTimer_PpCddHwrHwrProperties_SetStrokeTimer
        OIT_CddHwr_GetTPLanguage_PpCddHwrHidCommands_GetTPLanguage: RteEventRef=OIT_CddHwr_GetTPLanguage_PpCddHwrHidCommands_GetTPLanguage
        OIT_CddHwr_SetTPLanguage_PpCddHwrHidCommands_SetTPLanguage: RteEventRef=OIT_CddHwr_SetTPLanguage_PpCddHwrHidCommands_SetTPLanguage
        OIT_CddHwr_GetTPMode_PpCddHwrHidCommands_GetTPMode: RteEventRef=OIT_CddHwr_GetTPMode_PpCddHwrHidCommands_GetTPMode
        OIT_CddHwr_SetTPMode_PpCddHwrHidCommands_SetTPMode: RteEventRef=OIT_CddHwr_SetTPMode_PpCddHwrHidCommands_SetTPMode
        OIT_CddHwr_GetTSHwrArea_PpCddHwrHidCommands_GetTSHwrArea: RteEventRef=OIT_CddHwr_GetTSHwrArea_PpCddHwrHidCommands_GetTSHwrArea
        OIT_CddHwr_GetTSHwrControl_PpCddHwrHidCommands_GetTSHwrControl: RteEventRef=OIT_CddHwr_GetTSHwrControl_PpCddHwrHidCommands_GetTSHwrControl
        OIT_CddHwr_SetTSHwrArea_PpCddHwrHidCommands_SetTSHwrArea: RteEventRef=OIT_CddHwr_SetTSHwrArea_PpCddHwrHidCommands_SetTSHwrArea
        OIT_CddHwr_SetTSHwrControl_PpCddHwrHidCommands_SetTSHwrControl: RteEventRef=OIT_CddHwr_SetTSHwrControl_PpCddHwrHidCommands_SetTSHwrControl
        OIT_CddHwr_GetAckNackCntrs_PpCddHwrHwrInxProperties_GetAckNackCntrs: RteEventRef=OIT_CddHwr_GetAckNackCntrs_PpCddHwrHwrInxProperties_GetAckNackCntrs
        OIT_CddHwr_GetAppVersion_PpCddHwrHwrInxProperties_GetAppVersion: RteEventRef=OIT_CddHwr_GetAppVersion_PpCddHwrHwrInxProperties_GetAppVersion
        OIT_CddHwr_GetBuildTimeDate_PpCddHwrHwrInxProperties_GetBuildTimeDate: RteEventRef=OIT_CddHwr_GetBuildTimeDate_PpCddHwrHwrInxProperties_GetBuildTimeDate
        OIT_CddHwr_GetCRC32Result_PpCddHwrHwrInxProperties_GetCRC32Result: RteEventRef=OIT_CddHwr_GetCRC32Result_PpCddHwrHwrInxProperties_GetCRC32Result
        OIT_CddHwr_GetCrcAddress_PpCddHwrHwrInxProperties_GetCrcAddress: RteEventRef=OIT_CddHwr_GetCrcAddress_PpCddHwrHwrInxProperties_GetCrcAddress
        OIT_CddHwr_GetHanwangEngineVer_PpCddHwrHwrInxProperties_GetHanwangEngineVer: RteEventRef=OIT_CddHwr_GetHanwangEngineVer_PpCddHwrHwrInxProperties_GetHanwangEngineVer
        OIT_CddHwr_GetHanwangLibVerCN_PpCddHwrHwrInxProperties_GetHanwangLibVerCN: RteEventRef=OIT_CddHwr_GetHanwangLibVerCN_PpCddHwrHwrInxProperties_GetHanwangLibVerCN
        OIT_CddHwr_GetHanwangLibVerCT_PpCddHwrHwrInxProperties_GetHanwangLibVerCT: RteEventRef=OIT_CddHwr_GetHanwangLibVerCT_PpCddHwrHwrInxProperties_GetHanwangLibVerCT
        OIT_CddHwr_GetJobQueueStatus_PpCddHwrHwrInxProperties_GetJobQueueStatus: RteEventRef=OIT_CddHwr_GetJobQueueStatus_PpCddHwrHwrInxProperties_GetJobQueueStatus
        OIT_CddHwr_GetRecogTimes_PpCddHwrHwrInxProperties_GetRecogTimes: RteEventRef=OIT_CddHwr_GetRecogTimes_PpCddHwrHwrInxProperties_GetRecogTimes
        OIT_CddHwr_GetResultQueueStatus_PpCddHwrHwrInxProperties_GetResultQueueStatus: RteEventRef=OIT_CddHwr_GetResultQueueStatus_PpCddHwrHwrInxProperties_GetResultQueueStatus
        OIT_CddHwr_GetSeverityDebug_PpCddHwrHwrInxProperties_GetSeverityDebug: RteEventRef=OIT_CddHwr_GetSeverityDebug_PpCddHwrHwrInxProperties_GetSeverityDebug
        OIT_CddHwr_GetSeverityMain_PpCddHwrHwrInxProperties_GetSeverityMain: RteEventRef=OIT_CddHwr_GetSeverityMain_PpCddHwrHwrInxProperties_GetSeverityMain
        OIT_CddHwr_GetStrokeTimes_PpCddHwrHwrInxProperties_GetStrokeTimes: RteEventRef=OIT_CddHwr_GetStrokeTimes_PpCddHwrHwrInxProperties_GetStrokeTimes
        OIT_CddHwr_GetUartCatalogueVer_PpCddHwrHwrInxProperties_GetUartCatalogueVer: RteEventRef=OIT_CddHwr_GetUartCatalogueVer_PpCddHwrHwrInxProperties_GetUartCatalogueVer
        OIT_CddHwr_SetCrcAddress_PpCddHwrHwrInxProperties_SetCrcAddress: RteEventRef=OIT_CddHwr_SetCrcAddress_PpCddHwrHwrInxProperties_SetCrcAddress
        OIT_CddHwr_SetSeverityDebug_PpCddHwrHwrInxProperties_SetSeverityDebug: RteEventRef=OIT_CddHwr_SetSeverityDebug_PpCddHwrHwrInxProperties_SetSeverityDebug
        OIT_CddHwr_SetSeverityMain_PpCddHwrHwrInxProperties_SetSeverityMain: RteEventRef=OIT_CddHwr_SetSeverityMain_PpCddHwrHwrInxProperties_SetSeverityMain
        OIT_CddHwr_CalculateCRC32_PpCddHwrSlaveDownload_CalculateCRC32: RteEventRef=OIT_CddHwr_CalculateCRC32_PpCddHwrSlaveDownload_CalculateCRC32
        OIT_CddHwr_GetSlaveCRC32State_PpCddHwrSlaveDownload_GetSlaveCRC32State: RteEventRef=OIT_CddHwr_GetSlaveCRC32State_PpCddHwrSlaveDownload_GetSlaveCRC32State
        OIT_CddHwr_DiagSetSwUpdateReq_Start_PpRsCddHwrHwrDiagSetSwUpdateReq_Start: RteEventRef=OIT_CddHwr_DiagSetSwUpdateReq_Start_PpRsCddHwrHwrDiagSetSwUpdateReq_Start
        OIT_CddHwr_DiagSetSwUpdateReq_Stop_PpRsCddHwrHwrDiagSetSwUpdateReq_Stop: RteEventRef=OIT_CddHwr_DiagSetSwUpdateReq_Stop_PpRsCddHwrHwrDiagSetSwUpdateReq_Stop
        OIT_CddHwr_DiagConfigPropReq_Start_PpRsCddHwrHwrDiagConfigPropReq_Start: RteEventRef=OIT_CddHwr_DiagConfigPropReq_Start_PpRsCddHwrHwrDiagConfigPropReq_Start
        OIT_CddHwr_DiagRoutineReq_Start_PpRsCddHwrHwrDiagRoutineReq_Start: RteEventRef=OIT_CddHwr_DiagRoutineReq_Start_PpRsCddHwrHwrDiagRoutineReq_Start
        OIT_CddHwr_DiagSevLevelSim_Start_PpRsCddHwrHwrDiagSeverityLevelSimulation_Start: RteEventRef=OIT_CddHwr_DiagSevLevelSim_Start_PpRsCddHwrHwrDiagSeverityLevelSimulation_Start
        OIT_CddHwr_DiagSevLevelSim_Stop_PpRsCddHwrHwrDiagSeverityLevelSimulation_Stop: RteEventRef=OIT_CddHwr_DiagSevLevelSim_Stop_PpRsCddHwrHwrDiagSeverityLevelSimulation_Stop
    CddHWRNXPRT1171 (RteSwComponentType): RteComponentTypeRef=CddHWRNXPRT1171, RteImplementationRef=CddHWRNXPRT1171_Implementation
      ComponentTypeCalibration (RteComponentTypeCalibration): RteCalibrationSupportEnabled=false
    SwcHWR_EcuSwComposition (RteSwComponentInstance): RteSoftwareComponentInstanceRef=SwcHWR
      5 x RteEventToTaskMapping, all with RteImmediateRestart=false:
        MST_SwcHWR_DeInit_0: RtePositionInTask=54, RteEventRef=MST_SwcHWR_DeInit_0, RteMappedToTaskRef=OsTask_ApplInitDeInit, RteUsedOsEventRef=Rte_Ev_OnEntry_OsTask_ApplInitDeInit_SwcDisplayControl_PpSwcDispCtrlDisplayMode_Mode_UNINIT
        MST_SwcHWR_Init_0: RtePositionInTask=28, RteEventRef=MST_SwcHWR_Init_0, RteMappedToTaskRef=OsTask_ApplInitDeInit, RteUsedOsEventRef=Rte_Ev_OnExit_OsTask_ApplInitDeInit_SwcDisplayControl_PpSwcDispCtrlDisplayMode_Mode_UNINIT
        TMT_SwcHWR_MainFunction: RtePositionInTask=41, RteEventRef=TMT_SwcHWR_MainFunction, RteMappedToTaskRef=OsTask_ApplMainFunctions, RteUsedOsEventRef=Rte_Ev_Cyclic_OsTask_ApplMainFunctions_0_10ms, RteUsedOsAlarmRef=Rte_Al_TE_OsTask_ApplMainFunctions_0_10ms
        OIT_PpHWRHidData_Get_PpHWRHidData_Get: RteEventRef=OIT_PpHWRHidData_Get_PpHWRHidData_Get
        OIT_SwcHWRVersionInfo_GetVersionInfo_SwcHWRVersionInfo_GetVersionInfo: RteEventRef=OIT_SwcHWRVersionInfo_GetVersionInfo_SwcHWRVersionInfo_GetVersionInfo
      EASwcHWRCharDataBuffer (RteExclusiveAreaImplementation):
        RteExclusiveAreaImplMechanism = OS_RESOURCE
        RteExclusiveAreaRef = EASwcHWRCharDataBuffer
        RteExclusiveAreaOsResourceRef = Rte_Res_SwcHWR_EASwcHWRCharDataBuffer
      41 x RteEventToTaskMapping, all with RteImmediateRestart=false:
        MST_SwcHWR__0: RtePositionInTask=76, RteEventRef=MST_SwcHWR__0, RteUsedOsEventRef=Rte_Ev_Run_SwcHWR_SwcHWR_DeviceReady, RteMappedToTaskRef=OsTask_ApplMainFunctions
        MST_SwcHWR_Init_1: RtePositionInTask=28, RteEventRef=MST_SwcHWR_Init_1, RteMappedToTaskRef=OsTask_ApplInitDeInit, RteUsedOsEventRef=Rte_Ev_OnExit_OsTask_ApplInitDeInit_SwcDisplayControl_PpSwcDispCtrlDisplayMode_Mode_OFF
        OIT_SwcHWR_NewChars_PpSwcHWRCharsData_NewChars: RteEventRef=OIT_SwcHWR_NewChars_PpSwcHWRCharsData_NewChars
        MST_SwcHWR_DeviceNotReady_0: RtePositionInTask=1, RteEventRef=MST_SwcHWR_DeviceNotReady_0, RteMappedToTaskRef=OsTask_ApplMainFunctions, RteUsedOsEventRef=Rte_Ev_Run_SwcHWR_SwcHWR_DeviceNotReady
        OIT_PpSwcHWRHidCommands_SetTSHwrControl_PpSwcHWRHidCommands_SetTSHwrControl: RteEventRef=OIT_PpSwcHWRHidCommands_SetTSHwrControl_PpSwcHWRHidCommands_SetTSHwrControl
        OIT_PpSwcHWRHidCommands_SetTSHwrArea_PpSwcHWRHidCommands_SetTSHwrArea: RteEventRef=OIT_PpSwcHWRHidCommands_SetTSHwrArea_PpSwcHWRHidCommands_SetTSHwrArea
        OIT_PpSwcHWRHidCommands_SetTPMode_PpSwcHWRHidCommands_SetTPMode: RteEventRef=OIT_PpSwcHWRHidCommands_SetTPMode_PpSwcHWRHidCommands_SetTPMode
        OIT_PpSwcHWRHidCommands_SetTPLanguage_PpSwcHWRHidCommands_SetTPLanguage: RteEventRef=OIT_PpSwcHWRHidCommands_SetTPLanguage_PpSwcHWRHidCommands_SetTPLanguage
        OIT_PpSwcHWRHidCommands_GetTSHwrControl_PpSwcHWRHidCommands_GetTSHwrControl: RteEventRef=OIT_PpSwcHWRHidCommands_GetTSHwrControl_PpSwcHWRHidCommands_GetTSHwrControl
        OIT_PpSwcHWRHidCommands_GetTSHwrArea_PpSwcHWRHidCommands_GetTSHwrArea: RteEventRef=OIT_PpSwcHWRHidCommands_GetTSHwrArea_PpSwcHWRHidCommands_GetTSHwrArea
        OIT_PpSwcHWRHidCommands_GetTPMode_PpSwcHWRHidCommands_GetTPMode: RteEventRef=OIT_PpSwcHWRHidCommands_GetTPMode_PpSwcHWRHidCommands_GetTPMode
        OIT_PpSwcHWRHidCommands_GetTPLanguage_PpSwcHWRHidCommands_GetTPLanguage: RteEventRef=OIT_PpSwcHWRHidCommands_GetTPLanguage_PpSwcHWRHidCommands_GetTPLanguage
        OIT_PpSwcHWRProperties_SetStrokeTimer_PpSwcHWRProperties_SetStrokeTimer: RteEventRef=OIT_PpSwcHWRProperties_SetStrokeTimer_PpSwcHWRProperties_SetStrokeTimer
        OIT_PpSwcHWRProperties_SetResultMaximumNumber_PpSwcHWRProperties_SetResultMaximumNumber: RteEventRef=OIT_PpSwcHWRProperties_SetResultMaximumNumber_PpSwcHWRProperties_SetResultMaximumNumber
        OIT_PpSwcHWRProperties_SetRecognitionStartTimer_PpSwcHWRProperties_SetRecognitionStartTimer: RteEventRef=OIT_PpSwcHWRProperties_SetRecognitionStartTimer_PpSwcHWRProperties_SetRecognitionStartTimer
        OIT_PpSwcHWRProperties_SetHWRNGramLength_PpSwcHWRProperties_SetHWRNGramLength: RteEventRef=OIT_PpSwcHWRProperties_SetHWRNGramLength_PpSwcHWRProperties_SetHWRNGramLength
        OIT_PpSwcHWRProperties_SetConfidenceThreshold_PpSwcHWRProperties_SetConfidenceThreshold: RteEventRef=OIT_PpSwcHWRProperties_SetConfidenceThreshold_PpSwcHWRProperties_SetConfidenceThreshold
        OIT_PpSwcHWRProperties_GetStrokeTimer_PpSwcHWRProperties_GetStrokeTimer: RteEventRef=OIT_PpSwcHWRProperties_GetStrokeTimer_PpSwcHWRProperties_GetStrokeTimer
        OIT_PpSwcHWRProperties_GetResultMaximumNumber_PpSwcHWRProperties_GetResultMaximumNumber: RteEventRef=OIT_PpSwcHWRProperties_GetResultMaximumNumber_PpSwcHWRProperties_GetResultMaximumNumber
        OIT_PpSwcHWRProperties_GetRecognitionStartTimer_PpSwcHWRProperties_GetRecognitionStartTimer: RteEventRef=OIT_PpSwcHWRProperties_GetRecognitionStartTimer_PpSwcHWRProperties_GetRecognitionStartTimer
        OIT_PpSwcHWRProperties_GetHWRNGramLength_PpSwcHWRProperties_GetHWRNGramLength: RteEventRef=OIT_PpSwcHWRProperties_GetHWRNGramLength_PpSwcHWRProperties_GetHWRNGramLength
        OIT_PpSwcHWRProperties_GetConfidenceThreshold_PpSwcHWRProperties_GetConfidenceThreshold: RteEventRef=OIT_PpSwcHWRProperties_GetConfidenceThreshold_PpSwcHWRProperties_GetConfidenceThreshold
        OIT_PpSwcHWRInxProperties_SetSeverityMain_PpSwcHWRInxProperties_SetSeverityMain: RteEventRef=OIT_PpSwcHWRInxProperties_SetSeverityMain_PpSwcHWRInxProperties_SetSeverityMain
        OIT_PpSwcHWRInxProperties_SetSeverityDebug_PpSwcHWRInxProperties_SetSeverityDebug: RteEventRef=OIT_PpSwcHWRInxProperties_SetSeverityDebug_PpSwcHWRInxProperties_SetSeverityDebug
        OIT_PpSwcHWRInxProperties_SetCrcAddress_PpSwcHWRInxProperties_SetCrcAddress: RteEventRef=OIT_PpSwcHWRInxProperties_SetCrcAddress_PpSwcHWRInxProperties_SetCrcAddress
        OIT_PpSwcHWRInxProperties_GetUartCatalogueVer_PpSwcHWRInxProperties_GetUartCatalogueVer: RteEventRef=OIT_PpSwcHWRInxProperties_GetUartCatalogueVer_PpSwcHWRInxProperties_GetUartCatalogueVer
        OIT_PpSwcHWRInxProperties_GetStrokeTimes_PpSwcHWRInxProperties_GetStrokeTimes: RteEventRef=OIT_PpSwcHWRInxProperties_GetStrokeTimes_PpSwcHWRInxProperties_GetStrokeTimes
        OIT_PpSwcHWRInxProperties_GetSeverityMain_PpSwcHWRInxProperties_GetSeverityMain: RteEventRef=OIT_PpSwcHWRInxProperties_GetSeverityMain_PpSwcHWRInxProperties_GetSeverityMain
        OIT_PpSwcHWRInxProperties_GetSeverityDebug_PpSwcHWRInxProperties_GetSeverityDebug: RteEventRef=OIT_PpSwcHWRInxProperties_GetSeverityDebug_PpSwcHWRInxProperties_GetSeverityDebug
        OIT_PpSwcHWRInxProperties_GetResultQueueStatus_PpSwcHWRInxProperties_GetResultQueueStatus: RteEventRef=OIT_PpSwcHWRInxProperties_GetResultQueueStatus_PpSwcHWRInxProperties_GetResultQueueStatus
        OIT_PpSwcHWRInxProperties_GetRecogTimes_PpSwcHWRInxProperties_GetRecogTimes: RteEventRef=OIT_PpSwcHWRInxProperties_GetRecogTimes_PpSwcHWRInxProperties_GetRecogTimes
        OIT_PpSwcHWRInxProperties_GetJobQueueStatus_PpSwcHWRInxProperties_GetJobQueueStatus: RteEventRef=OIT_PpSwcHWRInxProperties_GetJobQueueStatus_PpSwcHWRInxProperties_GetJobQueueStatus
        OIT_PpSwcHWRInxProperties_GetHanwangLibVerCT_PpSwcHWRInxProperties_GetHanwangLibVerCT: RteEventRef=OIT_PpSwcHWRInxProperties_GetHanwangLibVerCT_PpSwcHWRInxProperties_GetHanwangLibVerCT
        OIT_PpSwcHWRInxProperties_GetHanwangLibVerCN_PpSwcHWRInxProperties_GetHanwangLibVerCN: RteEventRef=OIT_PpSwcHWRInxProperties_GetHanwangLibVerCN_PpSwcHWRInxProperties_GetHanwangLibVerCN
        OIT_PpSwcHWRInxProperties_GetHanwangEngineVer_PpSwcHWRInxProperties_GetHanwangEngineVer: RteEventRef=OIT_PpSwcHWRInxProperties_GetHanwangEngineVer_PpSwcHWRInxProperties_GetHanwangEngineVer
        OIT_PpSwcHWRInxProperties_GetCrcAddress_PpSwcHWRInxProperties_GetCrcAddress: RteEventRef=OIT_PpSwcHWRInxProperties_GetCrcAddress_PpSwcHWRInxProperties_GetCrcAddress
        OIT_PpSwcHWRInxProperties_GetCRC32Result_PpSwcHWRInxProperties_GetCRC32Result: RteEventRef=OIT_PpSwcHWRInxProperties_GetCRC32Result_PpSwcHWRInxProperties_GetCRC32Result
        OIT_PpSwcHWRInxProperties_GetBuildTimeDate_PpSwcHWRInxProperties_GetBuildTimeDate: RteEventRef=OIT_PpSwcHWRInxProperties_GetBuildTimeDate_PpSwcHWRInxProperties_GetBuildTimeDate
        OIT_PpSwcHWRInxProperties_GetAppVersion_PpSwcHWRInxProperties_GetAppVersion: RteEventRef=OIT_PpSwcHWRInxProperties_GetAppVersion_PpSwcHWRInxProperties_GetAppVersion
        OIT_PpSwcHWRInxProperties_GetAckNackCntrs_PpSwcHWRInxProperties_GetAckNackCntrs: RteEventRef=OIT_PpSwcHWRInxProperties_GetAckNackCntrs_PpSwcHWRInxProperties_GetAckNackCntrs
        OIT_SwcHWR_TxConfirmation_PpSwcHWRTxConfirmation_HidTxConfirmation: RteEventRef=OIT_SwcHWR_TxConfirmation_PpSwcHWRTxConfirmation_HidTxConfirmation
    SwcHWR (RteSwComponentType): RteComponentTypeRef=SwcHWR, RteImplementationRef=SwcHWR_Implementation
      ComponentTypeCalibration (RteComponentTypeCalibration): RteCalibrationSupportEnabled=false
    SwcSecAccessSa2_EcuSwComposition (RteSwComponentInstance): RteSoftwareComponentInstanceRef=SwcSecAccessSa2
      6 x RteEventToTaskMapping, all with RteImmediateRestart=false:
        SecAccessSa2_InitEvent: RtePositionInTask=5, RteEventRef=SecAccessSa2_InitEvent, RteMappedToTaskRef=OsTask_ApplInitDeInit
        TMT_SecAccessSa2_MainFunction: RtePositionInTask=42, RteEventRef=TMT_SecAccessSa2_MainFunction, RteMappedToTaskRef=OsTask_ApplMainFunctions, RteUsedOsEventRef=Rte_Ev_Cyclic_OsTask_ApplMainFunctions_0_10ms, RteUsedOsAlarmRef=Rte_Al_TE_OsTask_ApplMainFunctions_0_10ms
        OIT_SecurityAccess_L11_SetSecurityAttemptCounter_SecurityAccess_L11_SetSecurityAttemptCounter: RteEventRef=OIT_SecurityAccess_L11_SetSecurityAttemptCounter_SecurityAccess_L11_SetSecurityAttemptCounter
        OIT_SecurityAccess_L11_GetSecurityAttemptCounter_SecurityAccess_L11_GetSecurityAttemptCounter: RteEventRef=OIT_SecurityAccess_L11_GetSecurityAttemptCounter_SecurityAccess_L11_GetSecurityAttemptCounter
        OIT_SecurityAccess_L11_CompareKey_SecurityAccess_L11_CompareKey: RteEventRef=OIT_SecurityAccess_L11_CompareKey_SecurityAccess_L11_CompareKey
        OIT_SecurityAccess_L11_GetSeed_SecurityAccess_L11_GetSeed: RteEventRef=OIT_SecurityAccess_L11_GetSeed_SecurityAccess_L11_GetSeed
    SwcSecAccessSa2 (RteSwComponentType): RteComponentTypeRef=SwcSecAccessSa2, RteImplementationRef=SwcSecAccessSa2_Implementation
      ComponentTypeCalibration (RteComponentTypeCalibration): RteCalibrationSupportEnabled=false
    CddTouchIs25LQ040B_EcuSwComposition (RteSwComponentInstance): RteSoftwareComponentInstanceRef=CddExtFlashIs25LQxxxB
      8 x RteEventToTaskMapping, all with RteImmediateRestart=false:
        TECddExtFlashMainFunction: RtePositionInTask=18, RteEventRef=TECddExtFlashMainFunction, RteMappedToTaskRef=OsTask_ApplMainFunctions, RteUsedOsEventRef=Rte_Ev_Cyclic_OsTask_ApplMainFunctions_0_1ms, RteUsedOsAlarmRef=Rte_Al_TE_OsTask_ApplMainFunctions_0_1ms
        MSECddExtFlashInit_0: RtePositionInTask=39, RteEventRef=MSECddExtFlashInit_0, RteMappedToTaskRef=OsTask_ApplInitDeInit, RteUsedOsEventRef=Rte_Ev_OnExit_OsTask_ApplInitDeInit_SwcDisplayControl_PpSwcDispCtrlDisplayMode_Mode_UNINIT
        MSECddExtFlashInit_1: RtePositionInTask=39, RteEventRef=MSECddExtFlashInit_1, RteMappedToTaskRef=OsTask_ApplInitDeInit, RteUsedOsEventRef=Rte_Ev_OnExit_OsTask_ApplInitDeInit_SwcDisplayControl_PpSwcDispCtrlDisplayMode_Mode_OFF
        OIT_PpCddExtFlashService_Erase_PpCddExtFlashService_Erase: RteEventRef=OIT_PpCddExtFlashService_Erase_PpCddExtFlashService_Erase
        OIT_PpCddExtFlashService_Write_PpCddExtFlashService_Write: RteEventRef=OIT_PpCddExtFlashService_Write_PpCddExtFlashService_Write
        OIT_PpCddExtFlashService_Read_PpCddExtFlashService_Read: RteEventRef=OIT_PpCddExtFlashService_Read_PpCddExtFlashService_Read
        OIT_PpCddExtFlashVersionInfo_GetVersionInfo_PpCddExtFlashVersionInfo_GetVersionInfo: RteEventRef=OIT_PpCddExtFlashVersionInfo_GetVersionInfo_PpCddExtFlashVersionInfo_GetVersionInfo
        OIT_PpCddExtFlashService_GetDeviceInfo_PpCddExtFlashService_GetDeviceInfo: RteEventRef=OIT_PpCddExtFlashService_GetDeviceInfo_PpCddExtFlashService_GetDeviceInfo
    CddTouchBackupSwdl_EcuSwComposition (RteSwComponentInstance): RteSoftwareComponentInstanceRef=CddTouchBackupSwdl
      11 x RteEventToTaskMapping, all with RteImmediateRestart=false:
        OIT_PpTouchBackupDownload_GetSlaveSizeInBytes_PpTouchBackupDownload_GetSlaveSizeInBytes: RteEventRef=OIT_PpTouchBackupDownload_GetSlaveSizeInBytes_PpTouchBackupDownload_GetSlaveSizeInBytes
        OIT_PpTouchBackupDownload_GetSlaveState_PpTouchBackupDownload_GetSlaveState: RteEventRef=OIT_PpTouchBackupDownload_GetSlaveState_PpTouchBackupDownload_GetSlaveState
        OIT_PpTouchBackupDownload_ProcessData_PpTouchBackupDownload_ProcessData: RteEventRef=OIT_PpTouchBackupDownload_ProcessData_PpTouchBackupDownload_ProcessData
        OIT_PpTouchBackupDownload_Validate_PpTouchBackupDownload_Validate: RteEventRef=OIT_PpTouchBackupDownload_Validate_PpTouchBackupDownload_Validate
        OIT_PpTouchBackupDownload_Erase_PpTouchBackupDownload_Erase: RteEventRef=OIT_PpTouchBackupDownload_Erase_PpTouchBackupDownload_Erase
        TMT_CddTouchBackupSwdl_MainFunction: RtePositionInTask=17, RteEventRef=TECddVoltMonMainFunction, RteMappedToTaskRef=OsTask_ApplMainFunctions, RteUsedOsEventRef=Rte_Ev_Cyclic_OsTask_ApplMainFunctions_0_1ms, RteUsedOsAlarmRef=Rte_Al_TE_OsTask_ApplMainFunctions_0_1ms
        MST_CddTouchBackupSwdl_Init_0: RtePositionInTask=38, RteEventRef=MSECddTchDl_0, RteMappedToTaskRef=OsTask_ApplInitDeInit, RteUsedOsEventRef=Rte_Ev_OnExit_OsTask_ApplInitDeInit_SwcDisplayControl_PpSwcDispCtrlDisplayMode_Mode_UNINIT
        OIT_PpTouchBackupDownload_GetSlaveCRC32State_PpTouchBackupDownload_GetSlaveCRC32State: RteEventRef=OIT_PpTouchBackupDownload_GetSlaveCRC32State_PpTouchBackupDownload_GetSlaveCRC32State
        OIT_PpTouchBackupDownload_CalculateCRC32_PpTouchBackupDownload_CalculateCRC32: RteEventRef=OIT_PpTouchBackupDownload_CalculateCRC32_PpTouchBackupDownload_CalculateCRC32
        MST_CddTouchBackupSwdl_Init_1: RtePositionInTask=38, RteEventRef=MSECddTchDl_1, RteMappedToTaskRef=OsTask_ApplInitDeInit, RteUsedOsEventRef=Rte_Ev_OnExit_OsTask_ApplInitDeInit_SwcDisplayControl_PpSwcDispCtrlDisplayMode_Mode_OFF
        OIT_PpCddTchDlVersionInfo_GetVersionInfo_PpCddTchDlVersionInfo_GetVersionInfo: RteEventRef=OIT_PpCddTchDlVersionInfo_GetVersionInfo_PpCddTchDlVersionInfo_GetVersionInfo
    CddTouchBackupSwdl (RteSwComponentType): RteComponentTypeRef=CddTouchBackupSwdl, RteImplementationRef=CddTouchBackupSwdl_Implementation
      ComponentTypeCalibration (RteComponentTypeCalibration): RteCalibrationSupportEnabled=false
    CddExtFlashIs25LQxxxB (RteSwComponentType): RteComponentTypeRef=CddExtFlashIs25LQxxxB, RteImplementationRef=CddExtFlashIs25LQxxxB_Implementation
      ComponentTypeCalibration (RteComponentTypeCalibration): RteCalibrationSupportEnabled=false
    CddWakeupDetection_EcuSwComposition (RteSwComponentInstance): RteSoftwareComponentInstanceRef=CddWakeupDetect
      5 x RteEventToTaskMapping, all with RteImmediateRestart=false:
        OIT_PpCddWakeupDetectionVersionInfo_GetVersionInfo_PpCddWakeupDetectionVersionInfo_GetVersionInfo: RteEventRef=OIT_PpCddWakeupDetectionVersionInfo_GetVersionInfo_PpCddWakeupDetectionVersionInfo_GetVersionInfo
        MST_CddWakeupDetection_Init_0: RtePositionInTask=40, RteEventRef=MST_CddWakeupDetection_Init_0, RteMappedToTaskRef=OsTask_ApplInitDeInit, RteUsedOsEventRef=Rte_Ev_OnExit_OsTask_ApplInitDeInit_SwcDisplayControl_PpSwcDispCtrlDisplayMode_Mode_UNINIT
        DRT_CddWUDet_ProcessBem02Data_PpSwcComRxBem02Data_NVEM_Abschaltstufe: RtePositionInTask=53, RteEventRef=DRT_CddWUDet_ProcessBem02Data_PpSwcComRxBem02Data_NVEM_Abschaltstufe, RteMappedToTaskRef=OsTask_ApplMainFunctions, RteUsedOsEventRef=Rte_Ev_Run_CddWakeupDetect_CddWUDet_ProcessBem02Data
        DRT_CddWUDet_ProcessSi01Data_PpSwcComRxSi01Data_SI_T_Mode: RtePositionInTask=54, RteEventRef=DRT_CddWUDet_ProcessSi01Data_PpSwcComRxSi01Data_SI_T_Mode, RteMappedToTaskRef=OsTask_ApplMainFunctions, RteUsedOsEventRef=Rte_Ev_Run_CddWakeupDetect_CddWUDet_ProcessSi01Data
        DRT_CddWUDet_ProcessZr01Data_PpSwcComRxZr01Data_ZR_WecktGesp: RtePositionInTask=51, RteEventRef=DRT_CddWUDet_ProcessZr01Data_PpSwcComRxZr01Data_ZR_WecktGesp, RteMappedToTaskRef=OsTask_ApplMainFunctions, RteUsedOsEventRef=Rte_Ev_Run_CddWakeupDetect_CddWUDet_ProcessZr01Data
      EACddWUDetDiagnostics (RteExclusiveAreaImplementation):
        RteExclusiveAreaImplMechanism = OS_RESOURCE
        RteExclusiveAreaRef = EACddWUDetDiagnostics
        RteExclusiveAreaOsResourceRef = Rte_Res_CddWakeupDetect_EACddWUDetDiagnostics
      7 x RteEventToTaskMapping, all with RteImmediateRestart=false:
        OIT_PpDsCddWUDetAccessResetCntrs_ConditionCheckRead_PpDsCddWUDetAccessResetCntrs_ConditionCheckRead: RteEventRef=OIT_PpDsCddWUDetAccessResetCntrs_ConditionCheckRead_PpDsCddWUDetAccessResetCntrs_ConditionCheckRead
        OIT_PpDsCddWUDetAccessResetCntrs_ReadData_PpDsCddWUDetAccessResetCntrs_ReadData: RteEventRef=OIT_PpDsCddWUDetAccessResetCntrs_ReadData_PpDsCddWUDetAccessResetCntrs_ReadData
        MST_CddWUDet_DeInit_0: RtePositionInTask=71, RteEventRef=MST_CddWUDet_DeInit_0, RteMappedToTaskRef=OsTask_ApplInitDeInit, RteUsedOsEventRef=Rte_Ev_OnEntry_OsTask_ApplInitDeInit_SwcDisplayControl_PpSwcDispCtrlDisplayMode_Mode_UNINIT
        MST_CddWUDet_Init_1: RtePositionInTask=40, RteEventRef=MST_CddWUDet_Init_1, RteMappedToTaskRef=OsTask_ApplInitDeInit, RteUsedOsEventRef=Rte_Ev_OnExit_OsTask_ApplInitDeInit_SwcDisplayControl_PpSwcDispCtrlDisplayMode_Mode_OFF
        OIT_PpCddWUDetResetToFactorySettings_ResetToFactorySettings_PpCddWUDetResetToFactorySettings_ResetToFactorySettings: RteEventRef=OIT_PpCddWUDetResetToFactorySettings_ResetToFactorySettings_PpCddWUDetResetToFactorySettings_ResetToFactorySettings
        OIT_PpCddWUDetDeviceAccess_SetDeviceAccess_PpCddWUDetDeviceAccess_SetDeviceAccess: RteEventRef=OIT_PpCddWUDetDeviceAccess_SetDeviceAccess_PpCddWUDetDeviceAccess_SetDeviceAccess
        TECddWUDetClearResetStatus: RteCyclicTriggerImplementation=None, RtePositionInTask=40, RteEventRef=TECddWUDetClearResetStatus, RteUsedOsEventRef=Rte_Ev_Run1_CddWakeupDetect_CddWUDet_ClearResetStatus, RteMappedToTaskRef=OsTask_ApplMainFunctions
    CddWakeupDetection (RteSwComponentType): RteComponentTypeRef=CddWakeupDetect, RteImplementationRef=CddWakeupDetect_Implementation
      ComponentTypeCalibration (RteComponentTypeCalibration): RteCalibrationSupportEnabled=false
    CddHWRNXPRT1171Swdl_EcuSwComposition (RteSwComponentInstance): RteSoftwareComponentInstanceRef=CddHWRNXPRT1171Swdl
      14 x RteEventToTaskMapping, all with RteImmediateRestart=false:
        OIT_PpHWRNXPRT1171Download_Validate_PpHWRNXPRT1171Download_Validate: RteEventRef=OIT_PpHWRNXPRT1171Download_Validate_PpHWRNXPRT1171Download_Validate
        OIT_PpHWRNXPRT1171Download_ProcessData_PpHWRNXPRT1171Download_ProcessData: RteEventRef=OIT_PpHWRNXPRT1171Download_ProcessData_PpHWRNXPRT1171Download_ProcessData
        OIT_PpHWRNXPRT1171Download_GetSlaveState_PpHWRNXPRT1171Download_GetSlaveState: RteEventRef=OIT_PpHWRNXPRT1171Download_GetSlaveState_PpHWRNXPRT1171Download_GetSlaveState
        OIT_PpHWRNXPRT1171Download_GetSlaveSizeInBytes_PpHWRNXPRT1171Download_GetSlaveSizeInBytes: RteEventRef=OIT_PpHWRNXPRT1171Download_GetSlaveSizeInBytes_PpHWRNXPRT1171Download_GetSlaveSizeInBytes
        OIT_PpHWRNXPRT1171Download_Erase_PpHWRNXPRT1171Download_Erase: RteEventRef=OIT_PpHWRNXPRT1171Download_Erase_PpHWRNXPRT1171Download_Erase
        MST_CddHWRNXPRT1171Swdl_Init_0: RtePositionInTask=43, RteEventRef=MSECddHwrSwdlInit_0, RteMappedToTaskRef=OsTask_ApplInitDeInit, RteUsedOsEventRef=Rte_Ev_OnExit_OsTask_ApplInitDeInit_SwcDisplayControl_PpSwcDispCtrlDisplayMode_Mode_UNINIT
        TMT_CddHWRNXPRT1171Swdl_MainFunction: RtePositionInTask=43, RteEventRef=TECddHwrSwdlMainFunction, RteMappedToTaskRef=OsTask_ApplMainFunctions, RteUsedOsEventRef=Rte_Ev_Cyclic_OsTask_ApplMainFunctions_0_10ms, RteUsedOsAlarmRef=Rte_Al_TE_OsTask_ApplMainFunctions_0_10ms
        OIT_PpHWRNXPRT1171Download_GetSlaveCRC32State_PpHWRNXPRT1171Download_GetSlaveCRC32State: RteEventRef=OIT_PpHWRNXPRT1171Download_GetSlaveCRC32State_PpHWRNXPRT1171Download_GetSlaveCRC32State
        OIT_PpHWRNXPRT1171Download_CalculateCRC32_PpHWRNXPRT1171Download_CalculateCRC32: RteEventRef=OIT_PpHWRNXPRT1171Download_CalculateCRC32_PpHWRNXPRT1171Download_CalculateCRC32
        MST_CddHWRNXPRT1171Swdl_Init_1: RtePositionInTask=43, RteEventRef=MSECddHwrSwdlInit_1, RteMappedToTaskRef=OsTask_ApplInitDeInit, RteUsedOsEventRef=Rte_Ev_OnExit_OsTask_ApplInitDeInit_SwcDisplayControl_PpSwcDispCtrlDisplayMode_Mode_OFF
        OIT_PpCddHwrSwdlVersionInfo_GetVersionInfo_PpCddHwrSwdlVersionInfo_GetVersionInfo: RteEventRef=OIT_PpCddHwrSwdlVersionInfo_GetVersionInfo_PpCddHwrSwdlVersionInfo_GetVersionInfo
        DRECddHwrSwdlHealthStatus: RtePositionInTask=73, RteEventRef=DRECddHwrSwdlHealthStatus, RteMappedToTaskRef=OsTask_ApplMainFunctions, RteUsedOsEventRef=Rte_Ev_Run_CddHWRNXPRT1171Swdl_CddHwrSwdl_ProcessHwrHealthStatus
        MST_CddHwrSwdl_SwUpdateOnEnter_0: RtePositionInTask=74, RteEventRef=MSECddHwrSwdlSwUpdateOnEnter, RteMappedToTaskRef=OsTask_ApplMainFunctions, RteUsedOsEventRef=Rte_Ev_Run_CddHWRNXPRT1171Swdl_CddHwrSwdl_SwUpdateOnEnter
        DRECddHwrSwdlHwrAppVersion: RtePositionInTask=75, RteEventRef=DRECddHwrSwdlHwrAppVersion, RteMappedToTaskRef=OsTask_ApplMainFunctions, RteUsedOsEventRef=Rte_Ev_Run_CddHWRNXPRT1171Swdl_CddHwrSwdl_ProcessCddHwrAppVersion
    CddHWRNXPRT1171Swdl (RteSwComponentType): RteComponentTypeRef=CddHWRNXPRT1171Swdl, RteImplementationRef=CddHWRNXPRT1171Swdl_Implementation
      ComponentTypeCalibration (RteComponentTypeCalibration): RteCalibrationSupportEnabled=false
    SwcIVD_EcuSwComposition (RteSwComponentInstance): RteSoftwareComponentInstanceRef=SwcIVD
      3 x RteEventToTaskMapping, all with RteImmediateRestart=false, RteMappedToTaskRef=OsTask_ApplMainFunctions:
        OIT_AppData_Dsdl1_Data_AppData_Dsdl1_Data: RtePositionInTask=57, RteEventRef=OIT_AppData_Dsdl1_Data_AppData_Dsdl1_Data, RteUsedOsEventRef=Rte_Ev_Run_SwcIVD_AppData_Dsdl1_Data
        OIT_AppData_Dsdl1_AdrRange_AppData_Dsdl1_AdrRange: RtePositionInTask=56, RteEventRef=OIT_AppData_Dsdl1_AdrRange_AppData_Dsdl1_AdrRange, RteUsedOsEventRef=Rte_Ev_Run_SwcIVD_AppData_Dsdl1_AdrRange
        OIT_AdaptionCodingOrDsdl2_Data_AdaptionCodingOrDsdl2_Data: RtePositionInTask=55, RteEventRef=OIT_AdaptionCodingOrDsdl2_Data_AdaptionCodingOrDsdl2_Data, RteUsedOsEventRef=Rte_Ev_Run_SwcIVD_AdaptionCodingOrDsdl2_Data
    ShA_EcuSwComposition (RteSwComponentInstance): RteSoftwareComponentInstanceRef=ShA
      4 x RteEventToTaskMapping, all with RteImmediateRestart=false:
        MST_Runnable_0: RtePositionInTask=77, RteEventRef=MST_Runnable_0, RteMappedToTaskRef=OsTask_ApplInitDeInit, RteUsedOsEventRef=Rte_Ev_Run_ShA_Ivd_CurrentMode_PostRun
        MST_Ivd_CurrentMode_Run_0: RtePositionInTask=78, RteEventRef=MST_Ivd_CurrentMode_Run_0, RteMappedToTaskRef=OsTask_ApplInitDeInit, RteUsedOsEventRef=Rte_Ev_Run_ShA_Ivd_CurrentMode_Run
        ShA_InitEvent: RtePositionInTask=6, RteEventRef=ShA_InitEvent, RteMappedToTaskRef=OsTask_ApplInitDeInit
        TMT_Ivd_MainFunction: RtePositionInTask=46, RteEventRef=TMT_Ivd_MainFunction, RteMappedToTaskRef=OsTask_ApplMainFunctions, RteUsedOsEventRef=Rte_Ev_Run_ShA_Ivd_MainFunction, RteUsedOsAlarmRef=Rte_Al_TE_ShA_Ivd_MainFunction
    SwcIVD (RteSwComponentType): RteComponentTypeRef=SwcIVD, RteImplementationRef=SwcIVD_Implementation
      ComponentTypeCalibration (RteComponentTypeCalibration): RteCalibrationSupportEnabled=false
    ShA (RteSwComponentType): RteComponentTypeRef=ShA, RteImplementationRef=ShA_Implementation
      ComponentTypeCalibration (RteComponentTypeCalibration): RteCalibrationSupportEnabled=false
    DiagA_EcuSwComposition (RteSwComponentInstance): RteSoftwareComponentInstanceRef=DiagA
      20 x RteEventToTaskMapping, all with RteImmediateRestart=false:
        OIT_Data_0x0245_Configuration_Hash_ConditionCheckRead_Data_0x0245_Configuration_Hash_ConditionCheckRead: RteEventRef=OIT_Data_0x0245_Configuration_Hash_ConditionCheckRead_Data_0x0245_Configuration_Hash_ConditionCheckRead
        OIT_Data_0x0245_Configuration_Hash_ReadData_Data_0x0245_Configuration_Hash_ReadData: RteEventRef=OIT_Data_0x0245_Configuration_Hash_ReadData_Data_0x0245_Configuration_Hash_ReadData
        OIT_Data_0x0249_Programming_Hash_ConditionCheckRead_Data_0x0249_Programming_Hash_ConditionCheckRead: RteEventRef=OIT_Data_0x0249_Programming_Hash_ConditionCheckRead_Data_0x0249_Programming_Hash_ConditionCheckRead
        OIT_Data_0x0249_Programming_Hash_ReadData_Data_0x0249_Programming_Hash_ReadData: RteEventRef=OIT_Data_0x0249_Programming_Hash_ReadData_Data_0x0249_Programming_Hash_ReadData
        OIT_Data_0x0250_Integrity_validation_data_configuration_list_ConditionCheckRead_Data_0x0250_Integrity_validation_data_coF4607225: RteEventRef=OIT_Data_0x0250_Integrity_validation_data_configuration_list_ConditionCheckRead_Data_0x0250_Integrity_validation_data_coF4607225
        OIT_Data_0x0250_Integrity_validation_data_configuration_list_ReadData_Data_0x0250_Integrity_validation_data_configuratio55BBACF9: RteEventRef=OIT_Data_0x0250_Integrity_validation_data_configuration_list_ReadData_Data_0x0250_Integrity_validation_data_configuratio55BBACF9
        OIT_Data_0x0250_Integrity_validation_data_configuration_list_ReadDataLength_Data_0x0250_Integrity_validation_data_configA7BA6501: RteEventRef=OIT_Data_0x0250_Integrity_validation_data_configuration_list_ReadDataLength_Data_0x0250_Integrity_validation_data_configA7BA6501
        OIT_Data_0x0250_SFD2_ConditionCheckRead_Data_0x0250_SFD2_ConditionCheckRead: RteEventRef=OIT_Data_0x0250_SFD2_ConditionCheckRead_Data_0x0250_SFD2_ConditionCheckRead
        OIT_Data_0x0250_SFD2_ReadData_Data_0x0250_SFD2_ReadData: RteEventRef=OIT_Data_0x0250_SFD2_ReadData_Data_0x0250_SFD2_ReadData
        OIT_Data_0x0250_SFD2_ReadDataLength_Data_0x0250_SFD2_ReadDataLength: RteEventRef=OIT_Data_0x0250_SFD2_ReadDataLength_Data_0x0250_SFD2_ReadDataLength
        OIT_Data_0x0250_SFD2_WriteData_Data_0x0250_SFD2_WriteData: RteEventRef=OIT_Data_0x0250_SFD2_WriteData_Data_0x0250_SFD2_WriteData
        OIT_Data_0x0250_Integrity_validation_data_configuration_list_WriteData_Data_0x0250_Integrity_validation_data_configurati9AFB355F: RteEventRef=OIT_Data_0x0250_Integrity_validation_data_configuration_list_WriteData_Data_0x0250_Integrity_validation_data_configurati9AFB355F
        OIT_Data_0xF18F_SFD2_ConditionCheckRead_Data_0xF18F_SFD2_ConditionCheckRead: RteEventRef=OIT_Data_0xF18F_SFD2_ConditionCheckRead_Data_0xF18F_SFD2_ConditionCheckRead
        OIT_Data_0xF18F_SFD2_ReadData_Data_0xF18F_SFD2_ReadData: RteEventRef=OIT_Data_0xF18F_SFD2_ReadData_Data_0xF18F_SFD2_ReadData
        OIT_Data_0xF18F_SFD2_ReadDataLength_Data_0xF18F_SFD2_ReadDataLength: RteEventRef=OIT_Data_0xF18F_SFD2_ReadDataLength_Data_0xF18F_SFD2_ReadDataLength
        OIT_Data_0xF18F_SFD2_WriteData_Data_0xF18F_SFD2_WriteData: RteEventRef=OIT_Data_0xF18F_SFD2_WriteData_Data_0xF18F_SFD2_WriteData
        OIT_Routine_0x0253_Calculate_integrity_validation_data_Start_Routine_0x0253_Calculate_integrity_validation_data_Start_Start: RteEventRef=OIT_Routine_0x0253_Calculate_integrity_validation_data_Start_Routine_0x0253_Calculate_integrity_validation_data_Start_Start
        OIT_Routine_0x0254_Calculate_individual_hash_value_Start_Routine_0x0254_Calculate_individual_hash_value_Start_Start: RteEventRef=OIT_Routine_0x0254_Calculate_individual_hash_value_Start_Routine_0x0254_Calculate_individual_hash_value_Start_Start
        OIT_SlaveListProgCfgHash_Data_SlaveListProgCfgHash_Data: RteEventRef=OIT_SlaveListProgCfgHash_Data_SlaveListProgCfgHash_Data
        OIT_SlaveListProgCfgHash_Hash_SlaveListProgCfgHash_Hash: RteEventRef=OIT_SlaveListProgCfgHash_Hash_SlaveListProgCfgHash_Hash
    DiagA (RteSwComponentType): RteComponentTypeRef=DiagA, RteImplementationRef=DiagA_Implementation
      ComponentTypeCalibration (RteComponentTypeCalibration): RteCalibrationSupportEnabled=false
    NvA_EcuSwComposition (RteSwComponentInstance): RteSoftwareComponentInstanceRef=NvA
      NvA_InitEvent (RteEventToTaskMapping): RteImmediateRestart=false, RtePositionInTask=7, RteEventRef=NvA_InitEvent, RteMappedToTaskRef=OsTask_ApplInitDeInit
    NvA (RteSwComponentType): RteComponentTypeRef=NvA, RteImplementationRef=NvA_Implementation
      ComponentTypeCalibration (RteComponentTypeCalibration): RteCalibrationSupportEnabled=false
    AppDataA_EcuSwComposition (RteSwComponentInstance): RteSoftwareComponentInstanceRef=AppDataA
      AppDataA_InitEvent (RteEventToTaskMapping): RteImmediateRestart=false, RtePositionInTask=8, RteEventRef=AppDataA_InitEvent, RteMappedToTaskRef=OsTask_ApplInitDeInit
    AppDataA (RteSwComponentType): RteComponentTypeRef=AppDataA, RteImplementationRef=AppDataA_Implementation
      ComponentTypeCalibration (RteComponentTypeCalibration): RteCalibrationSupportEnabled=false
    10 x RteBswModuleInstance:
      Adc: RteBswImplementationRef=Adc_Impl, RteBswModuleConfigurationRef=Adc
        ADC_RAMDATA_PROTECTION (RteBswExclusiveAreaImpl): RteExclusiveAreaImplMechanism=ALL_INTERRUPT_BLOCKING, RteBswExclusiveAreaRef=ADC_RAMDATA_PROTECTION
        ADC_INT_PROTECTION (RteBswExclusiveAreaImpl): RteExclusiveAreaImplMechanism=ALL_INTERRUPT_BLOCKING, RteBswExclusiveAreaRef=ADC_INT_PROTECTION
      Dio: RteBswImplementationRef=Dio_Impl, RteBswModuleConfigurationRef=Dio
        DIO_REGISTER_PROTECTION (RteBswExclusiveAreaImpl): RteExclusiveAreaImplMechanism=ALL_INTERRUPT_BLOCKING, RteBswExclusiveAreaRef=DIO_REGISTER_PROTECTION
      Fls: RteBswImplementationRef=Fls_Impl, RteBswModuleConfigurationRef=Fls
        3 x RteBswExclusiveAreaImpl, all with RteExclusiveAreaImplMechanism=ALL_INTERRUPT_BLOCKING:
          FLS_DRIVERSTATE_DATA_PROTECTION: RteBswExclusiveAreaRef=FLS_DRIVERSTATE_DATA_PROTECTION
          FLS_REGISTER_PROTECTION: RteBswExclusiveAreaRef=FLS_REGISTER_PROTECTION
          FLS_CODE_FLASH_DISABLED: RteBswExclusiveAreaRef=FLS_CODE_FLASH_DISABLED
        Fls_MainFunctionTimingEvent0 (RteBswEventToTaskMapping):
          RteBswImmediateRestart = false
          RteBswPositionInTask = 10
          RteBswEventRef = Fls_MainFunctionTimingEvent0
          RteBswMappedToTaskRef = OsTask_BswMainFunctions
          RteBswUsedOsEventRef = Rte_Ev_Cyclic2_OsTask_BswMainFunctions_0_10ms
          RteBswUsedOsAlarmRef = Rte_Al_TE2_OsTask_BswMainFunctions_0_10ms
      Gpt: RteBswImplementationRef=Gpt_Impl, RteBswModuleConfigurationRef=Gpt
        GPT_TIMERREG_PROTECTION (RteBswExclusiveAreaImpl): RteExclusiveAreaImplMechanism=ALL_INTERRUPT_BLOCKING, RteBswExclusiveAreaRef=GPT_TIMERREG_PROTECTION
        GPT_TIMERINT_PROTECTION (RteBswExclusiveAreaImpl): RteExclusiveAreaImplMechanism=ALL_INTERRUPT_BLOCKING, RteBswExclusiveAreaRef=GPT_TIMERINT_PROTECTION
      Icu: RteBswImplementationRef=Icu_Impl, RteBswModuleConfigurationRef=Icu
        4 x RteBswExclusiveAreaImpl, all with RteExclusiveAreaImplMechanism=ALL_INTERRUPT_BLOCKING:
          ICU_CHANNEL_DATA_PROTECTION: RteBswExclusiveAreaRef=ICU_CHANNEL_DATA_PROTECTION
          ICU_TIMESTAMP_DATA_PROTECTION: RteBswExclusiveAreaRef=ICU_TIMESTAMP_DATA_PROTECTION
          ICU_SIGNALMEASURE_DATA_PROTECTION: RteBswExclusiveAreaRef=ICU_SIGNALMEASURE_DATA_PROTECTION
          ICU_EDGECOUNT_DATA_PROTECTION: RteBswExclusiveAreaRef=ICU_EDGECOUNT_DATA_PROTECTION
      Mcu: RteBswImplementationRef=Mcu_Impl, RteBswModuleConfigurationRef=Mcu
        3 x RteBswExclusiveAreaImpl, all with RteExclusiveAreaImplMechanism=ALL_INTERRUPT_BLOCKING:
          MCU_PWR_MODE_PSC_PROTECTION: RteBswExclusiveAreaRef=MCU_PWR_MODE_PSC_PROTECTION
          MCU_REGISTER_PROTECTION: RteBswExclusiveAreaRef=MCU_REGISTER_PROTECTION
          MCU_VARIABLE_PROTECTION: RteBswExclusiveAreaRef=MCU_VARIABLE_PROTECTION
      Port: RteBswImplementationRef=Port_Impl, RteBswModuleConfigurationRef=Port
        11 x RteBswExclusiveAreaImpl, all with RteExclusiveAreaImplMechanism=ALL_INTERRUPT_BLOCKING:
          PORT_SET_PIN_DIR_PROTECTION: RteBswExclusiveAreaRef=PORT_SET_PIN_DIR_PROTECTION
          PORT_SET_PIN_MODE_PROTECTION: RteBswExclusiveAreaRef=PORT_SET_PIN_MODE_PROTECTION
          PORT_SET_TO_DIO_ALT_PROTECTION: RteBswExclusiveAreaRef=PORT_SET_TO_DIO_ALT_PROTECTION
          PORT_INIT_CONFIG_PROTECTION: RteBswExclusiveAreaRef=PORT_INIT_CONFIG_PROTECTION
          PORT_REFRESH_PORT_INTERNAL_PROTECTION: RteBswExclusiveAreaRef=PORT_REFRESH_PORT_INTERNAL_PROTECTION
          PORT_SET_PIN_DEFAULT_MODE_PROTECTION: RteBswExclusiveAreaRef=PORT_SET_PIN_DEFAULT_MODE_PROTECTION
          PORT_SET_PIN_DEFAULT_DIR_PROTECTION: RteBswExclusiveAreaRef=PORT_SET_PIN_DEFAULT_DIR_PROTECTION
          PORT_CHECK_HW_CONSISTENCY_PROTECTION: RteBswExclusiveAreaRef=PORT_CHECK_HW_CONSISTENCY_PROTECTION
          PORT_REGISTER_PROTECTION: RteBswExclusiveAreaRef=PORT_REGISTER_PROTECTION
          PORT_INIT_PROTECTION: RteBswExclusiveAreaRef=PORT_INIT_PROTECTION
          PORT_FILTER_CONFIG_PROTECTION: RteBswExclusiveAreaRef=PORT_FILTER_CONFIG_PROTECTION
      Pwm: RteBswImplementationRef=Pwm_Impl, RteBswModuleConfigurationRef=Pwm
        PWM_REGISTERS_PROTECTION (RteBswExclusiveAreaImpl): RteExclusiveAreaImplMechanism=ALL_INTERRUPT_BLOCKING, RteBswExclusiveAreaRef=PWM_REGISTERS_PROTECTION
      Spi: RteBswImplementationRef=Spi_Impl, RteBswModuleConfigurationRef=Spi
        6 x RteBswExclusiveAreaImpl, all with RteExclusiveAreaImplMechanism=ALL_INTERRUPT_BLOCKING:
          SPI_RAM_DATA_PROTECTION: RteBswExclusiveAreaRef=SPI_RAM_DATA_PROTECTION
          SPI_CHIP_SELECT_PROTECTION: RteBswExclusiveAreaRef=SPI_CHIP_SELECT_PROTECTION
          SPI_REG_PROTECTION: RteBswExclusiveAreaRef=SPI_REG_PROTECTION
          SPI_DMA_PROTECTION: RteBswExclusiveAreaRef=SPI_DMA_PROTECTION
          SPI_REENTRANCY_PROTECTION: RteBswExclusiveAreaRef=SPI_REENTRANCY_PROTECTION
          SPI_INTERRUPT_CONTROL_PROTECTION: RteBswExclusiveAreaRef=SPI_INTERRUPT_CONTROL_PROTECTION
        Spi_MainFunction_HandlingTimingEvent0 (RteBswEventToTaskMapping): RteBswImmediateRestart=false, RteBswEventRef=Spi_MainFunction_HandlingTimingEvent0
      Wdg: RteBswImplementationRef=Wdg_Impl, RteBswModuleConfigurationRef=Wdg
        WDG_59_DRIVERA_MODE_SWITCH_PROTECTION (RteBswExclusiveAreaImpl): RteExclusiveAreaImplMechanism=ALL_INTERRUPT_BLOCKING, RteBswExclusiveAreaRef=WDG_59_DRIVERA_MODE_SWITCH_PROTECTION
        WDG_59_DRIVERA_TRIGG_PROTECTION (RteBswExclusiveAreaImpl): RteExclusiveAreaImplMechanism=ALL_INTERRUPT_BLOCKING, RteBswExclusiveAreaRef=WDG_59_DRIVERA_TRIGG_PROTECTION
    CddTestIO_EcuSwComposition (RteSwComponentInstance): RteSoftwareComponentInstanceRef=CddTestIO
      EACddTestIODeviceAccess (RteExclusiveAreaImplementation): RteExclusiveAreaImplMechanism=ALL_INTERRUPT_BLOCKING, RteExclusiveAreaRef=EACddTestIODeviceAccess
      4 x RteEventToTaskMapping, all with RteImmediateRestart=false:
        OIT_PpCddTestIOGetVersionInfo_GetVersionInfo_PpCddTestIOGetVersionInfo_GetVersionInfo: RteEventRef=OIT_PpCddTestIOGetVersionInfo_GetVersionInfo_PpCddTestIOGetVersionInfo_GetVersionInfo
        OIT_PpCddTestIODeviceAccess_SetDeviceAccess_PpCddTestIODeviceAccess_SetDeviceAccess: RteEventRef=OIT_PpCddTestIODeviceAccess_SetDeviceAccess_PpCddTestIODeviceAccess_SetDeviceAccess
        MST_CddTestIO_Init_1: RtePositionInTask=44, RteEventRef=MST_CddTestIO_Init_0, RteMappedToTaskRef=OsTask_ApplInitDeInit, RteUsedOsEventRef=Rte_Ev_OnEntry_OsTask_ApplInitDeInit_SwcDisplayControl_PpSwcDispCtrlDisplayMode_Mode_INIT
        OIT_PpCddTestIOControlTestIO_ReportEvent_PpCddTestIOControlTestIO_ReportEvent_001: RteEventRef=OIT_PpCddTestIOControlTestIO_ReportEvent_PpCddTestIOControlTestIO_ReportEvent
    CddKnockout (RteSwComponentType): RteComponentTypeRef=CddKnockout, RteImplementationRef=CddKnockout_Implementation
      ComponentTypeCalibration (RteComponentTypeCalibration): RteCalibrationSupportEnabled=false
    CddUart (RteBswModuleInstance): RteBswImplementationRef=CddUart_Impl, RteBswModuleConfigurationRef=CddUart
      EACddUartBufferAccess (RteBswExclusiveAreaImpl): RteExclusiveAreaImplMechanism=ALL_INTERRUPT_BLOCKING, RteBswExclusiveAreaRef=EACddUartBufferAccess
      CddUart_MainFuntionTimingEvent (RteBswEventToTaskMapping):
        RteBswImmediateRestart = false
        RteBswPositionInTask = 18
        RteBswEventRef = CddUart_MainFuntionTimingEvent0
        RteBswMappedToTaskRef = OsTask_BswMainFunctions
        RteBswUsedOsEventRef = Rte_Ev_Run_CddUart_CddUart_MainFunction
        RteBswUsedOsAlarmRef = Rte_Al_TE_CddUart_CddUart_MainFunction
    CddTestIO (RteSwComponentType): RteImplementationRef=CddTestIO_Implementation, RteComponentTypeRef=CddTestIO
      ComponentTypeCalibration (RteComponentTypeCalibration): RteCalibrationSupportEnabled=false
    CalibErrors_EcuSwComposition (RteSwComponentInstance): RteSoftwareComponentInstanceRef=CalibErrors
    CalibErrors (RteSwComponentType): RteComponentTypeRef=CalibErrors
      ComponentTypeCalibration (RteComponentTypeCalibration): RteCalibrationSupportEnabled=false
    CddKnockout_EcuSwComposition (RteSwComponentInstance): RteSoftwareComponentInstanceRef=CddKnockout
      6 x RteEventToTaskMapping, all with RteImmediateRestart=false:
        MSECddKoInit_0: RtePositionInTask=42, RteEventRef=MSECddKoInit_0, RteMappedToTaskRef=OsTask_ApplInitDeInit, RteUsedOsEventRef=Rte_Ev_OnExit_OsTask_ApplInitDeInit_SwcDisplayControl_PpSwcDispCtrlDisplayMode_Mode_OFF
        MSECddKoInit_1: RtePositionInTask=42, RteEventRef=MSECddKoInit_1, RteMappedToTaskRef=OsTask_ApplInitDeInit, RteUsedOsEventRef=Rte_Ev_OnExit_OsTask_ApplInitDeInit_SwcDisplayControl_PpSwcDispCtrlDisplayMode_Mode_UNINIT
        MSECddKoDeinit: RtePositionInTask=72, RteEventRef=MSECddKoDeinit, RteMappedToTaskRef=OsTask_ApplInitDeInit, RteUsedOsEventRef=Rte_Ev_OnEntry_OsTask_ApplInitDeInit_SwcDisplayControl_PpSwcDispCtrlDisplayMode_Mode_UNINIT
        TECddKoMainFunction: RtePositionInTask=45, RteEventRef=TECddKoMainFunction, RteMappedToTaskRef=OsTask_ApplMainFunctions, RteUsedOsEventRef=Rte_Ev_Cyclic_OsTask_ApplMainFunctions_0_10ms, RteUsedOsAlarmRef=Rte_Al_TE_OsTask_ApplMainFunctions_0_10ms
        OIT_PpCddEcuKnockoutVersionInfo_GetVersionInfo_PpCddEcuKnockoutVersionInfo_GetVersionInfo: RteEventRef=OIT_PpCddEcuKnockoutVersionInfo_GetVersionInfo_PpCddEcuKnockoutVersionInfo_GetVersionInfo
        DRECddKoBem02Data: RtePositionInTask=1, RteEventRef=DRECddKoBem02Data, RteMappedToTaskRef=OsTask_Communication, RteUsedOsEventRef=Rte_Ev_Run_CddKnockout_CddKo_ProcessBem02Data
