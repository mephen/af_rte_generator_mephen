AUTOSAR XML (schema 00048)
package /ActiveEcuC
  module config Os1: definition=Os
    4 x OsApplication:
      App0: OsTrusted=TRUE, OsTrustedApplicationDelayTimingViolationCall=TRUE, OsTrustedApplicationWithProtection=TRUE, OsApplicationCoreRef=EcucCoreDefinition0, OsAppCounterRef=counter3, OsAppTaskRef=T001, OsAppTaskRef=T002, OsAppTaskRef=T003, OsAppIsrRef=I001, OsAppIsrRef=I002, OsAppIsrRef=I003, OsAppIsrRef=I004, OsAppAlarmRef=alarm3, OsAppAlarmRef=alarm4, OsAppScheduleTableRef=ST1, OsAppScheduleTableRef=ST2, OsRestartTask=T003
        AIMER (OsApplicationTrustedFunction): OsTrustedFunctionName=AIMER, OsMemoryMappingCodeLocationRef=None
      A02: OsTrusted=TRUE, OsTrustedApplicationDelayTimingViolationCall=TRUE, OsTrustedApplicationWithProtection=FALSE, OsApplicationCoreRef=EcucCoreDefinition1, OsAppCounterRef=counter1, OsAppTaskRef=T101, OsAppTaskRef=T102, OsAppTaskRef=T103, OsAppIsrRef=I101, OsAppIsrRef=I102, OsAppIsrRef=I103, OsAppIsrRef=I104, OsAppAlarmRef=alarm1, OsAppScheduleTableRef=ST3, OsRestartTask=T103
        YUURI (OsApplicationTrustedFunction): OsTrustedFunctionName=YUURI, OsMemoryMappingCodeLocationRef=None
        HITORIE (OsApplicationTrustedFunction): OsTrustedFunctionName=HITORIE, OsMemoryMappingCodeLocationRef=None
      A03: OsTrusted=TRUE, OsTrustedApplicationDelayTimingViolationCall=FALSE, OsTrustedApplicationWithProtection=FALSE, OsApplicationCoreRef=EcucCoreDefinition0, OsAppCounterRef=counter4, OsAppTaskRef=T004, OsAppTaskRef=T005, OsAppTaskRef=T006, OsAppIsrRef=I005, OsAppIsrRef=I006, OsRestartTask=T006
      A04: OsTrusted=FALSE, OsTrustedApplicationDelayTimingViolationCall=FALSE, OsTrustedApplicationWithProtection=FALSE, OsApplicationCoreRef=EcucCoreDefinition1, OsAppCounterRef=counter2, OsAppTaskRef=T104, OsAppTaskRef=T105, OsAppTaskRef=T106, OsAppIsrRef=I105, OsAppIsrRef=I106, OsRestartTask=T106
    9 x OsTask, all with OsTaskSchedule=FULL, OsTaskStackSize=512:
      T001: OsTaskActivation=55, OsTaskPriority=1, OsTaskType=BASIC, OsTaskAccessingApplication=A01, OsTaskAccessingApplication=A02, OsTaskAccessingApplication=A03, OsTaskAccessingApplication=A04, OsTaskResourceRef=resource1
        OAT1 (OsTaskAutostart): OsTaskAppModeRef=AppMode1
        OTTP (OsTaskTimingProtection): OsTaskExecutionBudget=1, OsTaskAllInterruptLockBudget=10, OsTaskOsInterruptLockBudget=10, OsTaskTimeFrame=20
      T002: OsTaskActivation=10, OsTaskPriority=2, OsTaskType=EXTENDED, OsTaskAccessingApplication=A01, OsTaskAccessingApplication=A02, OsTaskAccessingApplication=A03, OsTaskAccessingApplication=A04, OsTaskResourceRef=resource1, OsTaskResourceRef=resource2
      T003: OsTaskActivation=10, OsTaskPriority=5, OsTaskType=BASIC, OsTaskAccessingApplication=A01, OsTaskAccessingApplication=A02, OsTaskAccessingApplication=A03, OsTaskAccessingApplication=A04, OsTaskEventRef=event3
      T004: OsTaskActivation=10, OsTaskPriority=3, OsTaskType=EXTENDED, OsTaskAccessingApplication=A01, OsTaskAccessingApplication=A02, OsTaskAccessingApplication=A03, OsTaskAccessingApplication=A04, OsTaskResourceRef=resource1, OsTaskResourceRef=resource2
        OTTP4 (OsTaskTimingProtection): OsTaskExecutionBudget=3, OsTaskAllInterruptLockBudget=20, OsTaskOsInterruptLockBudget=20, OsTaskTimeFrame=20
      T005: OsTaskActivation=1, OsTaskPriority=3, OsTaskType=BASIC, OsTaskAccessingApplication=A01, OsTaskAccessingApplication=A02, OsTaskAccessingApplication=A03, OsTaskAccessingApplication=A04, OsTaskEventRef=event3
        OTTP5 (OsTaskTimingProtection): OsTaskExecutionBudget=100, OsTaskAllInterruptLockBudget=30, OsTaskOsInterruptLockBudget=30, OsTaskTimeFrame=20
          3 x OsTaskResourceLock:
            OTTR5-1: OsTaskResourceLockResourceRef=resource1, OsTaskResourceLockBudget=30
            OTTR5-2: OsTaskResourceLockResourceRef=resource2, OsTaskResourceLockBudget=30
            OTTR5-3: OsTaskResourceLockResourceRef=resource3, OsTaskResourceLockBudget=10
      T006: OsTaskActivation=10, OsTaskPriority=1, OsTaskType=BASIC, OsTaskAccessingApplication=A01, OsTaskAccessingApplication=A02, OsTaskAccessingApplication=A03, OsTaskAccessingApplication=A04, OsTaskResourceRef=resource1, OsTaskResourceRef=resource2
      T101: OsTaskActivation=1, OsTaskPriority=3, OsTaskType=EXTENDED, OsTaskAccessingApplication=A01, OsTaskAccessingApplication=A02, OsTaskAccessingApplication=A03, OsTaskAccessingApplication=A04, OsTaskResourceRef=resource1, OsTaskResourceRef=resource2
      T102: OsTaskActivation=10, OsTaskPriority=2, OsTaskType=BASIC, OsTaskAccessingApplication=A01, OsTaskAccessingApplication=A02, OsTaskAccessingApplication=A03, OsTaskAccessingApplication=A04
      T103: OsTaskActivation=10, OsTaskPriority=2, OsTaskType=BASIC
    6 x OsResource, all with OsResourceProperty=STANDARD:
      resource1: OsResourceAccessingApplication=A01
      resource2: OsResourceAccessingApplication=A01
      resource3: OsResourceAccessingApplication=A03
      resource{4..6}: OsResourceAccessingApplication=A02, OsResourceAccessingApplication=A04
    ST001 (OsScheduleTable): OsScheduleTableDuration=10, OsScheduleTableRepeating=FALSE, OsTaskAccessingApplication=App0, OsScheduleTableCounterRef=Counter001
      OSTstart1 (OsScheduleTableAutostart): OsScheduleTableAutostartType=ABSOLUTE, OsScheduleTableStartValue=2, OsScheduleTableAppModeRef=AppMode1
      3 x OsScheduleTableExpiryPoint:
        ep0: OsScheduleTblExpPointOffset=2
          OSTactivatetask1-1 (OsScheduleTableTaskActivation): OsScheduleTableActivateTaskRef=T002
          OSTadjustpoint1-1 (OsScheduleTblAdjustableExpPoint): OsScheduleTableMaxLengthen=1, OsScheduleTableMaxShorten=1
        ep1: OsScheduleTblExpPointOffset=5
          OSTactivatetask1-2 (OsScheduleTableTaskActivation): OsScheduleTableActivateTaskRef=T003
          OSTadjustpoint1-2 (OsScheduleTblAdjustableExpPoint): OsScheduleTableMaxLengthen=1, OsScheduleTableMaxShorten=1
        ep2: OsScheduleTblExpPointOffset=8
          OSTactivatetask1-1 (OsScheduleTableTaskActivation): OsScheduleTableActivateTaskRef=T004
          OSTadjustpoint1-1 (OsScheduleTblAdjustableExpPoint): OsScheduleTableMaxLengthen=1, OsScheduleTableMaxShorten=1
      OSTsync1 (OsScheduleTableSync): OsScheduleTblExplicitPrecision=0, OsScheduleTblSyncStrategy=EXPLICIT
    ST2 (OsScheduleTable): OsScheduleTableDuration=7, OsScheduleTableRepeating=FALSE, OsTaskAccessingApplication=A01, OsScheduleTableCounterRef=counter3
      OSTstart2 (OsScheduleTableAutostart): OsScheduleTableAutostartType=ABSOLUTE, OsScheduleTableStartValue=2, OsScheduleTableAppModeRef=AppMode1
      ep20 (OsScheduleTableExpiryPoint): OsScheduleTblExpPointOffset=2
        OSTactivatetask21-1 (OsScheduleTableTaskActivation): OsScheduleTableActivateTaskRef=T004
        OSTadjustpoint21-1 (OsScheduleTblAdjustableExpPoint): OsScheduleTableMaxLengthen=0, OsScheduleTableMaxShorten=0
      ep21 (OsScheduleTableExpiryPoint): OsScheduleTblExpPointOffset=5
        OSTactivatetask21-2 (OsScheduleTableTaskActivation): OsScheduleTableActivateTaskRef=T005
        OSTadjustpoint1-3 (OsScheduleTblAdjustableExpPoint): OsScheduleTableMaxLengthen=0, OsScheduleTableMaxShorten=0
      OSTsync2 (OsScheduleTableSync): OsScheduleTblExplicitPrecision=0, OsScheduleTblSyncStrategy=NONE
    4 x OsCounter:
      counter1: OsCounterMaxAllowedValue=100, OsCounterMinCycle=2, OsCounterTicksPerBase=10, OsCounterType=HARDWARE
      counter2: OsCounterMaxAllowedValue=500, OsCounterMinCycle=10, OsCounterTicksPerBase=10, OsCounterType=SOFTWARE
      counter3: OsCounterMaxAllowedValue=294967295, OsCounterMinCycle=1, OsCounterTicksPerBase=1, OsCounterType=SOFTWARE
      counter4: OsCounterMaxAllowedValue=500, OsCounterMinCycle=10, OsCounterTicksPerBase=10, OsCounterType=HARDWARE
    8 x OsIsr, all with OsIsrCategory=CATEGORY_2:
      I{001..006}
      I105
      I106
    IOC (OsIoc)
      3 x OsIocCommunication, all with OsIocBufferLength=30:
        Q1
          IOC_QUE_DATA (OsIocDataProperties): OsIocInitValue=1, OsIocDataTypeRef=int
          RCV (OsIocReceiverProperties): OsIocFunctionImplementationKind=FUNCTION, OsIocReceivingOsApplicationRef=A03
          SND (OsIocSenderProperties): OsIocSenderId=0, OsIocFunctionImplementationKind=FUNCTION, OsIocSendingOsApplicationRef=A01
        Q2
          IOC_QUE_DATA (OsIocDataProperties): OsIocDataPropertyIndex=0, OsIocInitValue=0U, OsIocDataTypeRef=int
          RCV (OsIocReceiverProperties): OsIocFunctionImplementationKind=FUNCTION, OsIocReceivingOsApplicationRef=A02
          SND (OsIocSenderProperties): OsIocFunctionImplementationKind=FUNCTION, OsIocSendingOsApplicationRef=A01
        Q3
          IOC_QUE_DATA (OsIocDataProperties): OsIocDataPropertyIndex=0, OsIocInitValue=0U, OsIocDataTypeRef=void*,int
          RCV (OsIocReceiverProperties): OsIocFunctionImplementationKind=FUNCTION, OsIocReceivingOsApplicationRef=A03
          SND (OsIocSenderProperties): OsIocFunctionImplementationKind=FUNCTION, OsIocSendingOsApplicationRef=A01
