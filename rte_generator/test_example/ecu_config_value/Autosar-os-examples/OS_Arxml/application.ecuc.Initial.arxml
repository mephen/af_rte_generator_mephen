[part 1 of 2: package /InitialEcuC]
AUTOSAR XML (schema 00048)
package /InitialEcuC
  ecuc value collection InitialEcuC: ecuc-values=[Can, CanIf, CanNm, CanSM, CanTp, Com, ComM, Dcm, Dem, EcuC, EcuM, Nm, PduR]
  module config Can
    CanConfigSet
      CT_MIBCAN_e05e8304 (CanController):  # MIBCAN
        CanControllerActivation = true
        CanControllerDefaultBaudrate = CanControllerBaudrateConfig
        CanControllerSystemRef = CT_MIBCAN
        CanWakeupSourceRef = EcuMCommonConfiguration/CN_MIBCAN_0d25aee7
        CanControllerBaudrateConfig: CanControllerBaudRate=500
      3 x CanHardwareObject, all with CanHandleType=BASIC, CanIdValue=0, CanControllerRef=CanConfigSet/CT_MIBCAN_e05e8304:
        CN_MIBCAN_0d25aee7_Tx: CanObjectType=TRANSMIT
        CN_MIBCAN_0dc5442a_Rx: CanIdType=EXTENDED, CanObjectType=RECEIVE
        CN_MIBCAN_388f12d2_Rx: CanIdType=STANDARD, CanObjectType=RECEIVE
    CanGeneral: CanIndex=0
  module config CanIf
    CanIfCtrlDrvCfg_7d254554 (CanIfCtrlDrvCfg): CanIfCtrlDrvInitHohConfigRef=CanIfInitHohCfg, CanIfCtrlDrvNameRef=CanGeneral
      CT_MIBCAN_e05e8304 (CanIfCtrlCfg): CanIfCtrlCanCtrlRef=CanConfigSet/CT_MIBCAN_e05e8304
    CanIfInitCfg
      CHNL_743fe937 (CanIfBufferCfg): CanIfBufferSize=0, CanIfBufferHthRef=CanIfInitHohCfg/CN_MIBCAN_0d25aee7_Tx
      CanIfInitHohCfg: CanIfInitRefCfgSet=CanConfigSet
        CN_MIBCAN_0dc5442a_Rx (CanIfHrhCfg): CanIfHrhCanCtrlIdRef=CanIfCtrlDrvCfg_7d254554/CT_MIBCAN_e05e8304, CanIfHrhIdSymRef=CanConfigSet/CN_MIBCAN_0dc5442a_Rx
        CN_MIBCAN_388f12d2_Rx (CanIfHrhCfg): CanIfHrhCanCtrlIdRef=CanIfCtrlDrvCfg_7d254554/CT_MIBCAN_e05e8304, CanIfHrhIdSymRef=CanConfigSet/CN_MIBCAN_388f12d2_Rx
        CN_MIBCAN_0d25aee7_Tx (CanIfHthCfg): CanIfHthCanCtrlIdRef=CanIfCtrlDrvCfg_7d254554/CT_MIBCAN_e05e8304, CanIfHthIdSymRef=CanConfigSet/CN_MIBCAN_0d25aee7_Tx
      18 x CanIfRxPduCfg:
        ABT_1_MIB_ab_Gen3_cd68483f_Rx: CanIfRxPduCanIdType=EXTENDED_CAN, CanIfRxPduDlc=8, CanIfRxPduUserRxIndicationName=CanNm_RxIndication, CanIfRxPduUserRxIndicationUL=CAN_NM, CanIfRxPduHrhIdRef=CanIfInitHohCfg/CN_MIBCAN_0dc5442a_Rx, CanIfRxPduRef=ABT_1_MIB_ab_Gen3_46f0b378_Rx
          CHNL_dd3b3b77 (CanIfRxPduCanIdRange): CanIfRxPduCanIdRangeLowerCanId=452984832, CanIfRxPduCanIdRangeUpperCanId=452985087
        BEM_02_oMIBCAN_0038b99f_Rx: CanIfRxPduCanId=1635, CanIfRxPduCanIdType=STANDARD_CAN, CanIfRxPduDataChecksumPdu=false, CanIfRxPduDlc=8, CanIfRxPduUserRxIndicationName=PduR_CanIfRxIndication, CanIfRxPduUserRxIndicationUL=PDUR, CanIfRxPduHrhIdRef=CanIfInitHohCfg/CN_MIBCAN_388f12d2_Rx, CanIfRxPduRef=EcucPduCollection/BEM_02_oMIBCAN_4c571fd1_Rx
        DEV_ABT_1_Req_00_oMIBCAN_7ab23cc2_Rx: CanIfRxPduCanId=469732096, CanIfRxPduCanIdType=EXTENDED_CAN, CanIfRxPduDlc=8, CanIfRxPduHrhIdRef=CanIfInitHohCfg/CN_MIBCAN_0dc5442a_Rx, CanIfRxPduRef=DEV_ABT_1_Req_00_oMIBCAN_71c03311_Rx
        DEV_ABT_1_Req_04_Tp_oMIBCAN_79d92da2_Rx: CanIfRxPduCanId=469732100, CanIfRxPduCanIdType=EXTENDED_CAN, CanIfRxPduDlc=8, CanIfRxPduUserRxIndicationUL=CDD, CanIfRxPduHrhIdRef=CanIfInitHohCfg/CN_MIBCAN_0dc5442a_Rx, CanIfRxPduRef=DEV_ABT_1_Req_04_Tp_oMIBCAN_5e6f9bc1_Rx
        DEV_ABT_1_Req_05_oMIBCAN_f3bebcbb_Rx: CanIfRxPduCanId=469732111, CanIfRxPduCanIdType=EXTENDED_CAN, CanIfRxPduDlc=8, CanIfRxPduHrhIdRef=CanIfInitHohCfg/CN_MIBCAN_0dc5442a_Rx, CanIfRxPduRef=DEV_ABT_1_Req_05_oMIBCAN_2ff6e9e4_Rx
        DIA_ABT_1_Req_Tp_oMIBCAN_474a9bc3_Rx: CanIfRxPduCanId=402396686, CanIfRxPduCanIdType=EXTENDED_CAN, CanIfRxPduDlc=8, CanIfRxPduUserRxIndicationName=CanTp_RxIndication, CanIfRxPduUserRxIndicationType=PDUID_PDUINFOPTR, CanIfRxPduUserRxIndicationUL=CAN_TP, CanIfRxPduHrhIdRef=CanIfInitHohCfg/CN_MIBCAN_0dc5442a_Rx, CanIfRxPduRef=DIA_ABT_1_Req_Tp_oMIBCAN_f012988b_Rx
        Diag_ABT_1_Req_Tp_oMIBCAN_38a4da79_Rx: CanIfRxPduCanId=402392590, CanIfRxPduCanIdType=EXTENDED_CAN, CanIfRxPduDlc=8, CanIfRxPduUserRxIndicationName=CanTp_RxIndication, CanIfRxPduUserRxIndicationType=PDUID_PDUINFOPTR, CanIfRxPduUserRxIndicationUL=CAN_TP, CanIfRxPduHrhIdRef=CanIfInitHohCfg/CN_MIBCAN_0dc5442a_Rx, CanIfRxPduRef=Diag_ABT_1_Req_Tp_oMIBCAN_87b87875_Rx
        Diagnose_01_oMIBCAN_661d886e_Rx: CanIfRxPduCanId=1714, CanIfRxPduCanIdType=STANDARD_CAN, CanIfRxPduDataChecksumPdu=false, CanIfRxPduDlc=8, CanIfRxPduUserRxIndicationName=PduR_CanIfRxIndication, CanIfRxPduUserRxIndicationUL=PDUR, CanIfRxPduHrhIdRef=CanIfInitHohCfg/CN_MIBCAN_388f12d2_Rx, CanIfRxPduRef=EcucPduCollection/Diagnose_01_oMIBCAN_26fceb25_Rx
        Dimmung_01_oMIBCAN_904358ae_Rx: CanIfRxPduCanId=1520, CanIfRxPduCanIdType=STANDARD_CAN, CanIfRxPduDataChecksumPdu=false, CanIfRxPduDlc=8, CanIfRxPduUserRxIndicationName=PduR_CanIfRxIndication, CanIfRxPduUserRxIndicationUL=PDUR, CanIfRxPduHrhIdRef=CanIfInitHohCfg/CN_MIBCAN_388f12d2_Rx, CanIfRxPduRef=EcucPduCollection/Dimmung_01_oMIBCAN_b983c4ee_Rx
        HID_ABT_1_ZR_Resp_Tp_oMIBCAN_7ba72d76_Rx: CanIfRxPduCanId=402289649, CanIfRxPduCanIdType=EXTENDED_CAN, CanIfRxPduDlc=8, CanIfRxPduUserRxIndicationName=CanTp_RxIndication, CanIfRxPduUserRxIndicationType=PDUID_PDUINFOPTR, CanIfRxPduUserRxIndicationUL=CAN_TP, CanIfRxPduHrhIdRef=CanIfInitHohCfg/CN_MIBCAN_0dc5442a_Rx, CanIfRxPduRef=HID_ABT_1_ZR_Resp_Tp_oMIBCAN_bee4c682_Rx
        HID_ZR_ABT_1_Req_Tp_oMIBCAN_b8eef350_Rx: CanIfRxPduCanId=402158577, CanIfRxPduCanIdType=EXTENDED_CAN, CanIfRxPduDlc=8, CanIfRxPduUserRxIndicationName=CanTp_RxIndication, CanIfRxPduUserRxIndicationType=PDUID_PDUINFOPTR, CanIfRxPduUserRxIndicationUL=CAN_TP, CanIfRxPduHrhIdRef=CanIfInitHohCfg/CN_MIBCAN_0dc5442a_Rx, CanIfRxPduRef=HID_ZR_ABT_1_Req_Tp_oMIBCAN_570e7390_Rx
        KS_SSN_ABT_1_Req_Tp_oMIBCAN_06f9c72f_Rx: CanIfRxPduCanId=402415630, CanIfRxPduCanIdType=EXTENDED_CAN, CanIfRxPduDlc=8, CanIfRxPduUserRxIndicationName=CanTp_RxIndication, CanIfRxPduUserRxIndicationType=PDUID_PDUINFOPTR, CanIfRxPduUserRxIndicationUL=CAN_TP, CanIfRxPduHrhIdRef=CanIfInitHohCfg/CN_MIBCAN_0dc5442a_Rx, CanIfRxPduRef=KS_SSN_ABT_1_Req_Tp_oMIBCAN_2d9643dd_Rx
        Klemmen_Status_01_oMIBCAN_38ddc37c_Rx: CanIfRxPduCanId=960, CanIfRxPduCanIdType=STANDARD_CAN, CanIfRxPduDataChecksumPdu=false, CanIfRxPduDlc=4, CanIfRxPduUserRxIndicationName=PduR_CanIfRxIndication, CanIfRxPduUserRxIndicationUL=PDUR, CanIfRxPduHrhIdRef=CanIfInitHohCfg/CN_MIBCAN_388f12d2_Rx, CanIfRxPduRef=EcucPduCollection/Klemmen_Status_01_oMIBCAN_cc9f7e61_Rx
        OBDC_SSN_ABT_1_Req_Tp_oMIBCAN_8bc544e3_Rx: CanIfRxPduCanId=402419726, CanIfRxPduCanIdType=EXTENDED_CAN, CanIfRxPduDlc=8, CanIfRxPduUserRxIndicationName=CanTp_RxIndication, CanIfRxPduUserRxIndicationType=PDUID_PDUINFOPTR, CanIfRxPduUserRxIndicationUL=CAN_TP, CanIfRxPduHrhIdRef=CanIfInitHohCfg/CN_MIBCAN_0dc5442a_Rx, CanIfRxPduRef=OBDC_SSN_ABT_1_Req_Tp_oMIBCAN_24a71a07_Rx
        ORU_01_oMIBCAN_f2184f69_Rx: CanIfRxPduCanId=441800008, CanIfRxPduCanIdType=EXTENDED_CAN, CanIfRxPduDataChecksumPdu=false, CanIfRxPduDlc=8, CanIfRxPduUserRxIndicationName=PduR_CanIfRxIndication, CanIfRxPduUserRxIndicationUL=PDUR, CanIfRxPduHrhIdRef=CanIfInitHohCfg/CN_MIBCAN_0dc5442a_Rx, CanIfRxPduRef=EcucPduCollection/ORU_01_oMIBCAN_ee71652b_Rx
        Systeminfo_01_oMIBCAN_79e9fd34_Rx: CanIfRxPduCanId=1413, CanIfRxPduCanIdType=STANDARD_CAN, CanIfRxPduDataChecksumPdu=false, CanIfRxPduDlc=8, CanIfRxPduUserRxIndicationName=PduR_CanIfRxIndication, CanIfRxPduUserRxIndicationUL=PDUR, CanIfRxPduHrhIdRef=CanIfInitHohCfg/CN_MIBCAN_388f12d2_Rx, CanIfRxPduRef=EcucPduCollection/Systeminfo_01_oMIBCAN_de81f20c_Rx
        Zentralrechner_01_oMIBCAN_2d88dbe0_Rx: CanIfRxPduCanId=1140, CanIfRxPduCanIdType=STANDARD_CAN, CanIfRxPduDataChecksumPdu=false, CanIfRxPduDlc=8, CanIfRxPduUserRxIndicationName=PduR_CanIfRxIndication, CanIfRxPduUserRxIndicationUL=PDUR, CanIfRxPduHrhIdRef=CanIfInitHohCfg/CN_MIBCAN_388f12d2_Rx, CanIfRxPduRef=EcucPduCollection/Zentralrechner_01_oMIBCAN_76551c99_Rx
        Zentralrechner_04_oMIBCAN_09c51e32_Rx: CanIfRxPduCanId=441800317, CanIfRxPduCanIdType=EXTENDED_CAN, CanIfRxPduDataChecksumPdu=false, CanIfRxPduDlc=8, CanIfRxPduUserRxIndicationName=PduR_CanIfRxIndication, CanIfRxPduUserRxIndicationUL=PDUR, CanIfRxPduHrhIdRef=CanIfInitHohCfg/CN_MIBCAN_0dc5442a_Rx, CanIfRxPduRef=EcucPduCollection/Zentralrechner_04_oMIBCAN_2863c66c_Rx
      19 x CanIfTxPduCfg, all with CanIfTxPduDlc=8, CanIfTxPduBufferRef=CanIfInitCfg/CHNL_743fe937:
        DEV_ABT_1_Gen3_Tx_01_oMIBCAN_d3ed0e3e_Tx: CanIfTxPduCanId=469732106, CanIfTxPduCanIdType=EXTENDED_CAN, CanIfTxPduRef=DEV_ABT_1_Gen3_Tx_01_oMIBCAN_8e08c6bd_Tx
        DEV_ABT_1_Gen3_Tx_02_oMIBCAN_480aa55e_Tx: CanIfTxPduCanId=469732107, CanIfTxPduCanIdType=EXTENDED_CAN, CanIfTxPduRef=DEV_ABT_1_Gen3_Tx_02_oMIBCAN_bbe570ee_Tx
        DEV_ABT_1_Gen3_Tx_03_oMIBCAN_3ea83c7e_Tx: CanIfTxPduCanId=469732108, CanIfTxPduCanIdType=EXTENDED_CAN, CanIfTxPduRef=DEV_ABT_1_Gen3_Tx_03_oMIBCAN_1e6ee0e0_Tx
        DEV_ABT_1_Gen3_Tx_04_oMIBCAN_a4b4f5df_Tx: CanIfTxPduCanId=469732109, CanIfTxPduCanIdType=EXTENDED_CAN, CanIfTxPduRef=DEV_ABT_1_Gen3_Tx_04_oMIBCAN_d03e1c48_Tx
        DEV_ABT_1_Resp_01_oMIBCAN_f9c71a77_Tx: CanIfTxPduCanId=469732097, CanIfTxPduCanIdType=EXTENDED_CAN, CanIfTxPduRef=DEV_ABT_1_Resp_01_oMIBCAN_3d488e5a_Tx
        DEV_ABT_1_Resp_02_oMIBCAN_e5fc5939_Tx: CanIfTxPduCanId=469732098, CanIfTxPduCanIdType=EXTENDED_CAN, CanIfTxPduRef=DEV_ABT_1_Resp_02_oMIBCAN_08a53809_Tx
        DEV_ABT_1_Resp_03_oMIBCAN_58c59a3c_Tx: CanIfTxPduCanId=469732099, CanIfTxPduCanIdType=EXTENDED_CAN, CanIfTxPduRef=DEV_ABT_1_Resp_03_oMIBCAN_ad2ea807_Tx
        DEV_ABT_1_Resp_04_Tp_oMIBCAN_08a1dbbe_Tx: CanIfTxPduCanId=469732101, CanIfTxPduCanIdType=EXTENDED_CAN, CanIfTxPduUserTxConfirmationUL=CDD, CanIfTxPduRef=DEV_ABT_1_Resp_04_Tp_oMIBCAN_911ddf56_Tx
        DEV_ABT_1_Resp_05_oMIBCAN_60b31ca0_Tx: CanIfTxPduCanId=469732110, CanIfTxPduCanIdType=EXTENDED_CAN, CanIfTxPduRef=DEV_ABT_1_Resp_05_oMIBCAN_c6f5c4a1_Tx
        DIA_ABT_1_Resp_Tp_oMIBCAN_f0ff25b3_Tx: CanIfTxPduCanId=402527758, CanIfTxPduCanIdType=EXTENDED_CAN, CanIfTxPduUserTxConfirmationName=CanTp_TxConfirmation, CanIfTxPduUserTxConfirmationUL=CAN_TP, CanIfTxPduRef=DIA_ABT_1_Resp_Tp_oMIBCAN_e9ff9dc9_Tx
        Diag_ABT_1_Resp_Tp_oMIBCAN_20c6f452_Tx: CanIfTxPduCanId=402523662, CanIfTxPduCanIdType=EXTENDED_CAN, CanIfTxPduUserTxConfirmationName=CanTp_TxConfirmation, CanIfTxPduUserTxConfirmationUL=CAN_TP, CanIfTxPduRef=Diag_ABT_1_Resp_Tp_oMIBCAN_b38de832_Tx
        Display_1_01_oMIBCAN_72e15341_Tx: CanIfTxPduCanId=1142, CanIfTxPduCanIdType=STANDARD_CAN, CanIfTxPduDataChecksumPdu=false, CanIfTxPduUserTxConfirmationName=PduR_CanIfTxConfirmation, CanIfTxPduUserTxConfirmationUL=PDUR, CanIfTxPduRef=EcucPduCollection/Display_1_01_oMIBCAN_7531a5df_Tx
        Display_1_02_oMIBCAN_6bb2ae4e_Tx: CanIfTxPduCanId=1143, CanIfTxPduCanIdType=STANDARD_CAN, CanIfTxPduDataChecksumPdu=false, CanIfTxPduUserTxConfirmationName=PduR_CanIfTxConfirmation, CanIfTxPduUserTxConfirmationUL=PDUR, CanIfTxPduRef=EcucPduCollection/Display_1_02_oMIBCAN_40dc138c_Tx
        Display_1_03_oMIBCAN_637c054b_Tx: CanIfTxPduCanId=561, CanIfTxPduCanIdType=STANDARD_CAN, CanIfTxPduDataChecksumPdu=false, CanIfTxPduUserTxConfirmationName=PduR_CanIfTxConfirmation, CanIfTxPduUserTxConfirmationUL=PDUR, CanIfTxPduRef=EcucPduCollection/Display_1_03_oMIBCAN_e5578382_Tx
        HID_ABT_1_ZR_Req_Tp_oMIBCAN_859f3fd6_Tx: CanIfTxPduCanId=402190707, CanIfTxPduCanIdType=EXTENDED_CAN, CanIfTxPduUserTxConfirmationName=CanTp_TxConfirmation, CanIfTxPduUserTxConfirmationUL=CAN_TP, CanIfTxPduRef=HID_ABT_1_ZR_Req_Tp_oMIBCAN_83fcf6ff_Tx
        HID_ZR_ABT_1_Resp_Tp_oMIBCAN_f42ac01c_Tx: CanIfTxPduCanId=402321779, CanIfTxPduCanIdType=EXTENDED_CAN, CanIfTxPduUserTxConfirmationName=CanTp_TxConfirmation, CanIfTxPduUserTxConfirmationUL=CAN_TP, CanIfTxPduRef=HID_ZR_ABT_1_Resp_Tp_oMIBCAN_633d48ce_Tx
        KS_SSN_ABT_1_Resp_Tp_oMIBCAN_b4caf558_Tx: CanIfTxPduCanId=402546702, CanIfTxPduCanIdType=EXTENDED_CAN, CanIfTxPduUserTxConfirmationName=CanTp_TxConfirmation, CanIfTxPduUserTxConfirmationUL=CAN_TP, CanIfTxPduRef=KS_SSN_ABT_1_Resp_Tp_oMIBCAN_6b2aedd3_Tx
        NMH_ABT_1_oMIBCAN_fd2ebc1c_Tx: CanIfTxPduCanId=452985073, CanIfTxPduCanIdType=EXTENDED_CAN, CanIfTxPduUserTxConfirmationName=CanNm_TxConfirmation, CanIfTxPduUserTxConfirmationUL=CAN_NM, CanIfTxPduRef=EcucPduCollection/NMH_ABT_1_oMIBCAN_32c15a22_Tx
        OBDC_SSN_ABT_1_Resp_Tp_oMIBCAN_8da950a4_Tx: CanIfTxPduCanId=402550798, CanIfTxPduCanIdType=EXTENDED_CAN, CanIfTxPduUserTxConfirmationName=CanTp_TxConfirmation, CanIfTxPduUserTxConfirmationUL=CAN_TP, CanIfTxPduRef=OBDC_SSN_ABT_1_Resp_Tp_oMIBCAN_0d25e740_Tx
    CanIfPrivateCfg: CanIfPrivateSoftwareFilterType=LINEAR
    CanIfPublicCfg: CanIfPublicPnSupport=false
  module config CanNm
    CanNmGlobalConfig: CanNmComUserDataSupport=true, CanNmPnEiraCalcEnabled=false, CanNmUserDataEnabled=true
      MIBCAN_9c128fcc (CanNmChannelConfig):
        CanNmNodeId = 241
        CanNmPduCbvPosition = CANNM_PDU_BYTE_1
        CanNmPduNidPosition = CANNM_PDU_BYTE_0
        CanNmTimeoutTime = 1
        CanNmUserDataLength = 6
        CanNmWaitBusSleepTime = 0.75
        CanNmComMNetworkHandleRef = ComMConfigSet/CN_MIBCAN_0d25aee7
        MIBCAN_9c128fcc_Rx (CanNmRxPdu): CanNmRxPduRef=ABT_1_MIB_ab_Gen3_46f0b378_Rx
        NMH_ABT_1_oMIBCAN_32c15a22_Tx (CanNmTxPdu): CanNmTxPduRef=EcucPduCollection/NMH_ABT_1_oMIBCAN_32c15a22_Tx
        NMH_ABT_1_oMIBCAN_20c7138f (CanNmUserDataTxPdu): CanNmTxUserDataPduRef=EcucPduCollection/NMH_ABT_1_oMIBCAN_95150102_Tx
  module config CanSM
    CanSMConfiguration
      CHNL_743fe937 (CanSMManagerNetwork): CanSMComMNetworkHandleRef=ComMConfigSet/CN_MIBCAN_0d25aee7
        CT_MIBCAN_9cc8813a (CanSMController): CanSMControllerId=CanIfCtrlDrvCfg_7d254554/CT_MIBCAN_e05e8304
  module config CanTp
    CanTpConfig: CanTpMainFunctionPeriod=0.005
      15 x CanTpChannel, all with CanTpChannelMode=CANTP_MODE_FULL_DUPLEX:
        TPCH_10908f49: variation-point=post-build-variant-condition{matching-criterion=Communication, value=1}
          CanTpRxNSdu_7c52a4c5 (CanTpRxNSdu):
            CanTpRxAddressingFormat = CANTP_STANDARD
            CanTpRxDl = 8
            CanTpRxTaType = CANTP_PHYSICAL
            CanTpRxNSduRef = EcucPduCollection/HID_ABT_1_ZR_Resp_oMIBCAN_9e59f3fb_Rx
            CanTpRxNPdu_833d22a4 (CanTpRxNPdu): CanTpRxNPduRef=HID_ABT_1_ZR_Resp_Tp_oMIBCAN_bee4c682_Rx
            CanTpTxFcNPdu_833d22a4 (CanTpTxFcNPdu): CanTpTxFcNPduRef=HID_ABT_1_ZR_Req_Tp_oMIBCAN_83fcf6ff_Tx
          CanTpTxNSdu_7c52a4c5 (CanTpTxNSdu):
            CanTpTxAddressingFormat = CANTP_STANDARD
            CanTpTxDl = 8
            CanTpTxTaType = CANTP_PHYSICAL
            CanTpTxNSduRef = EcucPduCollection/HID_ABT_1_ZR_Req_oMIBCAN_8212e228_Tx
            CanTpRxFcNPdu_a1c7f656 (CanTpRxFcNPdu): CanTpRxFcNPduRef=HID_ABT_1_ZR_Resp_Tp_oMIBCAN_bee4c682_Rx
            CanTpTxNPdu_a1c7f656 (CanTpTxNPdu): CanTpTxNPduRef=HID_ABT_1_ZR_Req_Tp_oMIBCAN_83fcf6ff_Tx
        TPCH_11341e50: variation-point=post-build-variant-condition{matching-criterion=Communication, value=1}
          CanTpRxNSdu_91b752e1 (CanTpRxNSdu):
            CanTpRxAddressingFormat = CANTP_STANDARD
            CanTpRxDl = 8
            CanTpRxTaType = CANTP_PHYSICAL
            CanTpRxNSduRef = EcucPduCollection/HID_ZR_ABT_1_Req_oMIBCAN_9e31cb06_Rx
            CanTpRxNPdu_3a7e71a1 (CanTpRxNPdu): CanTpRxNPduRef=HID_ZR_ABT_1_Req_Tp_oMIBCAN_570e7390_Rx
            CanTpTxFcNPdu_3a7e71a1 (CanTpTxFcNPdu): CanTpTxFcNPduRef=HID_ZR_ABT_1_Resp_Tp_oMIBCAN_633d48ce_Tx
          CanTpTxNSdu_91b752e1 (CanTpTxNSdu):
            CanTpTxAddressingFormat = CANTP_STANDARD
            CanTpTxDl = 8
            CanTpTxTaType = CANTP_PHYSICAL
            CanTpTxNSduRef = EcucPduCollection/HID_ZR_ABT_1_Resp_oMIBCAN_4293dd1d_Tx
            CanTpRxFcNPdu_1884a553 (CanTpRxFcNPdu): CanTpRxFcNPduRef=HID_ZR_ABT_1_Req_Tp_oMIBCAN_570e7390_Rx
            CanTpTxNPdu_1884a553 (CanTpTxNPdu): CanTpTxNPduRef=HID_ZR_ABT_1_Resp_Tp_oMIBCAN_633d48ce_Tx
        TPCH_30e39867
          CanTpRxNSdu_098b3abe (CanTpRxNSdu):
            CanTpRxAddressingFormat = CANTP_STANDARD
            CanTpRxDl = 8
            CanTpRxTaType = CANTP_PHYSICAL
            CanTpRxNSduRef = EcucPduCollection/HID_ABT_1_ZR_Resp_oMIBCAN_9e59f3fb_Rx
            CanTpRxNPdu_20b73ca8 (CanTpRxNPdu): CanTpRxNPduRef=HID_ABT_1_ZR_Resp_Tp_oMIBCAN_bee4c682_Rx
            CanTpTxFcNPdu_20b73ca8 (CanTpTxFcNPdu): CanTpTxFcNPduRef=HID_ABT_1_ZR_Req_Tp_oMIBCAN_83fcf6ff_Tx
          CanTpTxNSdu_098b3abe (CanTpTxNSdu):
            CanTpTxAddressingFormat = CANTP_STANDARD
            CanTpTxDl = 8
            CanTpTxTaType = CANTP_PHYSICAL
            CanTpTxNSduRef = EcucPduCollection/HID_ABT_1_ZR_Req_oMIBCAN_8212e228_Tx
            CanTpRxFcNPdu_024de85a (CanTpRxFcNPdu): CanTpRxFcNPduRef=HID_ABT_1_ZR_Resp_Tp_oMIBCAN_bee4c682_Rx
            CanTpTxNPdu_024de85a (CanTpTxNPdu): CanTpTxNPduRef=HID_ABT_1_ZR_Req_Tp_oMIBCAN_83fcf6ff_Tx
        TPCH_48b990ff: variation-point=post-build-variant-condition{matching-criterion=Communication, value=1}
          CanTpRxNSdu_cfd03857 (CanTpRxNSdu):
            CanTpRxAddressingFormat = CANTP_STANDARD
            CanTpRxDl = 8
            CanTpRxTaType = CANTP_PHYSICAL
            CanTpRxNSduRef = EcucPduCollection/OBDC_SSN_ABT_1_Req_oMIBCAN_f307405b_Rx
            CanTpRxNPdu_cbb58404 (CanTpRxNPdu): CanTpRxNPduRef=OBDC_SSN_ABT_1_Req_Tp_oMIBCAN_24a71a07_Rx
            CanTpTxFcNPdu_cbb58404 (CanTpTxFcNPdu): CanTpTxFcNPduRef=OBDC_SSN_ABT_1_Resp_Tp_oMIBCAN_0d25e740_Tx
          CanTpTxNSdu_cfd03857 (CanTpTxNSdu):
            CanTpTxAddressingFormat = CANTP_STANDARD
            CanTpTxDl = 8
            CanTpTxTaType = CANTP_PHYSICAL
            CanTpTxNSduRef = EcucPduCollection/OBDC_SSN_ABT_1_Resp_oMIBCAN_5724c6df_Tx
            CanTpRxFcNPdu_e94f50f6 (CanTpRxFcNPdu): CanTpRxFcNPduRef=OBDC_SSN_ABT_1_Req_Tp_oMIBCAN_24a71a07_Rx
            CanTpTxNPdu_e94f50f6 (CanTpTxNPdu): CanTpTxNPduRef=OBDC_SSN_ABT_1_Resp_Tp_oMIBCAN_0d25e740_Tx
        TPCH_5d8adb4a: variation-point=post-build-variant-condition{matching-criterion=Communication, value=1}
          CanTpRxNSdu_02cf9345 (CanTpRxNSdu):
            CanTpRxAddressingFormat = CANTP_STANDARD
            CanTpRxDl = 8
            CanTpRxTaType = CANTP_PHYSICAL
            CanTpRxNSduRef = EcucPduCollection/KS_SSN_ABT_1_Req_oMIBCAN_16c9b54b_Rx
            CanTpRxNPdu_a2e284be (CanTpRxNPdu): CanTpRxNPduRef=KS_SSN_ABT_1_Req_Tp_oMIBCAN_2d9643dd_Rx
            CanTpTxFcNPdu_a2e284be (CanTpTxFcNPdu): CanTpTxFcNPduRef=KS_SSN_ABT_1_Resp_Tp_oMIBCAN_6b2aedd3_Tx
          CanTpTxNSdu_02cf9345 (CanTpTxNSdu):
            CanTpTxAddressingFormat = CANTP_STANDARD
            CanTpTxDl = 8
            CanTpTxTaType = CANTP_PHYSICAL
            CanTpTxNSduRef = EcucPduCollection/KS_SSN_ABT_1_Resp_oMIBCAN_4a76184e_Tx
            CanTpRxFcNPdu_8018504c (CanTpRxFcNPdu): CanTpRxFcNPduRef=KS_SSN_ABT_1_Req_Tp_oMIBCAN_2d9643dd_Rx
            CanTpTxNPdu_8018504c (CanTpTxNPdu): CanTpTxNPduRef=KS_SSN_ABT_1_Resp_Tp_oMIBCAN_6b2aedd3_Tx
        TPCH_6ef9a67d: variation-point=post-build-variant-condition{matching-criterion=Communication, value=1}
          CanTpRxNSdu_13fca38d (CanTpRxNSdu):
            CanTpRxAddressingFormat = CANTP_STANDARD
            CanTpRxDl = 8
            CanTpRxTaType = CANTP_PHYSICAL
            CanTpRxNSduRef = EcucPduCollection/HID_ABT_1_ZR_Resp_oMIBCAN_9e59f3fb_Rx
            CanTpRxNPdu_a0899b30 (CanTpRxNPdu): CanTpRxNPduRef=HID_ABT_1_ZR_Resp_Tp_oMIBCAN_bee4c682_Rx
            CanTpTxFcNPdu_a0899b30 (CanTpTxFcNPdu): CanTpTxFcNPduRef=HID_ABT_1_ZR_Req_Tp_oMIBCAN_83fcf6ff_Tx
          CanTpTxNSdu_13fca38d (CanTpTxNSdu):
            CanTpTxAddressingFormat = CANTP_STANDARD
            CanTpTxDl = 8
            CanTpTxTaType = CANTP_PHYSICAL
            CanTpTxNSduRef = EcucPduCollection/HID_ABT_1_ZR_Req_oMIBCAN_8212e228_Tx
            CanTpRxFcNPdu_82734fc2 (CanTpRxFcNPdu): CanTpRxFcNPduRef=HID_ABT_1_ZR_Resp_Tp_oMIBCAN_bee4c682_Rx
            CanTpTxNPdu_82734fc2 (CanTpTxNPdu): CanTpTxNPduRef=HID_ABT_1_ZR_Req_Tp_oMIBCAN_83fcf6ff_Tx
        TPCH_ed250bf6: variation-point=post-build-variant-condition{matching-criterion=Communication, value=1}
          CanTpRxNSdu_020c499a (CanTpRxNSdu):
            CanTpRxAddressingFormat = CANTP_STANDARD
            CanTpRxDl = 8
            CanTpRxTaType = CANTP_PHYSICAL
            CanTpRxNSduRef = EcucPduCollection/DIA_ABT_1_Req_oMIBCAN_1394b6c8_Rx
            CanTpRxNPdu_9a7bd35c (CanTpRxNPdu): CanTpRxNPduRef=DIA_ABT_1_Req_Tp_oMIBCAN_f012988b_Rx
            CanTpTxFcNPdu_9a7bd35c (CanTpTxFcNPdu): CanTpTxFcNPduRef=DIA_ABT_1_Resp_Tp_oMIBCAN_e9ff9dc9_Tx
          CanTpTxNSdu_020c499a (CanTpTxNSdu):
            CanTpTxAddressingFormat = CANTP_STANDARD
            CanTpTxDl = 8
            CanTpTxTaType = CANTP_PHYSICAL
            CanTpTxNSduRef = EcucPduCollection/DIA_ABT_1_Resp_oMIBCAN_3ec297d7_Tx
            CanTpRxFcNPdu_b88107ae (CanTpRxFcNPdu): CanTpRxFcNPduRef=DIA_ABT_1_Req_Tp_oMIBCAN_f012988b_Rx
            CanTpTxNPdu_b88107ae (CanTpTxNPdu): CanTpTxNPduRef=DIA_ABT_1_Resp_Tp_oMIBCAN_e9ff9dc9_Tx
        TPCH_ede2b36d: variation-point=post-build-variant-condition{matching-criterion=Communication, value=1}
          CanTpRxNSdu_920343e7 (CanTpRxNSdu):
            CanTpRxAddressingFormat = CANTP_STANDARD
            CanTpRxDl = 8
            CanTpRxTaType = CANTP_PHYSICAL
            CanTpRxNSduRef = EcucPduCollection/Diag_ABT_1_Req_oMIBCAN_4e8fe7b6_Rx
            CanTpRxNPdu_30e81c0c (CanTpRxNPdu): CanTpRxNPduRef=Diag_ABT_1_Req_Tp_oMIBCAN_87b87875_Rx
            CanTpTxFcNPdu_30e81c0c (CanTpTxFcNPdu): CanTpTxFcNPduRef=Diag_ABT_1_Resp_Tp_oMIBCAN_b38de832_Tx
          CanTpTxNSdu_920343e7 (CanTpTxNSdu):
            CanTpTxAddressingFormat = CANTP_STANDARD
            CanTpTxDl = 8
            CanTpTxTaType = CANTP_PHYSICAL
            CanTpTxNSduRef = EcucPduCollection/Diag_ABT_1_Resp_oMIBCAN_8922d0bd_Tx
            CanTpRxFcNPdu_1212c8fe (CanTpRxFcNPdu): CanTpRxFcNPduRef=Diag_ABT_1_Req_Tp_oMIBCAN_87b87875_Rx
            CanTpTxNPdu_1212c8fe (CanTpTxNPdu): CanTpTxNPduRef=Diag_ABT_1_Resp_Tp_oMIBCAN_b38de832_Tx
        TPCH_1d08b1aa: variation-point=post-build-variant-condition{matching-criterion=Communication, value=0}
          CanTpRxNSdu_d388d44c (CanTpRxNSdu):
            CanTpRxAddressingFormat = CANTP_STANDARD
            CanTpRxDl = 8
            CanTpRxTaType = CANTP_PHYSICAL
            CanTpRxNSduRef = EcucPduCollection/HID_ZR_ABT_1_Req_oMIBCAN_9e31cb06_Rx
            CanTpRxNPdu_36065985 (CanTpRxNPdu): CanTpRxNPduRef=HID_ZR_ABT_1_Req_Tp_oMIBCAN_570e7390_Rx
            CanTpTxFcNPdu_36065985 (CanTpTxFcNPdu): CanTpTxFcNPduRef=HID_ZR_ABT_1_Resp_Tp_oMIBCAN_633d48ce_Tx
          CanTpTxNSdu_d388d44c (CanTpTxNSdu):
            CanTpTxAddressingFormat = CANTP_STANDARD
            CanTpTxDl = 8
            CanTpTxTaType = CANTP_PHYSICAL
            CanTpTxNSduRef = EcucPduCollection/HID_ZR_ABT_1_Resp_oMIBCAN_4293dd1d_Tx
            CanTpRxFcNPdu_14fc8d77 (CanTpRxFcNPdu): CanTpRxFcNPduRef=HID_ZR_ABT_1_Req_Tp_oMIBCAN_570e7390_Rx
            CanTpTxNPdu_14fc8d77 (CanTpTxNPdu): CanTpTxNPduRef=HID_ZR_ABT_1_Resp_Tp_oMIBCAN_633d48ce_Tx
        TPCH_62120bfd: variation-point=post-build-variant-condition{matching-criterion=Communication, value=0}
          CanTpRxNSdu_2871ff54 (CanTpRxNSdu):
            CanTpRxAddressingFormat = CANTP_STANDARD
            CanTpRxDl = 8
            CanTpRxTaType = CANTP_PHYSICAL
            CanTpRxNSduRef = EcucPduCollection/HID_ABT_1_ZR_Resp_oMIBCAN_9e59f3fb_Rx
            CanTpRxNPdu_92fbd52c (CanTpRxNPdu): CanTpRxNPduRef=HID_ABT_1_ZR_Resp_Tp_oMIBCAN_bee4c682_Rx
            CanTpTxFcNPdu_92fbd52c (CanTpTxFcNPdu): CanTpTxFcNPduRef=HID_ABT_1_ZR_Req_Tp_oMIBCAN_83fcf6ff_Tx
          CanTpTxNSdu_2871ff54 (CanTpTxNSdu):
            CanTpTxAddressingFormat = CANTP_STANDARD
            CanTpTxDl = 8
            CanTpTxTaType = CANTP_PHYSICAL
            CanTpTxNSduRef = EcucPduCollection/HID_ABT_1_ZR_Req_oMIBCAN_8212e228_Tx
            CanTpRxFcNPdu_b00101de (CanTpRxFcNPdu): CanTpRxFcNPduRef=HID_ABT_1_ZR_Resp_Tp_oMIBCAN_bee4c682_Rx
            CanTpTxNPdu_b00101de (CanTpTxNPdu): CanTpTxNPduRef=HID_ABT_1_ZR_Req_Tp_oMIBCAN_83fcf6ff_Tx
        TPCH_79a24892: variation-point=post-build-variant-condition{matching-criterion=Communication, value=0}
          CanTpRxNSdu_bb302aac (CanTpRxNSdu):
            CanTpRxAddressingFormat = CANTP_STANDARD
            CanTpRxDl = 8
            CanTpRxTaType = CANTP_PHYSICAL
            CanTpRxNSduRef = EcucPduCollection/HID_ABT_1_ZR_Resp_oMIBCAN_9e59f3fb_Rx
            CanTpRxNPdu_d61c5759 (CanTpRxNPdu): CanTpRxNPduRef=HID_ABT_1_ZR_Resp_Tp_oMIBCAN_bee4c682_Rx
            CanTpTxFcNPdu_d61c5759 (CanTpTxFcNPdu): CanTpTxFcNPduRef=HID_ABT_1_ZR_Req_Tp_oMIBCAN_83fcf6ff_Tx
          CanTpTxNSdu_bb302aac (CanTpTxNSdu):
            CanTpTxAddressingFormat = CANTP_STANDARD
            CanTpTxDl = 8
            CanTpTxTaType = CANTP_PHYSICAL
            CanTpTxNSduRef = EcucPduCollection/HID_ABT_1_ZR_Req_oMIBCAN_8212e228_Tx
            CanTpRxFcNPdu_f4e683ab (CanTpRxFcNPdu): CanTpRxFcNPduRef=HID_ABT_1_ZR_Resp_Tp_oMIBCAN_bee4c682_Rx
            CanTpTxNPdu_f4e683ab (CanTpTxNPdu): CanTpTxNPduRef=HID_ABT_1_ZR_Req_Tp_oMIBCAN_83fcf6ff_Tx
        TPCH_883e0b7c: variation-point=post-build-variant-condition{matching-criterion=Communication, value=0}
          CanTpRxNSdu_63b4f94e (CanTpRxNSdu):
            CanTpRxAddressingFormat = CANTP_STANDARD
            CanTpRxDl = 8
            CanTpRxTaType = CANTP_PHYSICAL
            CanTpRxNSduRef = EcucPduCollection/Diag_ABT_1_Req_oMIBCAN_4e8fe7b6_Rx
            CanTpRxNPdu_42ba9d48 (CanTpRxNPdu): CanTpRxNPduRef=Diag_ABT_1_Req_Tp_oMIBCAN_87b87875_Rx
            CanTpTxFcNPdu_42ba9d48 (CanTpTxFcNPdu): CanTpTxFcNPduRef=Diag_ABT_1_Resp_Tp_oMIBCAN_b38de832_Tx
          CanTpTxNSdu_63b4f94e (CanTpTxNSdu):
            CanTpTxAddressingFormat = CANTP_STANDARD
            CanTpTxDl = 8
            CanTpTxTaType = CANTP_PHYSICAL
            CanTpTxNSduRef = EcucPduCollection/Diag_ABT_1_Resp_oMIBCAN_8922d0bd_Tx
            CanTpRxFcNPdu_604049ba (CanTpRxFcNPdu): CanTpRxFcNPduRef=Diag_ABT_1_Req_Tp_oMIBCAN_87b87875_Rx
            CanTpTxNPdu_604049ba (CanTpTxNPdu): CanTpTxNPduRef=Diag_ABT_1_Resp_Tp_oMIBCAN_b38de832_Tx
        TPCH_c0c7164d: variation-point=post-build-variant-condition{matching-criterion=Communication, value=0}
          CanTpRxNSdu_700aeb8c (CanTpRxNSdu):
            CanTpRxAddressingFormat = CANTP_STANDARD
            CanTpRxDl = 8
            CanTpRxTaType = CANTP_PHYSICAL
            CanTpRxNSduRef = EcucPduCollection/OBDC_SSN_ABT_1_Req_oMIBCAN_f307405b_Rx
            CanTpRxNPdu_ced6e4ae (CanTpRxNPdu): CanTpRxNPduRef=OBDC_SSN_ABT_1_Req_Tp_oMIBCAN_24a71a07_Rx
            CanTpTxFcNPdu_ced6e4ae (CanTpTxFcNPdu): CanTpTxFcNPduRef=OBDC_SSN_ABT_1_Resp_Tp_oMIBCAN_0d25e740_Tx
          CanTpTxNSdu_700aeb8c (CanTpTxNSdu):
            CanTpTxAddressingFormat = CANTP_STANDARD
            CanTpTxDl = 8
            CanTpTxTaType = CANTP_PHYSICAL
            CanTpTxNSduRef = EcucPduCollection/OBDC_SSN_ABT_1_Resp_oMIBCAN_5724c6df_Tx
            CanTpRxFcNPdu_ec2c305c (CanTpRxFcNPdu): CanTpRxFcNPduRef=OBDC_SSN_ABT_1_Req_Tp_oMIBCAN_24a71a07_Rx
            CanTpTxNPdu_ec2c305c (CanTpTxNPdu): CanTpTxNPduRef=OBDC_SSN_ABT_1_Resp_Tp_oMIBCAN_0d25e740_Tx
        TPCH_c59e7e4b: variation-point=post-build-variant-condition{matching-criterion=Communication, value=0}
          CanTpRxNSdu_6f061911 (CanTpRxNSdu):
            CanTpRxAddressingFormat = CANTP_STANDARD
            CanTpRxDl = 8
            CanTpRxTaType = CANTP_PHYSICAL
            CanTpRxNSduRef = EcucPduCollection/KS_SSN_ABT_1_Req_oMIBCAN_16c9b54b_Rx
            CanTpRxNPdu_3f057dc0 (CanTpRxNPdu): CanTpRxNPduRef=KS_SSN_ABT_1_Req_Tp_oMIBCAN_2d9643dd_Rx
            CanTpTxFcNPdu_3f057dc0 (CanTpTxFcNPdu): CanTpTxFcNPduRef=KS_SSN_ABT_1_Resp_Tp_oMIBCAN_6b2aedd3_Tx
          CanTpTxNSdu_6f061911 (CanTpTxNSdu):
            CanTpTxAddressingFormat = CANTP_STANDARD
            CanTpTxDl = 8
            CanTpTxTaType = CANTP_PHYSICAL
            CanTpTxNSduRef = EcucPduCollection/KS_SSN_ABT_1_Resp_oMIBCAN_4a76184e_Tx
            CanTpRxFcNPdu_1dffa932 (CanTpRxFcNPdu): CanTpRxFcNPduRef=KS_SSN_ABT_1_Req_Tp_oMIBCAN_2d9643dd_Rx
            CanTpTxNPdu_1dffa932 (CanTpTxNPdu): CanTpTxNPduRef=KS_SSN_ABT_1_Resp_Tp_oMIBCAN_6b2aedd3_Tx
        TPCH_e70dbf07: variation-point=post-build-variant-condition{matching-criterion=Communication, value=0}
          CanTpRxNSdu_a5615871 (CanTpRxNSdu):
            CanTpRxAddressingFormat = CANTP_STANDARD
            CanTpRxDl = 8
            CanTpRxTaType = CANTP_PHYSICAL
            CanTpRxNSduRef = EcucPduCollection/DIA_ABT_1_Req_oMIBCAN_1394b6c8_Rx
            CanTpRxNPdu_da3fa0be (CanTpRxNPdu): CanTpRxNPduRef=DIA_ABT_1_Req_Tp_oMIBCAN_f012988b_Rx
            CanTpTxFcNPdu_da3fa0be (CanTpTxFcNPdu): CanTpTxFcNPduRef=DIA_ABT_1_Resp_Tp_oMIBCAN_e9ff9dc9_Tx
          CanTpTxNSdu_a5615871 (CanTpTxNSdu):
            CanTpTxAddressingFormat = CANTP_STANDARD
            CanTpTxDl = 8
            CanTpTxTaType = CANTP_PHYSICAL
            CanTpTxNSduRef = EcucPduCollection/DIA_ABT_1_Resp_oMIBCAN_3ec297d7_Tx
            CanTpRxFcNPdu_f8c5744c (CanTpRxFcNPdu): CanTpRxFcNPduRef=DIA_ABT_1_Req_Tp_oMIBCAN_f012988b_Rx
            CanTpTxNPdu_f8c5744c (CanTpTxNPdu): CanTpTxNPduRef=DIA_ABT_1_Resp_Tp_oMIBCAN_e9ff9dc9_Tx
  module config Com
    ComConfig
      12 x ComIPdu, all with ComIPduType=NORMAL:
        BEM_02_oMIBCAN_6aef04e3_Rx: ComIPduDirection=RECEIVE, ComIPduGroupRef=ABT_1_MIB_ab_Gen3_oMIBCAN_Rx_8b2c9099, ComIPduSignalRef=NVEM_Abschaltstufe_oBEM_02_oMIBCAN_ef46dd34_Rx, ComPduIdRef=EcucPduCollection/BEM_02_oMIBCAN_6aef04e3_Rx
        Diagnose_01_oMIBCAN_a76d6db2_Rx: ComIPduDirection=RECEIVE, ComIPduGroupRef=ABT_1_MIB_ab_Gen3_oMIBCAN_Rx_8b2c9099, ComIPduSignalRef=DGN_Verlernzaehler_oDiagnose_01_oMIBCAN_b7bfe4e9_Rx if post-build-variant-condition{matching-criterion=Communication, value=1}, ComIPduSignalRef=KBI_Kilometerstand_oDiagnose_01_oMIBCAN_35c5dcae_Rx, ComIPduSignalRef=UH_Jahr_oDiagnose_01_oMIBCAN_892bc6b5_Rx, ComIPduSignalRef=UH_Minute_oDiagnose_01_oMIBCAN_85876052_Rx, ComIPduSignalRef=UH_Monat_oDiagnose_01_oMIBCAN_8aebb7ca_Rx, ComIPduSignalRef=UH_Sekunde_oDiagnose_01_oMIBCAN_c0c7f488_Rx, ComIPduSignalRef=UH_Stunde_oDiagnose_01_oMIBCAN_222168aa_Rx, ComIPduSignalRef=UH_Tag_oDiagnose_01_oMIBCAN_1961be5f_Rx, ComIPduSignalRef=Vehicle_Driving_Cycle_oDiagnose_01_oMIBCAN_ce282b65_Rx if post-build-variant-condition{matching-criterion=Communication, value=1}, ComPduIdRef=EcucPduCollection/Diagnose_01_oMIBCAN_a76d6db2_Rx
        Dimmung_01_oMIBCAN_65f0daf0_Rx: ComIPduDirection=RECEIVE, ComIPduGroupRef=ABT_1_MIB_ab_Gen3_oMIBCAN_Rx_8b2c9099, ComIPduSignalRef=DI_Display_Nachtdesign_oDimmung_01_oMIBCAN_b07c387e_Rx, ComIPduSignalRef=DI_KL_58xd_oDimmung_01_oMIBCAN_935a2425_Rx, ComIPduSignalRef=DI_KL_58xs_oDimmung_01_oMIBCAN_b159b091_Rx, ComIPduSignalRef=DI_KL_58xt_oDimmung_01_oMIBCAN_d8be36c9_Rx, ComPduIdRef=EcucPduCollection/Dimmung_01_oMIBCAN_65f0daf0_Rx
        Display_1_01_oMIBCAN_8bfac915_Tx: ComIPduDirection=SEND, ComIPduGroupRef=ABT_1_MIB_ab_Gen3_oMIBCAN_Tx_dd76371f, ComIPduSignalRef=DU_DispDerating_oDisplay_1_01_oMIBCAN_6203b525_Tx, ComIPduSignalRef=DU_KL30_Uebersp_Fehler_oDisplay_1_01_oMIBCAN_e0912025_Tx, ComIPduSignalRef=DU_KL30_Untersp_Fehler_oDisplay_1_01_oMIBCAN_5fbc402e_Tx, ComIPduSignalRef=DU_KL_30F_oDisplay_1_01_oMIBCAN_d11c2a24_Tx, ComIPduSignalRef=DU_State_oDisplay_1_01_oMIBCAN_4769a67f_Tx, ComIPduSignalRef=DU_TempSensMax_oDisplay_1_01_oMIBCAN_f790ff70_Tx, ComIPduSignalRef=DU_TempSens_oDisplay_1_01_oMIBCAN_49cb802f_Tx, ComIPduSignalRef=DU_Temp_Fehler_oDisplay_1_01_oMIBCAN_d7f54cb3_Tx, ComIPduSignalRef=DU_Variant_oDisplay_1_01_oMIBCAN_6b6c6b43_Tx, ComIPduSignalRef=DU_Zulieferer_oDisplay_1_01_oMIBCAN_c2936e4f_Tx, ComIPduSignalRef=FB_Mode_oDisplay_1_01_oMIBCAN_6b67d692_Tx, ComIPduSignalRef=HU_Fotosensor_oDisplay_1_01_oMIBCAN_f64a6679_Tx, ComIPduSignalRef=SystemMode_oDisplay_1_01_oMIBCAN_861c20ce_Tx, ComPduIdRef=EcucPduCollection/Display_1_01_oMIBCAN_8bfac915_Tx
          ComTxIPdu: ComMinimumDelayTime=0.04, ComTxIPduUnusedAreasDefault=0
            ComTxModeFalse
              ComTxMode: ComTxModeMode=MIXED, ComTxModeNumberOfRepetitions=0, ComTxModeRepetitionPeriod=0, ComTxModeTimeOffset=0, ComTxModeTimePeriod=1
            ComTxModeTrue
              ComTxMode: ComTxModeMode=MIXED, ComTxModeNumberOfRepetitions=0, ComTxModeRepetitionPeriod=0, ComTxModeTimeOffset=0, ComTxModeTimePeriod=1
        Display_1_02_oMIBCAN_b277f5d0_Tx: ComIPduDirection=SEND, ComIPduGroupRef=ABT_1_MIB_ab_Gen3_oMIBCAN_Tx_dd76371f, ComIPduSignalRef=DU1_HDCP_Status_oDisplay_1_02_oMIBCAN_cc122b1c_Tx, ComIPduSignalRef=DU1_Haptik_Fehlerstatus_oDisplay_1_02_oMIBCAN_1764e18b_Tx, ComIPduSignalRef=DU1_LVDS_Splitter_Fehlerstatus_oDisplay_1_02_oMIBCAN_64ba48d3_Tx, ComIPduSignalRef=DU1_SW_inkonsistent_oDisplay_1_02_oMIBCAN_b0f93d56_Tx, ComIPduSignalRef=DU1_Touch_Fehlerstatus_oDisplay_1_02_oMIBCAN_6890f00b_Tx, ComIPduSignalRef=DU_Betriebsdauer_min_oDisplay_1_02_oMIBCAN_2acbc23e_Tx, ComIPduSignalRef=DU_Betriebsdauer_std_oDisplay_1_02_oMIBCAN_9d663275_Tx, ComIPduSignalRef=DU_HintGrdBelKurzschl_oDisplay_1_02_oMIBCAN_fbaf82f0_Tx, ComIPduSignalRef=DU_HintGrdBelUnterbr_oDisplay_1_02_oMIBCAN_06cf81bf_Tx, ComIPduSignalRef=EEPROM_Fehler_oDisplay_1_02_oMIBCAN_817b8bfb_Tx, ComIPduSignalRef=LVDS_Status_oDisplay_1_02_oMIBCAN_ae978a05_Tx, ComIPduSignalRef=ZR_Lenkerpos_Status_oDisplay_1_02_oMIBCAN_352e9ddb_Tx, ComPduIdRef=EcucPduCollection/Display_1_02_oMIBCAN_b277f5d0_Tx
          ComTxIPdu: ComMinimumDelayTime=0.04, ComTxIPduUnusedAreasDefault=0
            ComTxModeFalse
              ComTxMode: ComTxModeMode=MIXED, ComTxModeNumberOfRepetitions=0, ComTxModeRepetitionPeriod=0, ComTxModeTimeOffset=0, ComTxModeTimePeriod=1
            ComTxModeTrue
              ComTxMode: ComTxModeMode=MIXED, ComTxModeNumberOfRepetitions=0, ComTxModeRepetitionPeriod=0, ComTxModeTimeOffset=0, ComTxModeTimePeriod=1
        Display_1_03_oMIBCAN_a50ce193_Tx: ComIPduDirection=SEND, ComIPduGroupRef=ABT_1_MIB_ab_Gen3_oMIBCAN_Tx_dd76371f, ComIPduSignalRef=DU1_Fehlerstatus_oDisplay_1_03_oMIBCAN_690a9677_Tx, ComIPduSignalRef=DU1_HWR_Fehlerstatus_oDisplay_1_03_oMIBCAN_0dd24a04_Tx, ComIPduSignalRef=DU1_KS_FIS_unplausibel_oDisplay_1_03_oMIBCAN_d6cb4cc3_Tx, ComIPduSignalRef=DU1_KS_SHE_keine_Grundeinst_oDisplay_1_03_oMIBCAN_ee354635_Tx, ComIPduSignalRef=DU1_KS_aktiv_Manipulationsschutz_oDisplay_1_03_oMIBCAN_96fab9e6_Tx, ComIPduSignalRef=DU1_KS_aktiv_anderer_Grund_oDisplay_1_03_oMIBCAN_60a79093_Tx, ComIPduSignalRef=DU1_KS_aktiv_falsche_Auth_oDisplay_1_03_oMIBCAN_9a47cfb6_Tx, ComIPduSignalRef=DU1_KS_keine_Grundeinstellung_oDisplay_1_03_oMIBCAN_9e5e074d_Tx, ComIPduSignalRef=DU1_Slider_Locked_oDisplay_1_03_oMIBCAN_72d0f324_Tx, ComIPduSignalRef=DU1_Touchstatus_oDisplay_1_03_oMIBCAN_2bf2a61b_Tx, ComPduIdRef=EcucPduCollection/Display_1_03_oMIBCAN_a50ce193_Tx
          ComTxIPdu: ComMinimumDelayTime=0.02, ComTxIPduUnusedAreasDefault=0
            ComTxModeFalse
              ComTxMode: ComTxModeMode=MIXED, ComTxModeNumberOfRepetitions=0, ComTxModeRepetitionPeriod=0, ComTxModeTimeOffset=0, ComTxModeTimePeriod=0.2
            ComTxModeTrue
              ComTxMode: ComTxModeMode=MIXED, ComTxModeNumberOfRepetitions=0, ComTxModeRepetitionPeriod=0, ComTxModeTimeOffset=0, ComTxModeTimePeriod=0.2
        Klemmen_Status_01_oMIBCAN_c14dd5d5_Rx: ComIPduDirection=RECEIVE, ComIPduGroupRef=ABT_1_MIB_ab_Gen3_oMIBCAN_Rx_8b2c9099, ComIPduSignalGroupRef=SG_Klemmen_Status_01_oKlemmen_Status_01_oMIBCAN_a0c765b4_Rx, ComPduIdRef=EcucPduCollection/Klemmen_Status_01_oMIBCAN_c14dd5d5_Rx
        NMH_ABT_1_oMIBCAN_95150102_Tx: ComIPduDirection=SEND, ComIPduSignalRef=NM_ABT_1_Car_Wakeup_oNMH_ABT_1_oMIBCAN_e071a033_Tx, ComIPduSignalRef=NM_ABT_1_NL_Dimmung_oNMH_ABT_1_oMIBCAN_7e696feb_Tx, ComIPduSignalRef=NM_ABT_1_NL_WakeUp_Lock_oNMH_ABT_1_oMIBCAN_11a791fc_Tx, ComIPduSignalRef=NM_ABT_1_NM_State_oNMH_ABT_1_oMIBCAN_91fd4fee_Tx, ComIPduSignalRef=NM_ABT_1_NM_aktiv_Diagnose_oNMH_ABT_1_oMIBCAN_33c33ade_Tx, ComIPduSignalRef=NM_ABT_1_NM_aktiv_KL15_oNMH_ABT_1_oMIBCAN_5752959c_Tx, ComIPduSignalRef=NM_ABT_1_NM_aktiv_Tmin_oNMH_ABT_1_oMIBCAN_c22cf87b_Tx, ComIPduSignalRef=NM_ABT_1_UDS_CC_oNMH_ABT_1_oMIBCAN_9b6e5a24_Tx, ComIPduSignalRef=NM_ABT_1_Wakeup_oNMH_ABT_1_oMIBCAN_d72a039d_Tx, ComPduIdRef=EcucPduCollection/NMH_ABT_1_oMIBCAN_95150102_Tx
          ComTxIPdu: ComTxIPduUnusedAreasDefault=0  # NMH_ABT_1_oMIBCAN
        ORU_01_oMIBCAN_27f873fd_Rx: ComIPduDirection=RECEIVE, ComIPduGroupRef=ABT_1_MIB_ab_Gen3_oMIBCAN_Rx_8b2c9099, ComIPduSignalGroupRef=SG_ORU_01_oORU_01_oMIBCAN_abfe8160_Rx if post-build-variant-condition{matching-criterion=Communication, value=1}, ComPduIdRef=EcucPduCollection/ORU_01_oMIBCAN_27f873fd_Rx
        Systeminfo_01_oMIBCAN_86e3ebe7_Rx: ComIPduDirection=RECEIVE, ComIPduGroupRef=ABT_1_MIB_ab_Gen3_oMIBCAN_Rx_8b2c9099, ComIPduSignalRef=SI_BUS_03_oSysteminfo_01_oMIBCAN_d2d89088_Rx, ComIPduSignalRef=SI_T_Mode_oSysteminfo_01_oMIBCAN_3f9035a3_Rx, ComPduIdRef=EcucPduCollection/Systeminfo_01_oMIBCAN_86e3ebe7_Rx
        Zentralrechner_01_oMIBCAN_e5318f4e_Rx: ComIPduDirection=RECEIVE, ComIPduGroupRef=ABT_1_MIB_ab_Gen3_oMIBCAN_Rx_8b2c9099, ComIPduSignalRef=DI_Screendesign_oZentralrechner_01_oMIBCAN_be1aac5d_Rx, ComIPduSignalRef=MMI_State_oZentralrechner_01_oMIBCAN_ec450996_Rx, ComIPduSignalRef=SI_ICAN_oZentralrechner_01_oMIBCAN_2902e27b_Rx, ComIPduSignalRef=ZR_DimOffs_DU_1_oZentralrechner_01_oMIBCAN_ed78e230_Rx, ComIPduSignalRef=ZR_Lenkerposition_oZentralrechner_01_oMIBCAN_ff96913e_Rx, ComIPduSignalRef=ZR_State_DU_1_oZentralrechner_01_oMIBCAN_df67a3d9_Rx, ComIPduSignalRef=ZR_WecktGesp_oZentralrechner_01_oMIBCAN_7de76e98_Rx, ComPduIdRef=EcucPduCollection/Zentralrechner_01_oMIBCAN_e5318f4e_Rx
        Zentralrechner_04_oMIBCAN_afa6ca01_Rx: ComIPduDirection=RECEIVE, ComIPduGroupRef=ABT_1_MIB_ab_Gen3_oMIBCAN_Rx_8b2c9099, ComIPduSignalRef=ZR_Plattform_oZentralrechner_04_oMIBCAN_29a5a979_Rx, ComPduIdRef=EcucPduCollection/Zentralrechner_04_oMIBCAN_afa6ca01_Rx
      ABT_1_MIB_ab_Gen3_oMIBCAN_Rx_8b2c9099 (ComIPduGroup)
      ABT_1_MIB_ab_Gen3_oMIBCAN_Tx_dd76371f (ComIPduGroup)
      68 x ComSignal, all with ComSignalEndianness=LITTLE_ENDIAN:
        DGN_Verlernzaehler_oDiagnose_01_oMIBCAN_b7bfe4e9_Rx: ComBitPosition=0, ComBitSize=8, ComSignalInitValue=0, ComSignalType=UINT8, ComTimeout=5, ComSystemTemplateSystemSignalRef=DGN_Verlernzaehler, variation-point=post-build-variant-condition{matching-criterion=Communication, value=1}
        DI_Display_Nachtdesign_oDimmung_01_oMIBCAN_b07c387e_Rx: ComBitPosition=15, ComBitSize=1, ComSignalInitValue=0, ComSignalType=BOOLEAN, ComTimeout=2, ComSystemTemplateSystemSignalRef=DI_Display_Nachtdesign
        DI_KL_58xd_oDimmung_01_oMIBCAN_935a2425_Rx: ComBitPosition=0, ComBitSize=8, ComSignalInitValue=254, ComSignalType=UINT8, ComTimeout=2, ComSystemTemplateSystemSignalRef=DI_KL_58xd
        DI_KL_58xs_oDimmung_01_oMIBCAN_b159b091_Rx: ComBitPosition=8, ComBitSize=7, ComSignalInitValue=126, ComSignalType=UINT8, ComTimeout=2, ComSystemTemplateSystemSignalRef=DI_KL_58xs
        DI_KL_58xt_oDimmung_01_oMIBCAN_d8be36c9_Rx: ComBitPosition=16, ComBitSize=7, ComSignalInitValue=126, ComSignalType=UINT8, ComTimeout=2, ComSystemTemplateSystemSignalRef=DI_KL_58xt
        DI_Screendesign_oZentralrechner_01_oMIBCAN_be1aac5d_Rx: ComBitPosition=32, ComBitSize=3, ComSignalInitValue=6, ComSignalType=UINT8, ComTimeout=5, ComSystemTemplateSystemSignalRef=DI_Screendesign
        DU1_Fehlerstatus_oDisplay_1_03_oMIBCAN_690a9677_Tx: ComBitPosition=20, ComBitSize=2, ComSignalInitValue=0, ComSignalType=UINT8, ComTransferProperty=TRIGGERED_ON_CHANGE_WITHOUT_REPETITION, ComSystemTemplateSystemSignalRef=DU1_Fehlerstatus
        DU1_HDCP_Status_oDisplay_1_02_oMIBCAN_cc122b1c_Tx: ComBitPosition=30, ComBitSize=1, ComSignalInitValue=0, ComSignalType=BOOLEAN, ComTransferProperty=TRIGGERED_ON_CHANGE_WITHOUT_REPETITION, ComSystemTemplateSystemSignalRef=DU1_HDCP_Status
        DU1_HWR_Fehlerstatus_oDisplay_1_03_oMIBCAN_0dd24a04_Tx: ComBitPosition=23, ComBitSize=2, ComSignalInitValue=0, ComSignalType=UINT8, ComTransferProperty=PENDING, ComSystemTemplateSystemSignalRef=DU1_HWR_Fehlerstatus
        DU1_Haptik_Fehlerstatus_oDisplay_1_02_oMIBCAN_1764e18b_Tx: ComBitPosition=42, ComBitSize=2, ComSignalInitValue=0, ComSignalType=UINT8, ComTransferProperty=PENDING, ComSystemTemplateSystemSignalRef=DU1_Haptik_Fehlerstatus
        DU1_KS_FIS_unplausibel_oDisplay_1_03_oMIBCAN_d6cb4cc3_Tx: ComBitPosition=15, ComBitSize=1, ComSignalInitValue=0, ComSignalType=BOOLEAN, ComTransferProperty=TRIGGERED_ON_CHANGE_WITHOUT_REPETITION, ComSystemTemplateSystemSignalRef=DU1_KS_FIS_unplausibel
        DU1_KS_SHE_keine_Grundeinst_oDisplay_1_03_oMIBCAN_ee354635_Tx: ComBitPosition=17, ComBitSize=1, ComSignalInitValue=0, ComSignalType=BOOLEAN, ComTransferProperty=TRIGGERED_ON_CHANGE_WITHOUT_REPETITION, ComSystemTemplateSystemSignalRef=DU1_KS_SHE_keine_Grundeinst
        DU1_KS_aktiv_Manipulationsschutz_oDisplay_1_03_oMIBCAN_96fab9e6_Tx: ComBitPosition=14, ComBitSize=1, ComSignalInitValue=0, ComSignalType=BOOLEAN, ComTransferProperty=TRIGGERED_ON_CHANGE_WITHOUT_REPETITION, ComSystemTemplateSystemSignalRef=DU1_KS_aktiv_Manipulationsschutz
        DU1_KS_aktiv_anderer_Grund_oDisplay_1_03_oMIBCAN_60a79093_Tx: ComBitPosition=12, ComBitSize=1, ComSignalInitValue=0, ComSignalType=BOOLEAN, ComTransferProperty=TRIGGERED_ON_CHANGE_WITHOUT_REPETITION, ComSystemTemplateSystemSignalRef=DU1_KS_aktiv_anderer_Grund
        DU1_KS_aktiv_falsche_Auth_oDisplay_1_03_oMIBCAN_9a47cfb6_Tx: ComBitPosition=13, ComBitSize=1, ComSignalInitValue=0, ComSignalType=BOOLEAN, ComTransferProperty=TRIGGERED_ON_CHANGE_WITHOUT_REPETITION, ComSystemTemplateSystemSignalRef=DU1_KS_aktiv_falsche_Auth
        DU1_KS_keine_Grundeinstellung_oDisplay_1_03_oMIBCAN_9e5e074d_Tx: ComBitPosition=16, ComBitSize=1, ComSignalInitValue=0, ComSignalType=BOOLEAN, ComTransferProperty=TRIGGERED_ON_CHANGE_WITHOUT_REPETITION, ComSystemTemplateSystemSignalRef=DU1_KS_keine_Grundeinstellung
        DU1_LVDS_Splitter_Fehlerstatus_oDisplay_1_02_oMIBCAN_64ba48d3_Tx: ComBitPosition=44, ComBitSize=2, ComSignalInitValue=0, ComSignalType=UINT8, ComTransferProperty=PENDING, ComSystemTemplateSystemSignalRef=DU1_LVDS_Splitter_Fehlerstatus
        DU1_SW_inkonsistent_oDisplay_1_02_oMIBCAN_b0f93d56_Tx: ComBitPosition=27, ComBitSize=1, ComSignalInitValue=0, ComSignalType=BOOLEAN, ComTransferProperty=PENDING, ComSystemTemplateSystemSignalRef=DU1_SW_inkonsistent
        DU1_Slider_Locked_oDisplay_1_03_oMIBCAN_72d0f324_Tx: ComBitPosition=22, ComBitSize=1, ComSignalInitValue=0, ComSignalType=BOOLEAN, ComTransferProperty=TRIGGERED_ON_CHANGE_WITHOUT_REPETITION, ComSystemTemplateSystemSignalRef=DU1_Slider_Locked
        DU1_Touch_Fehlerstatus_oDisplay_1_02_oMIBCAN_6890f00b_Tx: ComBitPosition=40, ComBitSize=2, ComSignalInitValue=0, ComSignalType=UINT8, ComTransferProperty=PENDING, ComSystemTemplateSystemSignalRef=DU1_Touch_Fehlerstatus
        DU1_Touchstatus_oDisplay_1_03_oMIBCAN_2bf2a61b_Tx: ComBitPosition=18, ComBitSize=2, ComSignalInitValue=0, ComSignalType=UINT8, ComTransferProperty=TRIGGERED_ON_CHANGE_WITHOUT_REPETITION, ComSystemTemplateSystemSignalRef=DU1_Touchstatus
        DU_Betriebsdauer_min_oDisplay_1_02_oMIBCAN_2acbc23e_Tx: ComBitPosition=0, ComBitSize=8, ComSignalInitValue=254, ComSignalType=UINT8, ComTransferProperty=PENDING, ComSystemTemplateSystemSignalRef=DU_Betriebsdauer_min
        DU_Betriebsdauer_std_oDisplay_1_02_oMIBCAN_9d663275_Tx: ComBitPosition=8, ComBitSize=16, ComSignalInitValue=65534, ComSignalType=UINT16, ComTransferProperty=PENDING, ComSystemTemplateSystemSignalRef=DU_Betriebsdauer_std
        DU_DispDerating_oDisplay_1_01_oMIBCAN_6203b525_Tx: ComBitPosition=8, ComBitSize=8, ComSignalInitValue=254, ComSignalType=UINT8, ComTransferProperty=PENDING, ComSystemTemplateSystemSignalRef=DU_DispDerating
        DU_HintGrdBelKurzschl_oDisplay_1_02_oMIBCAN_fbaf82f0_Tx: ComBitPosition=24, ComBitSize=1, ComSignalInitValue=0, ComSignalType=BOOLEAN, ComTransferProperty=TRIGGERED_ON_CHANGE_WITHOUT_REPETITION, ComSystemTemplateSystemSignalRef=DU_HintGrdBelKurzschl
        DU_HintGrdBelUnterbr_oDisplay_1_02_oMIBCAN_06cf81bf_Tx: ComBitPosition=25, ComBitSize=1, ComSignalInitValue=0, ComSignalType=BOOLEAN, ComTransferProperty=TRIGGERED_ON_CHANGE_WITHOUT_REPETITION, ComSystemTemplateSystemSignalRef=DU_HintGrdBelUnterbr
        DU_KL30_Uebersp_Fehler_oDisplay_1_01_oMIBCAN_e0912025_Tx: ComBitPosition=5, ComBitSize=1, ComSignalInitValue=0, ComSignalType=BOOLEAN, ComTransferProperty=TRIGGERED_ON_CHANGE_WITHOUT_REPETITION, ComSystemTemplateSystemSignalRef=DU_KL30_Uebersp_Fehler
        DU_KL30_Untersp_Fehler_oDisplay_1_01_oMIBCAN_5fbc402e_Tx: ComBitPosition=6, ComBitSize=1, ComSignalInitValue=0, ComSignalType=BOOLEAN, ComTransferProperty=TRIGGERED_ON_CHANGE_WITHOUT_REPETITION, ComSystemTemplateSystemSignalRef=DU_KL30_Untersp_Fehler
        DU_KL_30F_oDisplay_1_01_oMIBCAN_d11c2a24_Tx: ComBitPosition=16, ComBitSize=8, ComSignalInitValue=254, ComSignalType=UINT8, ComTransferProperty=PENDING, ComSystemTemplateSystemSignalRef=DU_KL_30F
        DU_State_oDisplay_1_01_oMIBCAN_4769a67f_Tx: ComBitPosition=0, ComBitSize=3, ComSignalInitValue=0, ComSignalType=UINT8, ComTransferProperty=TRIGGERED_ON_CHANGE_WITHOUT_REPETITION, ComSystemTemplateSystemSignalRef=DU_State
        DU_TempSensMax_oDisplay_1_01_oMIBCAN_f790ff70_Tx: ComBitPosition=32, ComBitSize=8, ComSignalInitValue=254, ComSignalType=UINT8, ComTransferProperty=PENDING, ComSystemTemplateSystemSignalRef=DU_TempSensMax
        DU_TempSens_oDisplay_1_01_oMIBCAN_49cb802f_Tx: ComBitPosition=24, ComBitSize=8, ComSignalInitValue=254, ComSignalType=UINT8, ComTransferProperty=PENDING, ComSystemTemplateSystemSignalRef=DU_TempSens
        DU_Temp_Fehler_oDisplay_1_01_oMIBCAN_d7f54cb3_Tx: ComBitPosition=4, ComBitSize=1, ComSignalInitValue=0, ComSignalType=BOOLEAN, ComTransferProperty=TRIGGERED_ON_CHANGE_WITHOUT_REPETITION, ComSystemTemplateSystemSignalRef=DU_Temp_Fehler
        DU_Variant_oDisplay_1_01_oMIBCAN_6b6c6b43_Tx: ComBitPosition=40, ComBitSize=8, ComSignalInitValue=254, ComSignalType=UINT8, ComTransferProperty=PENDING, ComSystemTemplateSystemSignalRef=DU_Variant
        DU_Zulieferer_oDisplay_1_01_oMIBCAN_c2936e4f_Tx: ComBitPosition=48, ComBitSize=3, ComSignalInitValue=0, ComSignalType=UINT8, ComTransferProperty=PENDING, ComSystemTemplateSystemSignalRef=DU_Zulieferer
        EEPROM_Fehler_oDisplay_1_02_oMIBCAN_817b8bfb_Tx: ComBitPosition=26, ComBitSize=1, ComSignalInitValue=0, ComSignalType=BOOLEAN, ComTransferProperty=TRIGGERED_ON_CHANGE_WITHOUT_REPETITION, ComSystemTemplateSystemSignalRef=EEPROM_Fehler
        FB_Mode_oDisplay_1_01_oMIBCAN_6b67d692_Tx: ComBitPosition=7, ComBitSize=1, ComSignalInitValue=0, ComSignalType=BOOLEAN, ComTransferProperty=TRIGGERED_ON_CHANGE_WITHOUT_REPETITION, ComSystemTemplateSystemSignalRef=FB_Mode
        HU_Fotosensor_oDisplay_1_01_oMIBCAN_f64a6679_Tx: ComBitPosition=51, ComBitSize=9, ComSignalInitValue=510, ComSignalType=UINT16, ComTransferProperty=PENDING, ComSystemTemplateSystemSignalRef=HU_Fotosensor
        KBI_Kilometerstand_oDiagnose_01_oMIBCAN_35c5dcae_Rx: ComBitPosition=8, ComBitSize=20, ComSignalInitValue=1048574, ComSignalType=UINT32, ComTimeout=5, ComSystemTemplateSystemSignalRef=KBI_Kilometerstand
        LVDS_Status_oDisplay_1_02_oMIBCAN_ae978a05_Tx: ComBitPosition=31, ComBitSize=1, ComSignalInitValue=0, ComSignalType=BOOLEAN, ComTransferProperty=TRIGGERED_ON_CHANGE_WITHOUT_REPETITION, ComSystemTemplateSystemSignalRef=LVDS_Status
        MMI_State_oZentralrechner_01_oMIBCAN_ec450996_Rx: ComBitPosition=10, ComBitSize=6, ComSignalInitValue=0, ComSignalType=UINT8, ComTimeout=5, ComSystemTemplateSystemSignalRef=MMI_State
        NM_ABT_1_Car_Wakeup_oNMH_ABT_1_oMIBCAN_e071a033_Tx: ComBitPosition=6, ComBitSize=1, ComSignalInitValue=0, ComSignalType=BOOLEAN, ComTransferProperty=PENDING, ComSystemTemplateSystemSignalRef=NM_ABT_1_Car_Wakeup
        NM_ABT_1_NL_Dimmung_oNMH_ABT_1_oMIBCAN_7e696feb_Tx: ComBitPosition=32, ComBitSize=1, ComSignalInitValue=0, ComSignalType=BOOLEAN, ComTransferProperty=PENDING, ComSystemTemplateSystemSignalRef=NM_ABT_1_NL_Dimmung
        NM_ABT_1_NL_WakeUp_Lock_oNMH_ABT_1_oMIBCAN_11a791fc_Tx: ComBitPosition=33, ComBitSize=1, ComSignalInitValue=0, ComSignalType=BOOLEAN, ComTransferProperty=PENDING, ComSystemTemplateSystemSignalRef=NM_ABT_1_NL_WakeUp_Lock
        NM_ABT_1_NM_State_oNMH_ABT_1_oMIBCAN_91fd4fee_Tx: ComBitPosition=0, ComBitSize=6, ComSignalInitValue=0, ComSignalType=UINT8, ComTransferProperty=PENDING, ComSystemTemplateSystemSignalRef=NM_ABT_1_NM_State
        NM_ABT_1_NM_aktiv_Diagnose_oNMH_ABT_1_oMIBCAN_33c33ade_Tx: ComBitPosition=17, ComBitSize=1, ComSignalInitValue=0, ComSignalType=BOOLEAN, ComTransferProperty=PENDING, ComSystemTemplateSystemSignalRef=NM_ABT_1_NM_aktiv_Diagnose
        NM_ABT_1_NM_aktiv_KL15_oNMH_ABT_1_oMIBCAN_5752959c_Tx: ComBitPosition=16, ComBitSize=1, ComSignalInitValue=0, ComSignalType=BOOLEAN, ComTransferProperty=PENDING, ComSystemTemplateSystemSignalRef=NM_ABT_1_NM_aktiv_KL15
        NM_ABT_1_NM_aktiv_Tmin_oNMH_ABT_1_oMIBCAN_c22cf87b_Tx: ComBitPosition=18, ComBitSize=1, ComSignalInitValue=0, ComSignalType=BOOLEAN, ComTransferProperty=PENDING, ComSystemTemplateSystemSignalRef=NM_ABT_1_NM_aktiv_Tmin
        NM_ABT_1_UDS_CC_oNMH_ABT_1_oMIBCAN_9b6e5a24_Tx: ComBitPosition=47, ComBitSize=1, ComSignalInitValue=0, ComSignalType=BOOLEAN, ComTransferProperty=PENDING, ComSystemTemplateSystemSignalRef=NM_ABT_1_UDS_CC
        NM_ABT_1_Wakeup_oNMH_ABT_1_oMIBCAN_d72a039d_Tx: ComBitPosition=8, ComBitSize=8, ComSignalInitValue=0, ComSignalType=UINT8, ComTransferProperty=PENDING, ComSystemTemplateSystemSignalRef=NM_ABT_1_Wakeup
        NVEM_Abschaltstufe_oBEM_02_oMIBCAN_ef46dd34_Rx: ComBitPosition=0, ComBitSize=2, ComSignalInitValue=0, ComSignalType=UINT8, ComTimeout=1, ComSystemTemplateSystemSignalRef=NVEM_Abschaltstufe
        SI_BUS_03_oSysteminfo_01_oMIBCAN_d2d89088_Rx: ComBitPosition=18, ComBitSize=1, ComSignalInitValue=1, ComSignalType=BOOLEAN, ComTimeout=5, ComSystemTemplateSystemSignalRef=SI_BUS_03
        SI_ICAN_oZentralrechner_01_oMIBCAN_2902e27b_Rx: ComBitPosition=28, ComBitSize=1, ComSignalInitValue=1, ComSignalType=BOOLEAN, ComTimeout=5, ComSystemTemplateSystemSignalRef=SI_ICAN
        SI_T_Mode_oSysteminfo_01_oMIBCAN_3f9035a3_Rx: ComBitPosition=9, ComBitSize=1, ComSignalInitValue=0, ComSignalType=BOOLEAN, ComTimeout=5, ComSystemTemplateSystemSignalRef=SI_T_Mode
        SystemMode_oDisplay_1_01_oMIBCAN_861c20ce_Tx: ComBitPosition=3, ComBitSize=1, ComSignalInitValue=0, ComSignalType=BOOLEAN, ComTransferProperty=TRIGGERED_ON_CHANGE_WITHOUT_REPETITION, ComSystemTemplateSystemSignalRef=SystemMode
        UH_Jahr_oDiagnose_01_oMIBCAN_892bc6b5_Rx: ComBitPosition=28, ComBitSize=7, ComSignalInitValue=0, ComSignalType=UINT8, ComTimeout=5, ComSystemTemplateSystemSignalRef=UH_Jahr
        UH_Minute_oDiagnose_01_oMIBCAN_85876052_Rx: ComBitPosition=49, ComBitSize=6, ComSignalInitValue=0, ComSignalType=UINT8, ComTimeout=5, ComSystemTemplateSystemSignalRef=UH_Minute
        UH_Monat_oDiagnose_01_oMIBCAN_8aebb7ca_Rx: ComBitPosition=35, ComBitSize=4, ComSignalInitValue=0, ComSignalType=UINT8, ComTimeout=5, ComSystemTemplateSystemSignalRef=UH_Monat
        UH_Sekunde_oDiagnose_01_oMIBCAN_c0c7f488_Rx: ComBitPosition=55, ComBitSize=6, ComSignalInitValue=0, ComSignalType=UINT8, ComTimeout=5, ComSystemTemplateSystemSignalRef=UH_Sekunde
        UH_Stunde_oDiagnose_01_oMIBCAN_222168aa_Rx: ComBitPosition=44, ComBitSize=5, ComSignalInitValue=0, ComSignalType=UINT8, ComTimeout=5, ComSystemTemplateSystemSignalRef=UH_Stunde
        UH_Tag_oDiagnose_01_oMIBCAN_1961be5f_Rx: ComBitPosition=39, ComBitSize=5, ComSignalInitValue=0, ComSignalType=UINT8, ComTimeout=5, ComSystemTemplateSystemSignalRef=UH_Tag
        Vehicle_Driving_Cycle_oDiagnose_01_oMIBCAN_ce282b65_Rx: ComBitPosition=61, ComBitSize=1, ComSignalInitValue=0, ComSignalType=BOOLEAN, ComTimeout=5, ComSystemTemplateSystemSignalRef=Vehicle_Driving_Cycle, variation-point=post-build-variant-condition{matching-criterion=Communication, value=1}
        ZR_DimOffs_DU_1_oZentralrechner_01_oMIBCAN_ed78e230_Rx: ComBitPosition=16, ComBitSize=4, ComSignalInitValue=14, ComSignalType=UINT8, ComTimeout=5, ComSystemTemplateSystemSignalRef=ZR_DimOffs_DU_1
        ZR_Lenkerpos_Status_oDisplay_1_02_oMIBCAN_352e9ddb_Tx: ComBitPosition=32, ComBitSize=1, ComSignalInitValue=0, ComSignalType=BOOLEAN, ComTransferProperty=PENDING, ComSystemTemplateSystemSignalRef=ZR_Lenkerpos_Status
        ZR_Lenkerposition_oZentralrechner_01_oMIBCAN_ff96913e_Rx: ComBitPosition=29, ComBitSize=1, ComSignalInitValue=0, ComSignalType=BOOLEAN, ComTimeout=5, ComSystemTemplateSystemSignalRef=ZR_Lenkerposition
        ZR_Plattform_oZentralrechner_04_oMIBCAN_29a5a979_Rx: ComBitPosition=12, ComBitSize=5, ComSignalInitValue=0, ComSignalType=UINT8, ComTimeout=5, ComSystemTemplateSystemSignalRef=ZR_Plattform
        ZR_State_DU_1_oZentralrechner_01_oMIBCAN_df67a3d9_Rx: ComBitPosition=0, ComBitSize=3, ComSignalInitValue=0, ComSignalType=UINT8, ComTimeout=5, ComSystemTemplateSystemSignalRef=ZR_State_DU_1
        ZR_WecktGesp_oZentralrechner_01_oMIBCAN_7de76e98_Rx: ComBitPosition=9, ComBitSize=1, ComSignalInitValue=0, ComSignalType=BOOLEAN, ComTimeout=5, ComSystemTemplateSystemSignalRef=ZR_WecktGesp
      SG_Klemmen_Status_01_oKlemmen_Status_01_oMIBCAN_a0c765b4_Rx (ComSignalGroup): ComTimeout=1, ComTransferProperty=PENDING, ComSystemTemplateSignalGroupRef=SG_Klemmen_Status_01
        21 x ComGroupSignal, all with ComSignalEndianness=LITTLE_ENDIAN:
          BCM_Ausparken_Betrieb_oKlemmen_Status_01_oMIBCAN_7e015356_Rx: ComBitPosition=28, ComBitSize=1, ComSignalInitValue=0, ComSignalType=BOOLEAN, ComSystemTemplateSystemSignalRef=BCM_Ausparken_Betrieb
          KST_Fahrerhinweis_1_oKlemmen_Status_01_oMIBCAN_8b2c6ae1_Rx: ComBitPosition=26, ComBitSize=1, ComSignalInitValue=0, ComSignalType=BOOLEAN, ComSystemTemplateSystemSignalRef=KST_Fahrerhinweis_1
          KST_Fahrerhinweis_2_oKlemmen_Status_01_oMIBCAN_89f26dc6_Rx: ComBitPosition=27, ComBitSize=1, ComSignalInitValue=0, ComSignalType=BOOLEAN, ComSystemTemplateSystemSignalRef=KST_Fahrerhinweis_2
          KST_Fahrerhinweis_4_oKlemmen_Status_01_oMIBCAN_8c4e6388_Rx: ComBitPosition=29, ComBitSize=1, ComSignalInitValue=0, ComSignalType=BOOLEAN, ComSystemTemplateSystemSignalRef=KST_Fahrerhinweis_4
          KST_Fahrerhinweis_5_oKlemmen_Status_01_oMIBCAN_8dfb9e95_Rx: ComBitPosition=30, ComBitSize=1, ComSignalInitValue=0, ComSignalType=BOOLEAN, ComSystemTemplateSystemSignalRef=KST_Fahrerhinweis_5
          KST_Fahrerhinweis_6_oKlemmen_Status_01_oMIBCAN_8f2599b2_Rx: ComBitPosition=31, ComBitSize=1, ComSignalInitValue=0, ComSignalType=BOOLEAN, ComSystemTemplateSystemSignalRef=KST_Fahrerhinweis_6
          KST_Warn_P1_ZST_def_oKlemmen_Status_01_oMIBCAN_67e72903_Rx: ComBitPosition=24, ComBitSize=1, ComSignalInitValue=0, ComSignalType=BOOLEAN, ComSystemTemplateSystemSignalRef=KST_Warn_P1_ZST_def
          KST_Warn_P2_ZST_def_oKlemmen_Status_01_oMIBCAN_030752fd_Rx: ComBitPosition=25, ComBitSize=1, ComSignalInitValue=0, ComSignalType=BOOLEAN, ComSystemTemplateSystemSignalRef=KST_Warn_P2_ZST_def
          Klemmen_Status_01_0x14_0x01_oKlemmen_Status_01_oMIBCAN_891dcbfb_Rx: ComBitPosition=20, ComBitSize=1, ComSignalType=BOOLEAN, ComSystemTemplateSystemSignalRef=Klemmen_Status_01_0x14_0x01, variation-point=post-build-variant-condition{matching-criterion=Communication, value=1}
          Klemmen_Status_01_0x16_0x02_oKlemmen_Status_01_oMIBCAN_e626ed3a_Rx: ComBitPosition=22, ComBitSize=2, ComSignalType=UINT8, ComSystemTemplateSystemSignalRef=Klemmen_Status_01_0x16_0x02, variation-point=post-build-variant-condition{matching-criterion=Communication, value=1}
          Klemmen_Status_01_BZ_oKlemmen_Status_01_oMIBCAN_17f28771_Rx: ComBitPosition=8, ComBitSize=4, ComSignalInitValue=0, ComSignalType=UINT8, ComSystemTemplateSystemSignalRef=Klemmen_Status_01_BZ
          Klemmen_Status_01_CRC_oKlemmen_Status_01_oMIBCAN_15bc5e1a_Rx: ComBitPosition=0, ComBitSize=8, ComSignalInitValue=0, ComSignalType=UINT8, ComSystemTemplateSystemSignalRef=Klemmen_Status_01_CRC
          RSt_Fahrerhinweise_oKlemmen_Status_01_oMIBCAN_3a06c6f8_Rx: ComBitPosition=12, ComBitSize=4, ComSignalInitValue=0, ComSignalType=UINT8, ComSystemTemplateSystemSignalRef=RSt_Fahrerhinweise
          ZAS_Kl_15_oKlemmen_Status_01_oMIBCAN_d7324601_Rx: ComBitPosition=17, ComBitSize=1, ComSignalInitValue=0, ComSignalType=BOOLEAN, ComSystemTemplateSystemSignalRef=ZAS_Kl_15
          ZAS_Kl_50_Startanforderung_oKlemmen_Status_01_oMIBCAN_b82dfcef_Rx: ComBitPosition=19, ComBitSize=1, ComSignalInitValue=0, ComSignalType=BOOLEAN, ComSystemTemplateSystemSignalRef=ZAS_Kl_50_Startanforderung
          ZAS_Kl_Infotainment_oKlemmen_Status_01_oMIBCAN_fc03e87a_Rx: ComBitPosition=21, ComBitSize=1, ComSignalInitValue=0, ComSignalType=BOOLEAN, ComSystemTemplateSystemSignalRef=ZAS_Kl_Infotainment
          ZAS_Kl_S_oKlemmen_Status_01_oMIBCAN_84711ff6_Rx: ComBitPosition=16, ComBitSize=1, ComSignalInitValue=0, ComSignalType=BOOLEAN, ComSystemTemplateSystemSignalRef=ZAS_Kl_S
          ZAS_Kl_X_oKlemmen_Status_01_oMIBCAN_8b00f039_Rx: ComBitPosition=18, ComBitSize=1, ComSignalInitValue=0, ComSignalType=BOOLEAN, ComSystemTemplateSystemSignalRef=ZAS_Kl_X
          BCM_Remotestart_Betrieb_oKlemmen_Status_01_oMIBCAN_3720576f_Rx: ComBitPosition=20, ComBitSize=1, ComSignalInitValue=0, ComSignalType=BOOLEAN, ComSystemTemplateSystemSignalRef=BCM_Remotestart_Betrieb, variation-point=post-build-variant-condition{matching-criterion=Communication, value=0}
          BCM_Remotestart_KL15_Anf_oKlemmen_Status_01_oMIBCAN_0ee9ae02_Rx: ComBitPosition=22, ComBitSize=1, ComSignalInitValue=0, ComSignalType=BOOLEAN, ComSystemTemplateSystemSignalRef=BCM_Remotestart_KL15_Anf, variation-point=post-build-variant-condition{matching-criterion=Communication, value=0}
          BCM_Remotestart_MO_Start_oKlemmen_Status_01_oMIBCAN_2fceacfc_Rx: ComBitPosition=23, ComBitSize=1, ComSignalInitValue=0, ComSignalType=BOOLEAN, ComSystemTemplateSystemSignalRef=BCM_Remotestart_MO_Start, variation-point=post-build-variant-condition{matching-criterion=Communication, value=0}
      SG_ORU_01_oORU_01_oMIBCAN_abfe8160_Rx (ComSignalGroup):
        ComTimeout = 5
        ComTransferProperty = PENDING
        ComSystemTemplateSignalGroupRef = SG_ORU_01
        variation-point = post-build-variant-condition{matching-criterion=Communication, value=1}
        11 x ComGroupSignal, all with ComSignalEndianness=LITTLE_ENDIAN:
          ORU_01_0x1C_0x07_oORU_01_oMIBCAN_7de3273c_Rx: ComBitPosition=28, ComBitSize=7, ComSignalType=UINT8, ComSystemTemplateSystemSignalRef=ORU_01_0x1C_0x07
          ORU_01_0x3C_0x01_oORU_01_oMIBCAN_374143dd_Rx: ComBitPosition=60, ComBitSize=1, ComSignalType=BOOLEAN, ComSystemTemplateSystemSignalRef=ORU_01_0x3C_0x01
          ORU_01_BZ_oORU_01_oMIBCAN_1b18ef46_Rx: ComBitPosition=8, ComBitSize=4, ComSignalInitValue=0, ComSignalType=UINT8, ComSystemTemplateSystemSignalRef=ORU_01_BZ
          ORU_01_CRC_oORU_01_oMIBCAN_14a88da6_Rx: ComBitPosition=0, ComBitSize=8, ComSignalInitValue=0, ComSignalType=UINT8, ComSystemTemplateSystemSignalRef=ORU_01_CRC
          ORU_DiagAddress_oORU_01_oMIBCAN_f8d9dae0_Rx: ComBitPosition=12, ComBitSize=16, ComSignalInitValue=0, ComSignalType=UINT16, ComSystemTemplateSystemSignalRef=ORU_DiagAddress
          ORU_EM_Anfrage_Flashdauer_oORU_01_oMIBCAN_7aaaa286_Rx: ComBitPosition=48, ComBitSize=10, ComSignalInitValue=0, ComSignalType=UINT16, ComSystemTemplateSystemSignalRef=ORU_EM_Anfrage_Flashdauer
          ORU_EM_Anfrage_Stromaufnahme_oORU_01_oMIBCAN_fdea2cf8_Rx: ComBitPosition=39, ComBitSize=9, ComSignalInitValue=0, ComSignalType=UINT16, ComSystemTemplateSystemSignalRef=ORU_EM_Anfrage_Stromaufnahme
          ORU_EM_Anfrage_freigegebeneNetze_oORU_01_oMIBCAN_648a0bf4_Rx: ComBitPosition=37, ComBitSize=2, ComSignalInitValue=0, ComSignalType=UINT8, ComSystemTemplateSystemSignalRef=ORU_EM_Anfrage_freigegebeneNetze
          ORU_Inventory_oORU_01_oMIBCAN_70592193_Rx: ComBitPosition=35, ComBitSize=2, ComSignalInitValue=0, ComSignalType=UINT8, ComSystemTemplateSystemSignalRef=ORU_Inventory
          ORU_Status_oORU_01_oMIBCAN_0f6334f9_Rx: ComBitPosition=61, ComBitSize=3, ComSignalInitValue=0, ComSignalType=UINT8, ComSystemTemplateSystemSignalRef=ORU_Status
          ORU_Warnung_oORU_01_oMIBCAN_6a7977f4_Rx: ComBitPosition=58, ComBitSize=2, ComSignalInitValue=0, ComSignalType=UINT8, ComSystemTemplateSystemSignalRef=ORU_Warnung
    ComGeneral
  module config ComM
    ComMConfigSet: ComMPncEnabled=false
      CN_MIBCAN_0d25aee7 (ComMChannel): ComMBusType=COMM_BUS_TYPE_CAN, ComMChannelId=0
        ComMNetworkManagement: ComMNmVariant=FULL
        CN_MIBCAN_a53f67be (ComMUserPerChannel): ComMUserChannel=CN_MIBCAN_49695965
      CN_MIBCAN_49695965 (ComMUser): ComMUserIdentifier=0
    ComMGeneral: ComMPncIdCounting=COMM_PNC_ID_COUNT_FROM_NM_MESSAGE, ComMPncSupport=false
