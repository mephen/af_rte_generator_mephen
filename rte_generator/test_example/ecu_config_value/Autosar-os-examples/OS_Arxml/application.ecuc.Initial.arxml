[part 2 of 2: package /InitialEcuC]
AUTOSAR XML (schema 00048)
package /InitialEcuC  (continued)
  module config Dcm
    DcmConfigSet  # Diagnostics Data Import
      DcmDsl
        DcmDslProtocol
          DcmDslProtocolRow_29812fbf (DcmDslProtocolRow)
            5 x DcmDslConnection:
              DC_DIA_ABT_1_oABT_1_MIB_ab_Gen3_oMIBCAN_7b176bb5
                DC_DIA_ABT_1_oABT_1_MIB_ab_Gen3_oMIBCAN_7b176bb5 (DcmDslMainConnection)
                  DIA_ABT_1_Req_oMIBCAN_57dc7f80_Rx_95e0e5e8 (DcmDslProtocolRx):
                    DcmDslProtocolRxAddrType = DCM_PHYSICAL_TYPE
                    DcmDslProtocolRxPduId = 1
                    DcmDslProtocolRxComMChannelRef = ComMConfigSet/CN_MIBCAN_0d25aee7
                    DcmDslProtocolRxPduRef = DIA_ABT_1_Req_oMIBCAN_57dc7f80_Rx
                  DIA_ABT_1_Resp_oMIBCAN_fa3ae601_Tx_6543a9fa (DcmDslProtocolTx): DcmDslTxConfirmationPduId=0, DcmDslProtocolTxPduRef=EcucPduCollection/DIA_ABT_1_Resp_oMIBCAN_fa3ae601_Tx
              DC_Diag_ABT_1_oABT_1_MIB_ab_Gen3_oMIBCAN_caa2cbc1
                DC_Diag_ABT_1_oABT_1_MIB_ab_Gen3_oMIBCAN_caa2cbc1 (DcmDslMainConnection)
                  Diag_ABT_1_Req_oMIBCAN_55599102_Rx_ddec79c9 (DcmDslProtocolRx):
                    DcmDslProtocolRxAddrType = DCM_PHYSICAL_TYPE
                    DcmDslProtocolRxPduId = 3
                    DcmDslProtocolRxComMChannelRef = ComMConfigSet/CN_MIBCAN_0d25aee7
                    DcmDslProtocolRxPduRef = Diag_ABT_1_Req_oMIBCAN_55599102_Rx
                  Diag_ABT_1_Resp_oMIBCAN_f98e81e3_Tx_0cee5805 (DcmDslProtocolTx): DcmDslTxConfirmationPduId=2, DcmDslProtocolTxPduRef=EcucPduCollection/Diag_ABT_1_Resp_oMIBCAN_f98e81e3_Tx
              DC_HID_ZR_ABT_1_oABT_1_MIB_ab_Gen3_oMIBCAN_343f341a
                DC_HID_ZR_ABT_1_oABT_1_MIB_ab_Gen3_oMIBCAN_343f341a (DcmDslMainConnection)
                  HID_ZR_ABT_1_Req_oMIBCAN_4e88cb04_Rx_09076d62 (DcmDslProtocolRx):
                    DcmDslProtocolRxAddrType = DCM_PHYSICAL_TYPE
                    DcmDslProtocolRxPduId = 5
                    DcmDslProtocolRxComMChannelRef = ComMConfigSet/CN_MIBCAN_0d25aee7
                    DcmDslProtocolRxPduRef = HID_ZR_ABT_1_Req_oMIBCAN_4e88cb04_Rx
                  HID_ZR_ABT_1_Resp_oMIBCAN_10f6f58c_Tx_3a6777c5 (DcmDslProtocolTx): DcmDslTxConfirmationPduId=4, DcmDslProtocolTxPduRef=EcucPduCollection/HID_ZR_ABT_1_Resp_oMIBCAN_10f6f58c_Tx
              DC_KS_SSN_ABT_1_oABT_1_MIB_ab_Gen3_oMIBCAN_c41b9fc2
                DC_KS_SSN_ABT_1_oABT_1_MIB_ab_Gen3_oMIBCAN_c41b9fc2 (DcmDslMainConnection)
                  KS_SSN_ABT_1_Req_oMIBCAN_ef3b7efa_Rx_89d2d4ef (DcmDslProtocolRx):
                    DcmDslProtocolRxAddrType = DCM_PHYSICAL_TYPE
                    DcmDslProtocolRxPduId = 7
                    DcmDslProtocolRxComMChannelRef = ComMConfigSet/CN_MIBCAN_0d25aee7
                    DcmDslProtocolRxPduRef = KS_SSN_ABT_1_Req_oMIBCAN_ef3b7efa_Rx
                  KS_SSN_ABT_1_Resp_oMIBCAN_4a529922_Tx_c5eb6e41 (DcmDslProtocolTx): DcmDslTxConfirmationPduId=6, DcmDslProtocolTxPduRef=EcucPduCollection/KS_SSN_ABT_1_Resp_oMIBCAN_4a529922_Tx
              DC_OBDC_SSN_ABT_1_oABT_1_MIB_ab_Gen3_oMIBCAN_5b2f826b
                DC_OBDC_SSN_ABT_1_oABT_1_MIB_ab_Gen3_oMIBCAN_5b2f826b (DcmDslMainConnection)
                  OBDC_SSN_ABT_1_Req_oMIBCAN_0f9cb27d_Rx_bced533d (DcmDslProtocolRx):
                    DcmDslProtocolRxAddrType = DCM_PHYSICAL_TYPE
                    DcmDslProtocolRxPduId = 9
                    DcmDslProtocolRxComMChannelRef = ComMConfigSet/CN_MIBCAN_0d25aee7
                    DcmDslProtocolRxPduRef = OBDC_SSN_ABT_1_Req_oMIBCAN_0f9cb27d_Rx
                  OBDC_SSN_ABT_1_Resp_oMIBCAN_396e286d_Tx_ca2f51d5 (DcmDslProtocolTx): DcmDslTxConfirmationPduId=8, DcmDslProtocolTxPduRef=EcucPduCollection/OBDC_SSN_ABT_1_Resp_oMIBCAN_396e286d_Tx
      DcmDsp: DcmDspMaxDidToRead=1  # Diagnostics Data Import
        ComControl (DcmDspComControl)  # Diagnostics Data Import
          DspComContolAllChannel (DcmDspComControlAllChannel)  # Diagnostics Data Import
        DcmDspSession  # Diagnostics Data Import
          5 x DcmDspSessionRow, all with DcmDspSessionP2ServerMax=0.05, DcmDspSessionP2StarServerMax=5:
            INX_Development_Session: DcmDspSessionLevel=97  # Diagnostics Data Import
            INX_End_Of_Line_Session: DcmDspSessionLevel=96  # Diagnostics Data Import
            Extended: DcmDspSessionLevel=3, DcmDspSessionForBoot=DCM_NO_BOOT  # Diagnostics Data Import
            Programming: DcmDspSessionLevel=2  # Diagnostics Data Import
            Default: DcmDspSessionLevel=1, DcmDspSessionForBoot=DCM_NO_BOOT  # Diagnostics Data Import
        DcmDspSecurity  # Diagnostics Data Import
          Level_17 (DcmDspSecurityRow): DcmDspSecurityKeySize=4, DcmDspSecurityLevel=9, DcmDspSecuritySeedSize=4  # Diagnostics Data Import
        79 x DcmDspRoutineInfo:
          RoutineInfo_CheckProgrammingDependencies_Start  # Diagnostics Data Import
            DcmDspStartRoutineOut  # Diagnostics Data Import
              Out_RoutineResult (DcmDspStartRoutineOutSignal): DcmDspRoutineSignalLength=8, DcmDspRoutineSignalType=UINT8, DcmDspRoutineSignalPos=0  # Diagnostics Data Import
            DcmDspRoutineAuthorization: DcmDspRoutineSessionRef=DcmDspSession/Programming, DcmDspRoutineSecurityLevelRef=Level_17  # Diagnostics Data Import
          RoutineInfo_EraseMemory_Start  # Diagnostics Data Import
            DcmDspStartRoutineOut  # Diagnostics Data Import
              Out_RoutineResult (DcmDspStartRoutineOutSignal): DcmDspRoutineSignalLength=8, DcmDspRoutineSignalType=UINT8, DcmDspRoutineSignalPos=0  # Diagnostics Data Import
            DcmDspStartRoutineIn  # Diagnostics Data Import
              In_MemoryAddress (DcmDspStartRoutineInSignal): DcmDspRoutineSignalLength=8, DcmDspRoutineSignalType=UINT8, DcmDspRoutineSignalPos=8  # Diagnostics Data Import
              In_ALFID (DcmDspStartRoutineInSignal): DcmDspRoutineSignalLength=8, DcmDspRoutineSignalType=UINT8, DcmDspRoutineSignalPos=0  # Diagnostics Data Import
            DcmDspRoutineAuthorization: DcmDspRoutineSessionRef=DcmDspSession/Programming, DcmDspRoutineSecurityLevelRef=Level_17  # Diagnostics Data Import
          RoutineInfo_SwcDisplayInfo_ModuleVersionInfo_Start  # Diagnostics Data Import
            DcmDspStartRoutineOut  # Diagnostics Data Import
              Out_moduleVersionList (DcmDspStartRoutineOutSignal): DcmDspRoutineSignalLength=4000, DcmDspRoutineSignalType=VARIABLE_LENGTH, DcmDspRoutineSignalEndianness=opaque, DcmDspRoutineSignalPos=8  # Diagnostics Data Import
              Out_moduleVersionCount (DcmDspStartRoutineOutSignal): DcmDspRoutineSignalLength=8, DcmDspRoutineSignalType=UINT8, DcmDspRoutineSignalPos=0  # Diagnostics Data Import
            DcmDspRoutineAuthorization:  # Diagnostics Data Import
              DcmDspRoutineSessionRef = DcmDspSession/Programming
              DcmDspRoutineSessionRef = DcmDspSession/Extended
              DcmDspRoutineSessionRef = INX_End_Of_Line_Session
              DcmDspRoutineSessionRef = INX_Development_Session
              DcmDspRoutineSecurityLevelRef = Level_17
          RoutineInfo_CddHWRNXPRT1171_SeverityLevelSimulation_Start  # Diagnostics Data Import
            DcmDspStartRoutineIn  # Diagnostics Data Import
              In_errorSeverityLevel (DcmDspStartRoutineInSignal): DcmDspRoutineSignalLength=8, DcmDspRoutineSignalType=UINT8, DcmDspRoutineSignalPos=0  # Diagnostics Data Import
            DcmDspRoutineAuthorization: DcmDspRoutineSessionRef=INX_End_Of_Line_Session, DcmDspRoutineSessionRef=INX_Development_Session, DcmDspRoutineSecurityLevelRef=Level_17  # Diagnostics Data Import
          RoutineInfo_SwcVerify_RecoveryRequest_Start  # Diagnostics Data Import
            DcmDspRoutineRequestResOut  # Diagnostics Data Import
              Out_pRecoveryState (DcmDspRoutineRequestResOutSignal): DcmDspRoutineSignalLength=8, DcmDspRoutineSignalType=UINT8, DcmDspRoutineSignalPos=0  # Diagnostics Data Import
            DcmDspRoutineRequestResIn  # Diagnostics Data Import
              In_recoveryId (DcmDspRoutineRequestResInSignal): DcmDspRoutineSignalLength=8, DcmDspRoutineSignalType=UINT8, DcmDspRoutineSignalPos=16  # Diagnostics Data Import
              In_moduleId (DcmDspRoutineRequestResInSignal): DcmDspRoutineSignalLength=16, DcmDspRoutineSignalType=UINT16, DcmDspRoutineSignalEndianness=BIG_ENDIAN, DcmDspRoutineSignalPos=0  # Diagnostics Data Import
            DcmDspStartRoutineIn  # Diagnostics Data Import
              In_recoveryId (DcmDspStartRoutineInSignal): DcmDspRoutineSignalLength=8, DcmDspRoutineSignalType=UINT8, DcmDspRoutineSignalPos=16  # Diagnostics Data Import
              In_moduleId (DcmDspStartRoutineInSignal): DcmDspRoutineSignalLength=16, DcmDspRoutineSignalType=UINT16, DcmDspRoutineSignalEndianness=BIG_ENDIAN, DcmDspRoutineSignalPos=0  # Diagnostics Data Import
            DcmDspRoutineAuthorization: DcmDspRoutineSessionRef=INX_End_Of_Line_Session, DcmDspRoutineSessionRef=INX_Development_Session, DcmDspRoutineSecurityLevelRef=Level_17  # Diagnostics Data Import
          RoutineInfo_SwcVerify_VerifyRequest_Start  # Diagnostics Data Import
            DcmDspRoutineRequestResOut  # Diagnostics Data Import
              Out_pVerifyState (DcmDspRoutineRequestResOutSignal): DcmDspRoutineSignalLength=8, DcmDspRoutineSignalType=UINT8, DcmDspRoutineSignalPos=0  # Diagnostics Data Import
            DcmDspRoutineRequestResIn  # Diagnostics Data Import
              In_verifyId (DcmDspRoutineRequestResInSignal): DcmDspRoutineSignalLength=8, DcmDspRoutineSignalType=UINT8, DcmDspRoutineSignalPos=16  # Diagnostics Data Import
              In_moduleId (DcmDspRoutineRequestResInSignal): DcmDspRoutineSignalLength=16, DcmDspRoutineSignalType=UINT16, DcmDspRoutineSignalEndianness=BIG_ENDIAN, DcmDspRoutineSignalPos=0  # Diagnostics Data Import
            DcmDspStartRoutineIn  # Diagnostics Data Import
              In_verifyId (DcmDspStartRoutineInSignal): DcmDspRoutineSignalLength=8, DcmDspRoutineSignalType=UINT8, DcmDspRoutineSignalPos=16  # Diagnostics Data Import
              In_moduleId (DcmDspStartRoutineInSignal): DcmDspRoutineSignalLength=16, DcmDspRoutineSignalType=UINT16, DcmDspRoutineSignalEndianness=BIG_ENDIAN, DcmDspRoutineSignalPos=0  # Diagnostics Data Import
            DcmDspRoutineAuthorization: DcmDspRoutineSessionRef=INX_End_Of_Line_Session, DcmDspRoutineSessionRef=INX_Development_Session, DcmDspRoutineSecurityLevelRef=Level_17  # Diagnostics Data Import
          RoutineInfo_SwcVerify_ModuleVerifyDisable_Start  # Diagnostics Data Import
            DcmDspRoutineStopIn  # Diagnostics Data Import
              In_moduleId (DcmDspRoutineStopInSignal): DcmDspRoutineSignalLength=16, DcmDspRoutineSignalType=UINT16, DcmDspRoutineSignalEndianness=BIG_ENDIAN, DcmDspRoutineSignalPos=0  # Diagnostics Data Import
            DcmDspStartRoutineIn  # Diagnostics Data Import
              In_moduleId (DcmDspStartRoutineInSignal): DcmDspRoutineSignalLength=16, DcmDspRoutineSignalType=UINT16, DcmDspRoutineSignalEndianness=BIG_ENDIAN, DcmDspRoutineSignalPos=0  # Diagnostics Data Import
            DcmDspRoutineAuthorization: DcmDspRoutineSessionRef=INX_End_Of_Line_Session, DcmDspRoutineSessionRef=INX_Development_Session, DcmDspRoutineSecurityLevelRef=Level_17  # Diagnostics Data Import
          RoutineInfo_SwcSelfDiagnostics_StackUsage_Start  # Diagnostics Data Import
            DcmDspStartRoutineOut  # Diagnostics Data Import
              Out_pStackUsage (DcmDspStartRoutineOutSignal): DcmDspRoutineSignalLength=2040, DcmDspRoutineSignalType=VARIABLE_LENGTH, DcmDspRoutineSignalEndianness=opaque, DcmDspRoutineSignalPos=8  # Diagnostics Data Import
              Out_pTask (DcmDspStartRoutineOutSignal): DcmDspRoutineSignalLength=8, DcmDspRoutineSignalType=UINT8, DcmDspRoutineSignalPos=0  # Diagnostics Data Import
            DcmDspStartRoutineIn  # Diagnostics Data Import
              In_taskId (DcmDspStartRoutineInSignal): DcmDspRoutineSignalLength=8, DcmDspRoutineSignalType=UINT8, DcmDspRoutineSignalPos=0  # Diagnostics Data Import
            DcmDspRoutineAuthorization:  # Diagnostics Data Import
              DcmDspRoutineSessionRef = DcmDspSession/Programming
              DcmDspRoutineSessionRef = DcmDspSession/Extended
              DcmDspRoutineSessionRef = INX_End_Of_Line_Session
              DcmDspRoutineSessionRef = INX_Development_Session
              DcmDspRoutineSecurityLevelRef = Level_17
          RoutineInfo_SwcSelfDiagnostics_AverageCpuLoad_Start  # Diagnostics Data Import
            DcmDspRoutineRequestResOut  # Diagnostics Data Import
              Out_cpuLoad (DcmDspRoutineRequestResOutSignal): DcmDspRoutineSignalLength=8, DcmDspRoutineSignalType=UINT8, DcmDspRoutineSignalPos=0  # Diagnostics Data Import
            DcmDspRoutineAuthorization: DcmDspRoutineSessionRef=INX_End_Of_Line_Session, DcmDspRoutineSessionRef=INX_Development_Session, DcmDspRoutineSecurityLevelRef=Level_17  # Diagnostics Data Import
          RoutineInfo_SwcDimming_SetDisplayDampingInterval_Start  # Diagnostics Data Import
            DcmDspStartRoutineIn  # Diagnostics Data Import
              In_value (DcmDspStartRoutineInSignal): DcmDspRoutineSignalLength=8, DcmDspRoutineSignalType=UINT8, DcmDspRoutineSignalPos=0  # Diagnostics Data Import
            DcmDspRoutineAuthorization:  # Diagnostics Data Import
              DcmDspRoutineSessionRef = DcmDspSession/Programming
              DcmDspRoutineSessionRef = DcmDspSession/Extended
              DcmDspRoutineSessionRef = INX_End_Of_Line_Session
              DcmDspRoutineSessionRef = INX_Development_Session
              DcmDspRoutineSecurityLevelRef = Level_17
          RoutineInfo_SwcDimming_SetTauNightToDay_Start  # Diagnostics Data Import
            DcmDspStartRoutineIn  # Diagnostics Data Import
              In_value (DcmDspStartRoutineInSignal): DcmDspRoutineSignalLength=8, DcmDspRoutineSignalType=UINT8, DcmDspRoutineSignalPos=0  # Diagnostics Data Import
            DcmDspRoutineAuthorization:  # Diagnostics Data Import
              DcmDspRoutineSessionRef = DcmDspSession/Programming
              DcmDspRoutineSessionRef = DcmDspSession/Extended
              DcmDspRoutineSessionRef = INX_End_Of_Line_Session
              DcmDspRoutineSessionRef = INX_Development_Session
              DcmDspRoutineSecurityLevelRef = Level_17
          RoutineInfo_SwcDimming_SetTauDayToNight_Start  # Diagnostics Data Import
            DcmDspStartRoutineIn  # Diagnostics Data Import
              In_value (DcmDspStartRoutineInSignal): DcmDspRoutineSignalLength=8, DcmDspRoutineSignalType=UINT8, DcmDspRoutineSignalPos=0  # Diagnostics Data Import
            DcmDspRoutineAuthorization:  # Diagnostics Data Import
              DcmDspRoutineSessionRef = DcmDspSession/Programming
              DcmDspRoutineSessionRef = DcmDspSession/Extended
              DcmDspRoutineSessionRef = INX_End_Of_Line_Session
              DcmDspRoutineSessionRef = INX_Development_Session
              DcmDspRoutineSecurityLevelRef = Level_17
          RoutineInfo_SwcDimming_SetTauDampDown_Start  # Diagnostics Data Import
            DcmDspStartRoutineIn  # Diagnostics Data Import
              In_value (DcmDspStartRoutineInSignal): DcmDspRoutineSignalLength=8, DcmDspRoutineSignalType=UINT8, DcmDspRoutineSignalPos=0  # Diagnostics Data Import
            DcmDspRoutineAuthorization:  # Diagnostics Data Import
              DcmDspRoutineSessionRef = DcmDspSession/Programming
              DcmDspRoutineSessionRef = DcmDspSession/Extended
              DcmDspRoutineSessionRef = INX_End_Of_Line_Session
              DcmDspRoutineSessionRef = INX_Development_Session
              DcmDspRoutineSecurityLevelRef = Level_17
          RoutineInfo_SwcDimming_SetTauDampUp_Start  # Diagnostics Data Import
            DcmDspStartRoutineIn  # Diagnostics Data Import
              In_value (DcmDspStartRoutineInSignal): DcmDspRoutineSignalLength=8, DcmDspRoutineSignalType=UINT8, DcmDspRoutineSignalPos=0  # Diagnostics Data Import
            DcmDspRoutineAuthorization:  # Diagnostics Data Import
              DcmDspRoutineSessionRef = DcmDspSession/Programming
              DcmDspRoutineSessionRef = DcmDspSession/Extended
              DcmDspRoutineSessionRef = INX_End_Of_Line_Session
              DcmDspRoutineSessionRef = INX_Development_Session
              DcmDspRoutineSecurityLevelRef = Level_17
          RoutineInfo_SwcDimming_SetDisplayOffsetMultiplier_Start  # Diagnostics Data Import
            DcmDspStartRoutineIn  # Diagnostics Data Import
              In_value (DcmDspStartRoutineInSignal): DcmDspRoutineSignalLength=8, DcmDspRoutineSignalType=UINT8, DcmDspRoutineSignalPos=0  # Diagnostics Data Import
            DcmDspRoutineAuthorization:  # Diagnostics Data Import
              DcmDspRoutineSessionRef = DcmDspSession/Programming
              DcmDspRoutineSessionRef = DcmDspSession/Extended
              DcmDspRoutineSessionRef = INX_End_Of_Line_Session
              DcmDspRoutineSessionRef = INX_Development_Session
              DcmDspRoutineSecurityLevelRef = Level_17
          RoutineInfo_SwcDimming_SetDisplayErrorDefault_Start  # Diagnostics Data Import
            DcmDspStartRoutineIn  # Diagnostics Data Import
              In_value (DcmDspStartRoutineInSignal): DcmDspRoutineSignalLength=8, DcmDspRoutineSignalType=UINT8, DcmDspRoutineSignalPos=0  # Diagnostics Data Import
            DcmDspRoutineAuthorization:  # Diagnostics Data Import
              DcmDspRoutineSessionRef = DcmDspSession/Programming
              DcmDspRoutineSessionRef = DcmDspSession/Extended
              DcmDspRoutineSessionRef = INX_End_Of_Line_Session
              DcmDspRoutineSessionRef = INX_Development_Session
              DcmDspRoutineSecurityLevelRef = Level_17
          RoutineInfo_SwcError_GetErrorCounters_Start  # Diagnostics Data Import
            DcmDspStartRoutineOut  # Diagnostics Data Import
              Out_data (DcmDspStartRoutineOutSignal): DcmDspRoutineSignalLength=6400, DcmDspRoutineSignalType=UINT8, DcmDspRoutineSignalEndianness=opaque, DcmDspRoutineSignalPos=8  # Diagnostics Data Import
              Out_nbrOfEntries (DcmDspStartRoutineOutSignal): DcmDspRoutineSignalLength=8, DcmDspRoutineSignalType=UINT8, DcmDspRoutineSignalPos=0  # Diagnostics Data Import
            DcmDspRoutineAuthorization: DcmDspRoutineSessionRef=INX_End_Of_Line_Session, DcmDspRoutineSessionRef=INX_Development_Session, DcmDspRoutineSecurityLevelRef=Level_17  # Diagnostics Data Import
          RoutineInfo_SwcError_GetErrorTrace_Start  # Diagnostics Data Import
            DcmDspStartRoutineOut  # Diagnostics Data Import
              Out_errorTrace (DcmDspStartRoutineOutSignal): DcmDspRoutineSignalLength=1920, DcmDspRoutineSignalType=UINT8, DcmDspRoutineSignalEndianness=opaque, DcmDspRoutineSignalPos=8  # Diagnostics Data Import
              Out_traceWriteIndex (DcmDspStartRoutineOutSignal): DcmDspRoutineSignalLength=8, DcmDspRoutineSignalType=UINT8, DcmDspRoutineSignalPos=0  # Diagnostics Data Import
            DcmDspRoutineAuthorization: DcmDspRoutineSessionRef=INX_End_Of_Line_Session, DcmDspRoutineSessionRef=INX_Development_Session, DcmDspRoutineSecurityLevelRef=Level_17  # Diagnostics Data Import
          RoutineInfo_SwcError_TraceSeverityLevelSimulation_Start  # Diagnostics Data Import
            DcmDspStartRoutineIn  # Diagnostics Data Import
              In_errorSeverityLevel (DcmDspStartRoutineInSignal): DcmDspRoutineSignalLength=8, DcmDspRoutineSignalType=UINT8, DcmDspRoutineSignalPos=0  # Diagnostics Data Import
            DcmDspRoutineAuthorization:  # Diagnostics Data Import
              DcmDspRoutineSessionRef = DcmDspSession/Programming
              DcmDspRoutineSessionRef = DcmDspSession/Extended
              DcmDspRoutineSessionRef = INX_End_Of_Line_Session
              DcmDspRoutineSessionRef = INX_Development_Session
              DcmDspRoutineSecurityLevelRef = Level_17
          RoutineInfo_SwcError_ErrorCountSeverityLevelSimulation_Start  # Diagnostics Data Import
            DcmDspStartRoutineIn  # Diagnostics Data Import
              In_errorSeverityLevel (DcmDspStartRoutineInSignal): DcmDspRoutineSignalLength=8, DcmDspRoutineSignalType=UINT8, DcmDspRoutineSignalPos=0  # Diagnostics Data Import
            DcmDspRoutineAuthorization:  # Diagnostics Data Import
              DcmDspRoutineSessionRef = DcmDspSession/Programming
              DcmDspRoutineSessionRef = DcmDspSession/Extended
              DcmDspRoutineSessionRef = INX_End_Of_Line_Session
              DcmDspRoutineSessionRef = INX_Development_Session
              DcmDspRoutineSecurityLevelRef = Level_17
          RoutineInfo_SwcError_UartSeverityLevelSimulation_Start  # Diagnostics Data Import
            DcmDspStartRoutineIn  # Diagnostics Data Import
              In_errorSeverityLevel (DcmDspStartRoutineInSignal): DcmDspRoutineSignalLength=8, DcmDspRoutineSignalType=UINT8, DcmDspRoutineSignalPos=0  # Diagnostics Data Import
            DcmDspRoutineAuthorization: DcmDspRoutineSessionRef=INX_End_Of_Line_Session, DcmDspRoutineSessionRef=INX_Development_Session, DcmDspRoutineSecurityLevelRef=Level_17  # Diagnostics Data Import
          RoutineInfo_SwcError_ClearErrorCounters_Start  # Diagnostics Data Import
            DcmDspRoutineAuthorization: DcmDspRoutineSessionRef=INX_End_Of_Line_Session, DcmDspRoutineSessionRef=INX_Development_Session, DcmDspRoutineSecurityLevelRef=Level_17  # Diagnostics Data Import
          RoutineInfo_SwcError_ClearErrorTrace_Start  # Diagnostics Data Import
            DcmDspRoutineAuthorization:  # Diagnostics Data Import
              DcmDspRoutineSessionRef = DcmDspSession/Programming
              DcmDspRoutineSessionRef = DcmDspSession/Extended
              DcmDspRoutineSessionRef = INX_End_Of_Line_Session
              DcmDspRoutineSessionRef = INX_Development_Session
              DcmDspRoutineSecurityLevelRef = Level_17
          RoutineInfo_SwcError_GetErrorStatus_Start  # Diagnostics Data Import
            DcmDspStartRoutineOut  # Diagnostics Data Import
              Out_errorEntryLog (DcmDspStartRoutineOutSignal): DcmDspRoutineSignalLength=8192, DcmDspRoutineSignalType=VARIABLE_LENGTH, DcmDspRoutineSignalEndianness=opaque, DcmDspRoutineSignalPos=16  # Diagnostics Data Import
              Out_nrOfErrorEntries (DcmDspStartRoutineOutSignal): DcmDspRoutineSignalLength=16, DcmDspRoutineSignalType=UINT16, DcmDspRoutineSignalEndianness=BIG_ENDIAN, DcmDspRoutineSignalPos=0  # Diagnostics Data Import
            DcmDspStartRoutineIn  # Diagnostics Data Import
              4 x DcmDspStartRoutineInSignal:
                In_filter_Filters_STRUCTURE: DcmDspRoutineSignalLength=8, DcmDspRoutineSignalType=UINT8, DcmDspRoutineSignalPos=32  # Diagnostics Data Import
                In_status: DcmDspRoutineSignalLength=8, DcmDspRoutineSignalType=UINT8, DcmDspRoutineSignalPos=24  # Diagnostics Data Import
                In_errorId: DcmDspRoutineSignalLength=8, DcmDspRoutineSignalType=UINT8, DcmDspRoutineSignalPos=16  # Diagnostics Data Import
                In_moduleId: DcmDspRoutineSignalLength=16, DcmDspRoutineSignalType=UINT16, DcmDspRoutineSignalEndianness=BIG_ENDIAN, DcmDspRoutineSignalPos=0  # Diagnostics Data Import
            DcmDspRoutineAuthorization: DcmDspRoutineSessionRef=INX_End_Of_Line_Session, DcmDspRoutineSessionRef=INX_Development_Session, DcmDspRoutineSecurityLevelRef=Level_17  # Diagnostics Data Import
          RoutineInfo_SwcDisplayControl_TestPattern_Start  # Diagnostics Data Import
            DcmDspStartRoutineIn  # Diagnostics Data Import
              In_testPattern (DcmDspStartRoutineInSignal): DcmDspRoutineSignalLength=8, DcmDspRoutineSignalType=UINT8, DcmDspRoutineSignalPos=0  # Diagnostics Data Import
            DcmDspRoutineAuthorization: DcmDspRoutineSessionRef=INX_End_Of_Line_Session, DcmDspRoutineSessionRef=INX_Development_Session, DcmDspRoutineSecurityLevelRef=Level_17  # Diagnostics Data Import
          RoutineInfo_SwcDimming_SetSliderXtErrorDefault_Start  # Diagnostics Data Import
            DcmDspStartRoutineIn  # Diagnostics Data Import
              In_value (DcmDspStartRoutineInSignal): DcmDspRoutineSignalLength=8, DcmDspRoutineSignalType=UINT8, DcmDspRoutineSignalPos=0  # Diagnostics Data Import
            DcmDspRoutineAuthorization:  # Diagnostics Data Import
              DcmDspRoutineSessionRef = DcmDspSession/Programming
              DcmDspRoutineSessionRef = DcmDspSession/Extended
              DcmDspRoutineSessionRef = INX_End_Of_Line_Session
              DcmDspRoutineSessionRef = INX_Development_Session
              DcmDspRoutineSecurityLevelRef = Level_17
          RoutineInfo_SwcDimming_SetSliderXsErrorDefault_Start  # Diagnostics Data Import
            DcmDspStartRoutineIn  # Diagnostics Data Import
              In_value (DcmDspStartRoutineInSignal): DcmDspRoutineSignalLength=8, DcmDspRoutineSignalType=UINT8, DcmDspRoutineSignalPos=0  # Diagnostics Data Import
            DcmDspRoutineAuthorization:  # Diagnostics Data Import
              DcmDspRoutineSessionRef = DcmDspSession/Programming
              DcmDspRoutineSessionRef = DcmDspSession/Extended
              DcmDspRoutineSessionRef = INX_End_Of_Line_Session
              DcmDspRoutineSessionRef = INX_Development_Session
              DcmDspRoutineSecurityLevelRef = Level_17
          RoutineInfo_SwcDimming_SetDisplayPwmMin_Start  # Diagnostics Data Import
            DcmDspStartRoutineIn  # Diagnostics Data Import
              In_value (DcmDspStartRoutineInSignal): DcmDspRoutineSignalLength=8, DcmDspRoutineSignalType=UINT8, DcmDspRoutineSignalPos=0  # Diagnostics Data Import
            DcmDspRoutineAuthorization:  # Diagnostics Data Import
              DcmDspRoutineSessionRef = DcmDspSession/Programming
              DcmDspRoutineSessionRef = DcmDspSession/Extended
              DcmDspRoutineSessionRef = INX_End_Of_Line_Session
              DcmDspRoutineSessionRef = INX_Development_Session
              DcmDspRoutineSecurityLevelRef = Level_17
          RoutineInfo_SwcDimming_SetSliderLut_Start  # Diagnostics Data Import
            DcmDspStartRoutineIn  # Diagnostics Data Import
              In_data (DcmDspStartRoutineInSignal): DcmDspRoutineSignalLength=128, DcmDspRoutineSignalType=VARIABLE_LENGTH, DcmDspRoutineSignalEndianness=opaque, DcmDspRoutineSignalPos=0  # Diagnostics Data Import
            DcmDspRoutineAuthorization:  # Diagnostics Data Import
              DcmDspRoutineSessionRef = DcmDspSession/Programming
              DcmDspRoutineSessionRef = DcmDspSession/Extended
              DcmDspRoutineSessionRef = INX_End_Of_Line_Session
              DcmDspRoutineSessionRef = INX_Development_Session
              DcmDspRoutineSecurityLevelRef = Level_17
          RoutineInfo_SwcDimming_SetDisplayLutNight_Start  # Diagnostics Data Import
            DcmDspStartRoutineIn  # Diagnostics Data Import
              In_data (DcmDspStartRoutineInSignal): DcmDspRoutineSignalLength=256, DcmDspRoutineSignalType=VARIABLE_LENGTH, DcmDspRoutineSignalEndianness=opaque, DcmDspRoutineSignalPos=0  # Diagnostics Data Import
            DcmDspRoutineAuthorization:  # Diagnostics Data Import
              DcmDspRoutineSessionRef = DcmDspSession/Programming
              DcmDspRoutineSessionRef = DcmDspSession/Extended
              DcmDspRoutineSessionRef = INX_End_Of_Line_Session
              DcmDspRoutineSessionRef = INX_Development_Session
              DcmDspRoutineSecurityLevelRef = Level_17
          RoutineInfo_SwcDimming_SetDisplayLutDay_Start  # Diagnostics Data Import
            DcmDspStartRoutineIn  # Diagnostics Data Import
              In_data (DcmDspStartRoutineInSignal): DcmDspRoutineSignalLength=256, DcmDspRoutineSignalType=VARIABLE_LENGTH, DcmDspRoutineSignalEndianness=opaque, DcmDspRoutineSignalPos=0  # Diagnostics Data Import
            DcmDspRoutineAuthorization:  # Diagnostics Data Import
              DcmDspRoutineSessionRef = DcmDspSession/Programming
              DcmDspRoutineSessionRef = DcmDspSession/Extended
              DcmDspRoutineSessionRef = INX_End_Of_Line_Session
              DcmDspRoutineSessionRef = INX_Development_Session
              DcmDspRoutineSecurityLevelRef = Level_17
          RoutineInfo_SwcDimming_SetSliderPwmOutput_Start  # Diagnostics Data Import
            DcmDspStartRoutineIn  # Diagnostics Data Import
              In_value (DcmDspStartRoutineInSignal): DcmDspRoutineSignalLength=16, DcmDspRoutineSignalType=UINT16, DcmDspRoutineSignalEndianness=BIG_ENDIAN, DcmDspRoutineSignalPos=0  # Diagnostics Data Import
            DcmDspRoutineAuthorization:  # Diagnostics Data Import
              DcmDspRoutineSessionRef = DcmDspSession/Programming
              DcmDspRoutineSessionRef = DcmDspSession/Extended
              DcmDspRoutineSessionRef = INX_End_Of_Line_Session
              DcmDspRoutineSessionRef = INX_Development_Session
              DcmDspRoutineSecurityLevelRef = Level_17
          RoutineInfo_SwcDimming_SetDisplayPwmOutput_Start  # Diagnostics Data Import
            DcmDspStartRoutineIn  # Diagnostics Data Import
              In_value (DcmDspStartRoutineInSignal): DcmDspRoutineSignalLength=16, DcmDspRoutineSignalType=UINT16, DcmDspRoutineSignalEndianness=BIG_ENDIAN, DcmDspRoutineSignalPos=0  # Diagnostics Data Import
            DcmDspRoutineAuthorization:  # Diagnostics Data Import
              DcmDspRoutineSessionRef = DcmDspSession/Programming
              DcmDspRoutineSessionRef = DcmDspSession/Extended
              DcmDspRoutineSessionRef = INX_End_Of_Line_Session
              DcmDspRoutineSessionRef = INX_Development_Session
              DcmDspRoutineSecurityLevelRef = Level_17
          RoutineInfo_CddHWRNXPRT1171_SetSwUpdateReq_Start  # Diagnostics Data Import
            DcmDspRoutineAuthorization: DcmDspRoutineSessionRef=INX_End_Of_Line_Session, DcmDspRoutineSessionRef=INX_Development_Session, DcmDspRoutineSecurityLevelRef=Level_17  # Diagnostics Data Import
          RoutineInfo_CddHWRNXPRT1171_ConfigPropRequest_Start  # Diagnostics Data Import
            DcmDspStartRoutineOut  # Diagnostics Data Import
              Out_data (DcmDspStartRoutineOutSignal): DcmDspRoutineSignalLength=2040, DcmDspRoutineSignalType=VARIABLE_LENGTH, DcmDspRoutineSignalEndianness=opaque, DcmDspRoutineSignalPos=8  # Diagnostics Data Import
              Out_nrOfBytes (DcmDspStartRoutineOutSignal): DcmDspRoutineSignalLength=8, DcmDspRoutineSignalType=UINT8, DcmDspRoutineSignalPos=0  # Diagnostics Data Import
            DcmDspStartRoutineIn  # Diagnostics Data Import
              In_data (DcmDspStartRoutineInSignal): DcmDspRoutineSignalLength=128, DcmDspRoutineSignalType=VARIABLE_LENGTH, DcmDspRoutineSignalEndianness=opaque, DcmDspRoutineSignalPos=8  # Diagnostics Data Import
              In_nrOfBytes (DcmDspStartRoutineInSignal): DcmDspRoutineSignalLength=8, DcmDspRoutineSignalType=UINT8, DcmDspRoutineSignalPos=0  # Diagnostics Data Import
            DcmDspRoutineAuthorization: DcmDspRoutineSessionRef=INX_End_Of_Line_Session, DcmDspRoutineSessionRef=INX_Development_Session, DcmDspRoutineSecurityLevelRef=Level_17  # Diagnostics Data Import
          RoutineInfo_CddHWRNXPRT1171_RoutineRequest_Start  # Diagnostics Data Import
            DcmDspStartRoutineOut  # Diagnostics Data Import
              Out_data (DcmDspStartRoutineOutSignal): DcmDspRoutineSignalLength=2040, DcmDspRoutineSignalType=VARIABLE_LENGTH, DcmDspRoutineSignalEndianness=opaque, DcmDspRoutineSignalPos=8  # Diagnostics Data Import
              Out_nrOfBytes (DcmDspStartRoutineOutSignal): DcmDspRoutineSignalLength=8, DcmDspRoutineSignalType=UINT8, DcmDspRoutineSignalPos=0  # Diagnostics Data Import
            DcmDspStartRoutineIn  # Diagnostics Data Import
              In_data (DcmDspStartRoutineInSignal): DcmDspRoutineSignalLength=128, DcmDspRoutineSignalType=VARIABLE_LENGTH, DcmDspRoutineSignalEndianness=opaque, DcmDspRoutineSignalPos=8  # Diagnostics Data Import
              In_nrOfBytes (DcmDspStartRoutineInSignal): DcmDspRoutineSignalLength=8, DcmDspRoutineSignalType=UINT8, DcmDspRoutineSignalPos=0  # Diagnostics Data Import
            DcmDspRoutineAuthorization: DcmDspRoutineSessionRef=INX_End_Of_Line_Session, DcmDspRoutineSessionRef=INX_Development_Session, DcmDspRoutineSecurityLevelRef=Level_17  # Diagnostics Data Import
          RoutineInfo_CddSliderBackLightTiSN1903001_BacklightLedCurrentSimulation_Start  # Diagnostics Data Import
            DcmDspStartRoutineIn  # Diagnostics Data Import
              In_ledCurrents (DcmDspStartRoutineInSignal): DcmDspRoutineSignalLength=64, DcmDspRoutineSignalType=VARIABLE_LENGTH, DcmDspRoutineSignalEndianness=opaque, DcmDspRoutineSignalPos=8  # Diagnostics Data Import
              In_ledStringMask (DcmDspStartRoutineInSignal): DcmDspRoutineSignalLength=8, DcmDspRoutineSignalType=UINT8, DcmDspRoutineSignalPos=0  # Diagnostics Data Import
            DcmDspRoutineAuthorization: DcmDspRoutineSessionRef=INX_End_Of_Line_Session, DcmDspRoutineSessionRef=INX_Development_Session, DcmDspRoutineSecurityLevelRef=Level_17  # Diagnostics Data Import
          RoutineInfo_CddSliderBackLightTiSN1903001_BacklightPercentageSimulation_Start  # Diagnostics Data Import
            DcmDspStartRoutineIn  # Diagnostics Data Import
              In_percentage (DcmDspStartRoutineInSignal): DcmDspRoutineSignalLength=16, DcmDspRoutineSignalType=UINT16, DcmDspRoutineSignalEndianness=BIG_ENDIAN, DcmDspRoutineSignalPos=0  # Diagnostics Data Import
            DcmDspRoutineAuthorization:  # Diagnostics Data Import
              DcmDspRoutineSessionRef = DcmDspSession/Programming
              DcmDspRoutineSessionRef = DcmDspSession/Extended
              DcmDspRoutineSessionRef = INX_End_Of_Line_Session
              DcmDspRoutineSessionRef = INX_Development_Session
              DcmDspRoutineSecurityLevelRef = Level_17
          RoutineInfo_CddSliderBackLightTiSN1903001_Write_Start  # Diagnostics Data Import
            DcmDspStartRoutineIn  # Diagnostics Data Import
              In_data (DcmDspStartRoutineInSignal): DcmDspRoutineSignalLength=16, DcmDspRoutineSignalType=UINT16, DcmDspRoutineSignalEndianness=BIG_ENDIAN, DcmDspRoutineSignalPos=16  # Diagnostics Data Import
              In_address (DcmDspStartRoutineInSignal): DcmDspRoutineSignalLength=16, DcmDspRoutineSignalType=UINT16, DcmDspRoutineSignalEndianness=BIG_ENDIAN, DcmDspRoutineSignalPos=0  # Diagnostics Data Import
            DcmDspRoutineAuthorization:  # Diagnostics Data Import
              DcmDspRoutineSessionRef = DcmDspSession/Programming
              DcmDspRoutineSessionRef = DcmDspSession/Extended
              DcmDspRoutineSessionRef = INX_End_Of_Line_Session
              DcmDspRoutineSessionRef = INX_Development_Session
              DcmDspRoutineSecurityLevelRef = Level_17
          RoutineInfo_CddSliderBackLightTiSN1903001_Read_Start  # Diagnostics Data Import
            DcmDspStartRoutineOut  # Diagnostics Data Import
              Out_data (DcmDspStartRoutineOutSignal): DcmDspRoutineSignalLength=2040, DcmDspRoutineSignalType=VARIABLE_LENGTH, DcmDspRoutineSignalEndianness=opaque, DcmDspRoutineSignalPos=0  # Diagnostics Data Import
            DcmDspStartRoutineIn  # Diagnostics Data Import
              In_address (DcmDspStartRoutineInSignal): DcmDspRoutineSignalLength=16, DcmDspRoutineSignalType=UINT16, DcmDspRoutineSignalEndianness=BIG_ENDIAN, DcmDspRoutineSignalPos=0  # Diagnostics Data Import
            DcmDspRoutineAuthorization:  # Diagnostics Data Import
              DcmDspRoutineSessionRef = DcmDspSession/Programming
              DcmDspRoutineSessionRef = DcmDspSession/Extended
              DcmDspRoutineSessionRef = INX_End_Of_Line_Session
              DcmDspRoutineSessionRef = INX_Development_Session
              DcmDspRoutineSecurityLevelRef = Level_17
          RoutineInfo_CddBist_BistMode_Start  # Diagnostics Data Import
            DcmDspStartRoutineIn  # Diagnostics Data Import
              In_bistMode (DcmDspStartRoutineInSignal): DcmDspRoutineSignalLength=8, DcmDspRoutineSignalType=UINT8, DcmDspRoutineSignalPos=0  # Diagnostics Data Import
            DcmDspRoutineAuthorization: DcmDspRoutineSessionRef=INX_End_Of_Line_Session, DcmDspRoutineSessionRef=INX_Development_Session, DcmDspRoutineSecurityLevelRef=Level_17  # Diagnostics Data Import
          RoutineInfo_CddWatchdogInterface_SimulateWatchdogPeriod_Start  # Diagnostics Data Import
            DcmDspRoutineStopIn  # Diagnostics Data Import
              In_watchdog (DcmDspRoutineStopInSignal): DcmDspRoutineSignalLength=8, DcmDspRoutineSignalType=UINT8, DcmDspRoutineSignalPos=0  # Diagnostics Data Import
            DcmDspStartRoutineIn  # Diagnostics Data Import
              In_timeoutPeriod (DcmDspStartRoutineInSignal): DcmDspRoutineSignalLength=16, DcmDspRoutineSignalType=UINT16, DcmDspRoutineSignalEndianness=BIG_ENDIAN, DcmDspRoutineSignalPos=8  # Diagnostics Data Import
              In_watchdog (DcmDspStartRoutineInSignal): DcmDspRoutineSignalLength=8, DcmDspRoutineSignalType=UINT8, DcmDspRoutineSignalPos=0  # Diagnostics Data Import
            DcmDspRoutineAuthorization: DcmDspRoutineSessionRef=INX_End_Of_Line_Session, DcmDspRoutineSessionRef=INX_Development_Session, DcmDspRoutineSecurityLevelRef=Level_17  # Diagnostics Data Import
          RoutineInfo_CddWatchdogInterface_WatchdogTriggering_Start  # Diagnostics Data Import
            DcmDspRoutineStopIn  # Diagnostics Data Import
              In_watchdog (DcmDspRoutineStopInSignal): DcmDspRoutineSignalLength=8, DcmDspRoutineSignalType=UINT8, DcmDspRoutineSignalPos=0  # Diagnostics Data Import
            DcmDspStartRoutineIn  # Diagnostics Data Import
              In_watchdog (DcmDspStartRoutineInSignal): DcmDspRoutineSignalLength=8, DcmDspRoutineSignalType=UINT8, DcmDspRoutineSignalPos=0  # Diagnostics Data Import
            DcmDspRoutineAuthorization: DcmDspRoutineSessionRef=INX_End_Of_Line_Session, DcmDspRoutineSessionRef=INX_Development_Session, DcmDspRoutineSecurityLevelRef=Level_17  # Diagnostics Data Import
          RoutineInfo_CddHeadUnitInterface_SimulateResetTrigger_Start  # Diagnostics Data Import
            DcmDspRoutineAuthorization: DcmDspRoutineSessionRef=INX_End_Of_Line_Session, DcmDspRoutineSessionRef=INX_Development_Session, DcmDspRoutineSecurityLevelRef=Level_17  # Diagnostics Data Import
          RoutineInfo_CddButton_ButtonStatusSimulation_Start  # Diagnostics Data Import
            DcmDspStartRoutineIn  # Diagnostics Data Import
              In_buttonStatus (DcmDspStartRoutineInSignal): DcmDspRoutineSignalLength=8, DcmDspRoutineSignalType=UINT8, DcmDspRoutineSignalPos=0  # Diagnostics Data Import
            DcmDspRoutineAuthorization:  # Diagnostics Data Import
              DcmDspRoutineSessionRef = DcmDspSession/Programming
              DcmDspRoutineSessionRef = DcmDspSession/Extended
              DcmDspRoutineSessionRef = INX_End_Of_Line_Session
              DcmDspRoutineSessionRef = INX_Development_Session
              DcmDspRoutineSecurityLevelRef = Level_17
          RoutineInfo_CddPerCtrl_WriteI2cDevice_Start  # Diagnostics Data Import
            DcmDspRoutineStopIn  # Diagnostics Data Import
              In_deviceId (DcmDspRoutineStopInSignal): DcmDspRoutineSignalLength=8, DcmDspRoutineSignalType=UINT8, DcmDspRoutineSignalPos=0  # Diagnostics Data Import
            DcmDspStartRoutineIn  # Diagnostics Data Import
              4 x DcmDspStartRoutineInSignal:
                In_data: DcmDspRoutineSignalLength=2040, DcmDspRoutineSignalType=VARIABLE_LENGTH, DcmDspRoutineSignalEndianness=opaque, DcmDspRoutineSignalPos=32  # Diagnostics Data Import
                In_nrOfBytes: DcmDspRoutineSignalLength=8, DcmDspRoutineSignalType=UINT8, DcmDspRoutineSignalPos=24  # Diagnostics Data Import
                In_startAddress: DcmDspRoutineSignalLength=16, DcmDspRoutineSignalType=UINT16, DcmDspRoutineSignalEndianness=BIG_ENDIAN, DcmDspRoutineSignalPos=8  # Diagnostics Data Import
                In_deviceId: DcmDspRoutineSignalLength=8, DcmDspRoutineSignalType=UINT8, DcmDspRoutineSignalPos=0  # Diagnostics Data Import
            DcmDspRoutineAuthorization:  # Diagnostics Data Import
              DcmDspRoutineSessionRef = DcmDspSession/Programming
              DcmDspRoutineSessionRef = DcmDspSession/Extended
              DcmDspRoutineSessionRef = INX_End_Of_Line_Session
              DcmDspRoutineSessionRef = INX_Development_Session
              DcmDspRoutineSecurityLevelRef = Level_17
          RoutineInfo_CddPerCtrl_ReadI2cDevice_Start  # Diagnostics Data Import
            DcmDspRoutineStopIn  # Diagnostics Data Import
              In_deviceId (DcmDspRoutineStopInSignal): DcmDspRoutineSignalLength=8, DcmDspRoutineSignalType=UINT8, DcmDspRoutineSignalPos=0  # Diagnostics Data Import
            DcmDspStartRoutineOut  # Diagnostics Data Import
              Out_data (DcmDspStartRoutineOutSignal): DcmDspRoutineSignalLength=2040, DcmDspRoutineSignalType=VARIABLE_LENGTH, DcmDspRoutineSignalEndianness=opaque, DcmDspRoutineSignalPos=8  # Diagnostics Data Import
              Out_nrOfBytes (DcmDspStartRoutineOutSignal): DcmDspRoutineSignalLength=8, DcmDspRoutineSignalType=UINT8, DcmDspRoutineSignalPos=0  # Diagnostics Data Import
            DcmDspStartRoutineIn  # Diagnostics Data Import
              3 x DcmDspStartRoutineInSignal:
                In_nrOfBytes: DcmDspRoutineSignalLength=8, DcmDspRoutineSignalType=UINT8, DcmDspRoutineSignalPos=24  # Diagnostics Data Import
                In_startAddress: DcmDspRoutineSignalLength=16, DcmDspRoutineSignalType=UINT16, DcmDspRoutineSignalEndianness=BIG_ENDIAN, DcmDspRoutineSignalPos=8  # Diagnostics Data Import
                In_deviceId: DcmDspRoutineSignalLength=8, DcmDspRoutineSignalType=UINT8, DcmDspRoutineSignalPos=0  # Diagnostics Data Import
            DcmDspRoutineAuthorization:  # Diagnostics Data Import
              DcmDspRoutineSessionRef = DcmDspSession/Programming
              DcmDspRoutineSessionRef = DcmDspSession/Extended
              DcmDspRoutineSessionRef = INX_End_Of_Line_Session
              DcmDspRoutineSessionRef = INX_Development_Session
              DcmDspRoutineSecurityLevelRef = Level_17
          RoutineInfo_CddPerCtrl_SpiTransfer_Start  # Diagnostics Data Import
            DcmDspRoutineStopIn  # Diagnostics Data Import
              In_deviceId (DcmDspRoutineStopInSignal): DcmDspRoutineSignalLength=8, DcmDspRoutineSignalType=UINT8, DcmDspRoutineSignalPos=0  # Diagnostics Data Import
            DcmDspStartRoutineOut  # Diagnostics Data Import
              Out_data (DcmDspStartRoutineOutSignal): DcmDspRoutineSignalLength=2040, DcmDspRoutineSignalType=VARIABLE_LENGTH, DcmDspRoutineSignalEndianness=opaque, DcmDspRoutineSignalPos=8  # Diagnostics Data Import
              Out_nrOfBytes (DcmDspStartRoutineOutSignal): DcmDspRoutineSignalLength=8, DcmDspRoutineSignalType=UINT8, DcmDspRoutineSignalPos=0  # Diagnostics Data Import
            DcmDspStartRoutineIn  # Diagnostics Data Import
              3 x DcmDspStartRoutineInSignal:
                In_data: DcmDspRoutineSignalLength=2040, DcmDspRoutineSignalType=VARIABLE_LENGTH, DcmDspRoutineSignalEndianness=opaque, DcmDspRoutineSignalPos=16  # Diagnostics Data Import
                In_nrOfBytes: DcmDspRoutineSignalLength=8, DcmDspRoutineSignalType=UINT8, DcmDspRoutineSignalPos=8  # Diagnostics Data Import
                In_deviceId: DcmDspRoutineSignalLength=8, DcmDspRoutineSignalType=UINT8, DcmDspRoutineSignalPos=0  # Diagnostics Data Import
            DcmDspRoutineAuthorization:  # Diagnostics Data Import
              DcmDspRoutineSessionRef = DcmDspSession/Programming
              DcmDspRoutineSessionRef = DcmDspSession/Extended
              DcmDspRoutineSessionRef = INX_End_Of_Line_Session
              DcmDspRoutineSessionRef = INX_Development_Session
              DcmDspRoutineSecurityLevelRef = Level_17
          RoutineInfo_CddPerCtrl_TrgWdgReset_Start  # Diagnostics Data Import
            DcmDspRoutineAuthorization: DcmDspRoutineSessionRef=INX_End_Of_Line_Session, DcmDspRoutineSessionRef=INX_Development_Session, DcmDspRoutineSecurityLevelRef=Level_17  # Diagnostics Data Import
          RoutineInfo_CddPerCtrl_DioControl_Start  # Diagnostics Data Import
            DcmDspRoutineStopIn  # Diagnostics Data Import
              In_channelId (DcmDspRoutineStopInSignal): DcmDspRoutineSignalLength=8, DcmDspRoutineSignalType=UINT8, DcmDspRoutineSignalPos=0  # Diagnostics Data Import
            DcmDspStartRoutineOut  # Diagnostics Data Import
              Out_value (DcmDspStartRoutineOutSignal): DcmDspRoutineSignalLength=8, DcmDspRoutineSignalType=UINT8, DcmDspRoutineSignalPos=0  # Diagnostics Data Import
            DcmDspStartRoutineIn  # Diagnostics Data Import
              3 x DcmDspStartRoutineInSignal, all with DcmDspRoutineSignalLength=8, DcmDspRoutineSignalType=UINT8:
                In_value: DcmDspRoutineSignalPos=16  # Diagnostics Data Import
                In_channelId: DcmDspRoutineSignalPos=8  # Diagnostics Data Import
                In_actionId: DcmDspRoutineSignalPos=0  # Diagnostics Data Import
            DcmDspRoutineAuthorization: DcmDspRoutineSessionRef=INX_End_Of_Line_Session, DcmDspRoutineSessionRef=INX_Development_Session, DcmDspRoutineSecurityLevelRef=Level_17  # Diagnostics Data Import
          RoutineInfo_CddPerCtrl_GetAdcRawValues_Start  # Diagnostics Data Import
            DcmDspStartRoutineOut  # Diagnostics Data Import
              Out_adcRawValue (DcmDspStartRoutineOutSignal): DcmDspRoutineSignalLength=2040, DcmDspRoutineSignalType=VARIABLE_LENGTH, DcmDspRoutineSignalEndianness=opaque, DcmDspRoutineSignalPos=16  # Diagnostics Data Import
              Out_nrOfChannels (DcmDspStartRoutineOutSignal): DcmDspRoutineSignalLength=16, DcmDspRoutineSignalType=UINT16, DcmDspRoutineSignalEndianness=BIG_ENDIAN, DcmDspRoutineSignalPos=0  # Diagnostics Data Import
            DcmDspRoutineAuthorization: DcmDspRoutineSessionRef=INX_Development_Session, DcmDspRoutineSecurityLevelRef=Level_17  # Diagnostics Data Import
          RoutineInfo_CddVoltageMonitor_VoltControl_Start  # Diagnostics Data Import
            DcmDspRoutineRequestResOut  # Diagnostics Data Import
              Out_pVoltage (DcmDspRoutineRequestResOutSignal): DcmDspRoutineSignalLength=8, DcmDspRoutineSignalType=UINT8, DcmDspRoutineSignalPos=0  # Diagnostics Data Import
            DcmDspRoutineRequestResIn  # Diagnostics Data Import
              In_voltChannel (DcmDspRoutineRequestResInSignal): DcmDspRoutineSignalLength=8, DcmDspRoutineSignalType=UINT8, DcmDspRoutineSignalPos=0  # Diagnostics Data Import
            DcmDspRoutineStopIn  # Diagnostics Data Import
              In_voltChannel (DcmDspRoutineStopInSignal): DcmDspRoutineSignalLength=8, DcmDspRoutineSignalType=UINT8, DcmDspRoutineSignalPos=0  # Diagnostics Data Import
            DcmDspStartRoutineIn  # Diagnostics Data Import
              In_voltage (DcmDspStartRoutineInSignal): DcmDspRoutineSignalLength=8, DcmDspRoutineSignalType=UINT8, DcmDspRoutineSignalPos=8  # Diagnostics Data Import
              In_voltChannel (DcmDspStartRoutineInSignal): DcmDspRoutineSignalLength=8, DcmDspRoutineSignalType=UINT8, DcmDspRoutineSignalPos=0  # Diagnostics Data Import
            DcmDspRoutineAuthorization: DcmDspRoutineSessionRef=INX_End_Of_Line_Session, DcmDspRoutineSessionRef=INX_Development_Session, DcmDspRoutineSecurityLevelRef=Level_17  # Diagnostics Data Import
          RoutineInfo_CddTemperatureMonitor_TemperatureControl_Start  # Diagnostics Data Import
            DcmDspRoutineRequestResOut  # Diagnostics Data Import
              Out_temperature (DcmDspRoutineRequestResOutSignal): DcmDspRoutineSignalLength=16, DcmDspRoutineSignalType=SINT16, DcmDspRoutineSignalEndianness=BIG_ENDIAN, DcmDspRoutineSignalPos=0  # Diagnostics Data Import
            DcmDspRoutineRequestResIn  # Diagnostics Data Import
              In_temperatureChannel (DcmDspRoutineRequestResInSignal): DcmDspRoutineSignalLength=8, DcmDspRoutineSignalType=UINT8, DcmDspRoutineSignalPos=0  # Diagnostics Data Import
            DcmDspRoutineStopIn  # Diagnostics Data Import
              In_temperatureChannel (DcmDspRoutineStopInSignal): DcmDspRoutineSignalLength=8, DcmDspRoutineSignalType=UINT8, DcmDspRoutineSignalPos=0  # Diagnostics Data Import
            DcmDspStartRoutineIn  # Diagnostics Data Import
              In_temperature (DcmDspStartRoutineInSignal): DcmDspRoutineSignalLength=16, DcmDspRoutineSignalType=UINT16, DcmDspRoutineSignalEndianness=BIG_ENDIAN, DcmDspRoutineSignalPos=8  # Diagnostics Data Import
              In_temperatureChannel (DcmDspStartRoutineInSignal): DcmDspRoutineSignalLength=8, DcmDspRoutineSignalType=UINT8, DcmDspRoutineSignalPos=0  # Diagnostics Data Import
            DcmDspRoutineAuthorization: DcmDspRoutineSessionRef=INX_End_Of_Line_Session, DcmDspRoutineSessionRef=INX_Development_Session, DcmDspRoutineSecurityLevelRef=Level_17  # Diagnostics Data Import
          RoutineInfo_CddPanelHimaxHx8249B_GammaVoltageSetting_Start  # Diagnostics Data Import
            DcmDspStartRoutineIn  # Diagnostics Data Import
              3 x DcmDspStartRoutineInSignal, all with DcmDspRoutineSignalLength=8, DcmDspRoutineSignalType=UINT8:
                In_vgmplsVgmnls: DcmDspRoutineSignalPos=16  # Diagnostics Data Import
                In_vgmnhs: DcmDspRoutineSignalPos=8  # Diagnostics Data Import
                In_vgmphs: DcmDspRoutineSignalPos=0  # Diagnostics Data Import
            DcmDspRoutineAuthorization:  # Diagnostics Data Import
              DcmDspRoutineSessionRef = DcmDspSession/Extended
              DcmDspRoutineSessionRef = INX_End_Of_Line_Session
              DcmDspRoutineSessionRef = INX_Development_Session
              DcmDspRoutineSecurityLevelRef = Level_17
          RoutineInfo_CddPanelHimaxHx8249B_VcomSimulation_Start  # Diagnostics Data Import
            DcmDspStartRoutineIn  # Diagnostics Data Import
              4 x DcmDspStartRoutineInSignal, all with DcmDspRoutineSignalLength=8, DcmDspRoutineSignalType=UINT8:
                In_tsVcomEn: DcmDspRoutineSignalPos=24  # Diagnostics Data Import
                In_vcomsLt: DcmDspRoutineSignalPos=16  # Diagnostics Data Import
                In_vcomsHt: DcmDspRoutineSignalPos=8  # Diagnostics Data Import
                In_vcoms: DcmDspRoutineSignalPos=0  # Diagnostics Data Import
            DcmDspRoutineAuthorization: DcmDspRoutineSessionRef=INX_End_Of_Line_Session, DcmDspRoutineSessionRef=INX_Development_Session, DcmDspRoutineSecurityLevelRef=Level_17  # Diagnostics Data Import
          RoutineInfo_CddPanelHimaxHx8249B_GammaSimulation_Start  # Diagnostics Data Import
            DcmDspStartRoutineIn  # Diagnostics Data Import
              In_gammaLut (DcmDspStartRoutineInSignal): DcmDspRoutineSignalLength=720, DcmDspRoutineSignalType=VARIABLE_LENGTH, DcmDspRoutineSignalEndianness=opaque, DcmDspRoutineSignalPos=8  # Diagnostics Data Import
              In_color (DcmDspStartRoutineInSignal): DcmDspRoutineSignalLength=8, DcmDspRoutineSignalType=UINT8, DcmDspRoutineSignalPos=0  # Diagnostics Data Import
            DcmDspRoutineAuthorization: DcmDspRoutineSessionRef=INX_End_Of_Line_Session, DcmDspRoutineSessionRef=INX_Development_Session, DcmDspRoutineSecurityLevelRef=Level_17  # Diagnostics Data Import
          RoutineInfo_CddPanelHimaxHx8249B_Write_Start  # Diagnostics Data Import
            DcmDspStartRoutineIn  # Diagnostics Data Import
              4 x DcmDspStartRoutineInSignal:
                In_data: DcmDspRoutineSignalLength=2040, DcmDspRoutineSignalType=VARIABLE_LENGTH, DcmDspRoutineSignalEndianness=opaque, DcmDspRoutineSignalPos=24  # Diagnostics Data Import
                In_dataLength: DcmDspRoutineSignalLength=8, DcmDspRoutineSignalType=UINT8, DcmDspRoutineSignalPos=16  # Diagnostics Data Import
                In_address: DcmDspRoutineSignalLength=8, DcmDspRoutineSignalType=UINT8, DcmDspRoutineSignalPos=8  # Diagnostics Data Import
                In_panelPage: DcmDspRoutineSignalLength=8, DcmDspRoutineSignalType=UINT8, DcmDspRoutineSignalPos=0  # Diagnostics Data Import
            DcmDspRoutineAuthorization: DcmDspRoutineSessionRef=INX_End_Of_Line_Session, DcmDspRoutineSessionRef=INX_Development_Session, DcmDspRoutineSecurityLevelRef=Level_17  # Diagnostics Data Import
          RoutineInfo_CddPanelHimaxHx8249B_Read_Start  # Diagnostics Data Import
            DcmDspStartRoutineOut  # Diagnostics Data Import
              Out_data (DcmDspStartRoutineOutSignal): DcmDspRoutineSignalLength=2040, DcmDspRoutineSignalType=VARIABLE_LENGTH, DcmDspRoutineSignalEndianness=opaque, DcmDspRoutineSignalPos=0  # Diagnostics Data Import
            DcmDspStartRoutineIn  # Diagnostics Data Import
              3 x DcmDspStartRoutineInSignal, all with DcmDspRoutineSignalLength=8, DcmDspRoutineSignalType=UINT8:
                In_dataLength: DcmDspRoutineSignalPos=16  # Diagnostics Data Import
                In_address: DcmDspRoutineSignalPos=8  # Diagnostics Data Import
                In_panelPage: DcmDspRoutineSignalPos=0  # Diagnostics Data Import
            DcmDspRoutineAuthorization: DcmDspRoutineSessionRef=INX_End_Of_Line_Session, DcmDspRoutineSessionRef=INX_Development_Session, DcmDspRoutineSecurityLevelRef=Level_17  # Diagnostics Data Import
          RoutineInfo_CddBoosterDriver_BacklightPercentageSimulation_Start  # Diagnostics Data Import
            DcmDspStartRoutineIn  # Diagnostics Data Import
              In_percentage (DcmDspStartRoutineInSignal): DcmDspRoutineSignalLength=16, DcmDspRoutineSignalType=UINT16, DcmDspRoutineSignalEndianness=BIG_ENDIAN, DcmDspRoutineSignalPos=0  # Diagnostics Data Import
            DcmDspRoutineAuthorization: DcmDspRoutineSessionRef=INX_End_Of_Line_Session, DcmDspRoutineSessionRef=INX_Development_Session, DcmDspRoutineSecurityLevelRef=Level_17  # Diagnostics Data Import
          RoutineInfo_CddBoosterDriver_Write_Start  # Diagnostics Data Import
            DcmDspStartRoutineIn  # Diagnostics Data Import
              3 x DcmDspStartRoutineInSignal:
                In_data: DcmDspRoutineSignalLength=2040, DcmDspRoutineSignalType=VARIABLE_LENGTH, DcmDspRoutineSignalEndianness=opaque, DcmDspRoutineSignalPos=16  # Diagnostics Data Import
                In_data_length: DcmDspRoutineSignalLength=8, DcmDspRoutineSignalType=UINT8, DcmDspRoutineSignalPos=8  # Diagnostics Data Import
                In_address: DcmDspRoutineSignalLength=8, DcmDspRoutineSignalType=UINT8, DcmDspRoutineSignalPos=0  # Diagnostics Data Import
            DcmDspRoutineAuthorization: DcmDspRoutineSessionRef=INX_End_Of_Line_Session, DcmDspRoutineSessionRef=INX_Development_Session, DcmDspRoutineSecurityLevelRef=Level_17  # Diagnostics Data Import
          RoutineInfo_CddBoosterDriver_Read_Start  # Diagnostics Data Import
            DcmDspStartRoutineOut  # Diagnostics Data Import
              Out_data (DcmDspStartRoutineOutSignal): DcmDspRoutineSignalLength=2040, DcmDspRoutineSignalType=VARIABLE_LENGTH, DcmDspRoutineSignalEndianness=opaque, DcmDspRoutineSignalPos=0  # Diagnostics Data Import
            DcmDspStartRoutineIn  # Diagnostics Data Import
              In_data_length (DcmDspStartRoutineInSignal): DcmDspRoutineSignalLength=8, DcmDspRoutineSignalType=UINT8, DcmDspRoutineSignalPos=8  # Diagnostics Data Import
              In_address (DcmDspStartRoutineInSignal): DcmDspRoutineSignalLength=8, DcmDspRoutineSignalType=UINT8, DcmDspRoutineSignalPos=0  # Diagnostics Data Import
            DcmDspRoutineAuthorization: DcmDspRoutineSessionRef=INX_End_Of_Line_Session, DcmDspRoutineSessionRef=INX_Development_Session, DcmDspRoutineSecurityLevelRef=Level_17  # Diagnostics Data Import
          RoutineInfo_CddTouchCypressGen7_CalibrateTouchSensor_Start  # Diagnostics Data Import
            DcmDspStartRoutineOut  # Diagnostics Data Import
              Out_pCalibResult (DcmDspStartRoutineOutSignal): DcmDspRoutineSignalLength=8, DcmDspRoutineSignalType=UINT8, DcmDspRoutineSignalPos=0  # Diagnostics Data Import
            DcmDspStartRoutineIn  # Diagnostics Data Import
              In_sensorId (DcmDspStartRoutineInSignal): DcmDspRoutineSignalLength=8, DcmDspRoutineSignalType=UINT8, DcmDspRoutineSignalPos=0  # Diagnostics Data Import
            DcmDspRoutineAuthorization: DcmDspRoutineSessionRef=INX_End_Of_Line_Session, DcmDspRoutineSessionRef=INX_Development_Session, DcmDspRoutineSecurityLevelRef=Level_17  # Diagnostics Data Import
          RoutineInfo_CddTouchCypressGen7_SetRamParameter_Start  # Diagnostics Data Import
            DcmDspStartRoutineIn  # Diagnostics Data Import
              3 x DcmDspStartRoutineInSignal:
                In_pParameterData: DcmDspRoutineSignalLength=32, DcmDspRoutineSignalType=VARIABLE_LENGTH, DcmDspRoutineSignalEndianness=opaque, DcmDspRoutineSignalPos=16  # Diagnostics Data Import
                In_parameterLength: DcmDspRoutineSignalLength=8, DcmDspRoutineSignalType=UINT8, DcmDspRoutineSignalPos=8  # Diagnostics Data Import
                In_parameterId: DcmDspRoutineSignalLength=8, DcmDspRoutineSignalType=UINT8, DcmDspRoutineSignalPos=0  # Diagnostics Data Import
            DcmDspRoutineAuthorization: DcmDspRoutineSessionRef=INX_End_Of_Line_Session, DcmDspRoutineSessionRef=INX_Development_Session, DcmDspRoutineSecurityLevelRef=Level_17  # Diagnostics Data Import
          RoutineInfo_CddTouchCypressGen7_GetRamParameter_Start  # Diagnostics Data Import
            DcmDspStartRoutineOut  # Diagnostics Data Import
              Out_pParameterData (DcmDspStartRoutineOutSignal): DcmDspRoutineSignalLength=32, DcmDspRoutineSignalType=VARIABLE_LENGTH, DcmDspRoutineSignalEndianness=opaque, DcmDspRoutineSignalPos=8  # Diagnostics Data Import
              Out_pParameterLength (DcmDspStartRoutineOutSignal): DcmDspRoutineSignalLength=8, DcmDspRoutineSignalType=UINT8, DcmDspRoutineSignalPos=0  # Diagnostics Data Import
            DcmDspStartRoutineIn  # Diagnostics Data Import
              In_parameterId (DcmDspStartRoutineInSignal): DcmDspRoutineSignalLength=8, DcmDspRoutineSignalType=UINT8, DcmDspRoutineSignalPos=0  # Diagnostics Data Import
            DcmDspRoutineAuthorization: DcmDspRoutineSessionRef=INX_End_Of_Line_Session, DcmDspRoutineSessionRef=INX_Development_Session, DcmDspRoutineSecurityLevelRef=Level_17  # Diagnostics Data Import
          RoutineInfo_CddTouchCypressGen7_MtkMode_Start  # Diagnostics Data Import
            DcmDspRoutineRequestResOut  # Diagnostics Data Import
              Out_pMtkModeState (DcmDspRoutineRequestResOutSignal): DcmDspRoutineSignalLength=8, DcmDspRoutineSignalType=UINT8, DcmDspRoutineSignalPos=0  # Diagnostics Data Import
            DcmDspRoutineAuthorization:  # Diagnostics Data Import
              DcmDspRoutineSessionRef = DcmDspSession/Programming
              DcmDspRoutineSessionRef = DcmDspSession/Extended
              DcmDspRoutineSessionRef = INX_End_Of_Line_Session
              DcmDspRoutineSessionRef = INX_Development_Session
              DcmDspRoutineSecurityLevelRef = Level_17
          RoutineInfo_CddTouchCypressGen7_Write_Start  # Diagnostics Data Import
            DcmDspStartRoutineIn  # Diagnostics Data Import
              3 x DcmDspStartRoutineInSignal:
                In_pData: DcmDspRoutineSignalLength=2040, DcmDspRoutineSignalType=VARIABLE_LENGTH, DcmDspRoutineSignalEndianness=opaque, DcmDspRoutineSignalPos=16  # Diagnostics Data Import
                In_length: DcmDspRoutineSignalLength=8, DcmDspRoutineSignalType=UINT8, DcmDspRoutineSignalPos=8  # Diagnostics Data Import
                In_address: DcmDspRoutineSignalLength=8, DcmDspRoutineSignalType=UINT8, DcmDspRoutineSignalPos=0  # Diagnostics Data Import
            DcmDspRoutineAuthorization: DcmDspRoutineSessionRef=INX_End_Of_Line_Session, DcmDspRoutineSessionRef=INX_Development_Session, DcmDspRoutineSecurityLevelRef=Level_17  # Diagnostics Data Import
          RoutineInfo_CddTouchCypressGen7_Read_Start  # Diagnostics Data Import
            DcmDspStartRoutineOut  # Diagnostics Data Import
              Out_pData (DcmDspStartRoutineOutSignal): DcmDspRoutineSignalLength=2040, DcmDspRoutineSignalType=VARIABLE_LENGTH, DcmDspRoutineSignalEndianness=opaque, DcmDspRoutineSignalPos=0  # Diagnostics Data Import
            DcmDspStartRoutineIn  # Diagnostics Data Import
              In_length (DcmDspStartRoutineInSignal): DcmDspRoutineSignalLength=8, DcmDspRoutineSignalType=UINT8, DcmDspRoutineSignalPos=8  # Diagnostics Data Import
              In_address (DcmDspStartRoutineInSignal): DcmDspRoutineSignalLength=8, DcmDspRoutineSignalType=UINT8, DcmDspRoutineSignalPos=0  # Diagnostics Data Import
            DcmDspRoutineAuthorization: DcmDspRoutineSessionRef=INX_End_Of_Line_Session, DcmDspRoutineSessionRef=INX_Development_Session, DcmDspRoutineSecurityLevelRef=Level_17  # Diagnostics Data Import
          RoutineInfo_CddDeserializerTIDS90Ux948_LvdsLockSimulation_Start  # Diagnostics Data Import
            DcmDspStartRoutineIn  # Diagnostics Data Import
              In_lvdsLock (DcmDspStartRoutineInSignal): DcmDspRoutineSignalLength=8, DcmDspRoutineSignalType=UINT8, DcmDspRoutineSignalPos=0  # Diagnostics Data Import
            DcmDspRoutineAuthorization: DcmDspRoutineSessionRef=INX_End_Of_Line_Session, DcmDspRoutineSessionRef=INX_Development_Session, DcmDspRoutineSecurityLevelRef=Level_17  # Diagnostics Data Import
          RoutineInfo_CddDeserializerTIDS90Ux948_Write_Start  # Diagnostics Data Import
            DcmDspStartRoutineIn  # Diagnostics Data Import
              3 x DcmDspStartRoutineInSignal:
                In_data: DcmDspRoutineSignalLength=2040, DcmDspRoutineSignalType=VARIABLE_LENGTH, DcmDspRoutineSignalEndianness=opaque, DcmDspRoutineSignalPos=16  # Diagnostics Data Import
                In_dataLength: DcmDspRoutineSignalLength=8, DcmDspRoutineSignalType=UINT8, DcmDspRoutineSignalPos=8  # Diagnostics Data Import
                In_address: DcmDspRoutineSignalLength=8, DcmDspRoutineSignalType=UINT8, DcmDspRoutineSignalPos=0  # Diagnostics Data Import
            DcmDspRoutineAuthorization: DcmDspRoutineSessionRef=INX_End_Of_Line_Session, DcmDspRoutineSessionRef=INX_Development_Session, DcmDspRoutineSecurityLevelRef=Level_17  # Diagnostics Data Import
          RoutineInfo_CddDeserializerTIDS90Ux948_Read_Start  # Diagnostics Data Import
            DcmDspStartRoutineOut  # Diagnostics Data Import
              Out_data (DcmDspStartRoutineOutSignal): DcmDspRoutineSignalLength=2040, DcmDspRoutineSignalType=VARIABLE_LENGTH, DcmDspRoutineSignalEndianness=opaque, DcmDspRoutineSignalPos=0  # Diagnostics Data Import
            DcmDspStartRoutineIn  # Diagnostics Data Import
              In_dataLength (DcmDspStartRoutineInSignal): DcmDspRoutineSignalLength=8, DcmDspRoutineSignalType=UINT8, DcmDspRoutineSignalPos=8  # Diagnostics Data Import
              In_address (DcmDspStartRoutineInSignal): DcmDspRoutineSignalLength=8, DcmDspRoutineSignalType=UINT8, DcmDspRoutineSignalPos=0  # Diagnostics Data Import
            DcmDspRoutineAuthorization: DcmDspRoutineSessionRef=INX_End_Of_Line_Session, DcmDspRoutineSessionRef=INX_Development_Session, DcmDspRoutineSecurityLevelRef=Level_17  # Diagnostics Data Import
          RoutineInfo_CddNvmManager_EepromStateSimulation_Start  # Diagnostics Data Import
            DcmDspStartRoutineIn  # Diagnostics Data Import
              In_eepromState (DcmDspStartRoutineInSignal): DcmDspRoutineSignalLength=8, DcmDspRoutineSignalType=UINT8, DcmDspRoutineSignalPos=0  # Diagnostics Data Import
            DcmDspRoutineAuthorization: DcmDspRoutineSessionRef=INX_Development_Session, DcmDspRoutineSecurityLevelRef=Level_17  # Diagnostics Data Import
          RoutineInfo_CddNvmManager_DataToUart_Start  # Diagnostics Data Import
            DcmDspStartRoutineIn  # Diagnostics Data Import
              In_blockId (DcmDspStartRoutineInSignal): DcmDspRoutineSignalLength=16, DcmDspRoutineSignalType=UINT16, DcmDspRoutineSignalEndianness=BIG_ENDIAN, DcmDspRoutineSignalPos=8  # Diagnostics Data Import
              In_source (DcmDspStartRoutineInSignal): DcmDspRoutineSignalLength=8, DcmDspRoutineSignalType=UINT8, DcmDspRoutineSignalPos=0  # Diagnostics Data Import
            DcmDspRoutineAuthorization: DcmDspRoutineSessionRef=INX_End_Of_Line_Session, DcmDspRoutineSessionRef=INX_Development_Session, DcmDspRoutineSecurityLevelRef=Level_17  # Diagnostics Data Import
          RoutineInfo_CddNvmManager_GetEepromBlockSizes_Start  # Diagnostics Data Import
            DcmDspStartRoutineOut  # Diagnostics Data Import
              Out_pBlockInfoList (DcmDspStartRoutineOutSignal): DcmDspRoutineSignalLength=8192, DcmDspRoutineSignalType=VARIABLE_LENGTH, DcmDspRoutineSignalEndianness=opaque, DcmDspRoutineSignalPos=16  # Diagnostics Data Import
              Out_pNrOfBlocks (DcmDspStartRoutineOutSignal): DcmDspRoutineSignalLength=16, DcmDspRoutineSignalType=UINT16, DcmDspRoutineSignalEndianness=BIG_ENDIAN, DcmDspRoutineSignalPos=0  # Diagnostics Data Import
            DcmDspRoutineAuthorization: DcmDspRoutineSessionRef=INX_End_Of_Line_Session, DcmDspRoutineSessionRef=INX_Development_Session, DcmDspRoutineSecurityLevelRef=Level_17  # Diagnostics Data Import
          RoutineInfo_CddNvmManager_CopyNvData_Start  # Diagnostics Data Import
            DcmDspStartRoutineOut  # Diagnostics Data Import
              Out_pBlockIdList (DcmDspStartRoutineOutSignal): DcmDspRoutineSignalLength=4096, DcmDspRoutineSignalType=VARIABLE_LENGTH, DcmDspRoutineSignalEndianness=opaque, DcmDspRoutineSignalPos=16  # Diagnostics Data Import
              Out_pNrOfBlocks (DcmDspStartRoutineOutSignal): DcmDspRoutineSignalLength=16, DcmDspRoutineSignalType=UINT16, DcmDspRoutineSignalEndianness=BIG_ENDIAN, DcmDspRoutineSignalPos=0  # Diagnostics Data Import
            DcmDspStartRoutineIn  # Diagnostics Data Import
              In_blockId (DcmDspStartRoutineInSignal): DcmDspRoutineSignalLength=16, DcmDspRoutineSignalType=UINT16, DcmDspRoutineSignalEndianness=BIG_ENDIAN, DcmDspRoutineSignalPos=8  # Diagnostics Data Import
              In_direction (DcmDspStartRoutineInSignal): DcmDspRoutineSignalLength=8, DcmDspRoutineSignalType=UINT8, DcmDspRoutineSignalPos=0  # Diagnostics Data Import
            DcmDspRoutineAuthorization: DcmDspRoutineSessionRef=INX_End_Of_Line_Session, DcmDspRoutineSessionRef=INX_Development_Session, DcmDspRoutineSecurityLevelRef=Level_17  # Diagnostics Data Import
          RoutineInfo_CddNvmManager_EepromDataWrite_Start  # Diagnostics Data Import
            DcmDspStartRoutineIn  # Diagnostics Data Import
              5 x DcmDspStartRoutineInSignal:
                In_data: DcmDspRoutineSignalLength=2048, DcmDspRoutineSignalType=VARIABLE_LENGTH, DcmDspRoutineSignalEndianness=opaque, DcmDspRoutineSignalPos=56  # Diagnostics Data Import
                In_writeImmediately: DcmDspRoutineSignalLength=8, DcmDspRoutineSignalType=UINT8, DcmDspRoutineSignalPos=48  # Diagnostics Data Import
                In_blockLength: DcmDspRoutineSignalLength=16, DcmDspRoutineSignalType=UINT16, DcmDspRoutineSignalEndianness=BIG_ENDIAN, DcmDspRoutineSignalPos=32  # Diagnostics Data Import
                In_blockOffset: DcmDspRoutineSignalLength=16, DcmDspRoutineSignalType=UINT16, DcmDspRoutineSignalEndianness=BIG_ENDIAN, DcmDspRoutineSignalPos=16  # Diagnostics Data Import
                In_blockID: DcmDspRoutineSignalLength=16, DcmDspRoutineSignalType=UINT16, DcmDspRoutineSignalEndianness=BIG_ENDIAN, DcmDspRoutineSignalPos=0  # Diagnostics Data Import
            DcmDspRoutineAuthorization: DcmDspRoutineSessionRef=INX_End_Of_Line_Session, DcmDspRoutineSessionRef=INX_Development_Session, DcmDspRoutineSecurityLevelRef=Level_17  # Diagnostics Data Import
          RoutineInfo_CddNvmManager_EepromDataRead_Start  # Diagnostics Data Import
            DcmDspStartRoutineOut  # Diagnostics Data Import
              Out_pData (DcmDspStartRoutineOutSignal): DcmDspRoutineSignalLength=2048, DcmDspRoutineSignalType=VARIABLE_LENGTH, DcmDspRoutineSignalEndianness=opaque, DcmDspRoutineSignalPos=0  # Diagnostics Data Import
            DcmDspStartRoutineIn  # Diagnostics Data Import
              3 x DcmDspStartRoutineInSignal, all with DcmDspRoutineSignalLength=16, DcmDspRoutineSignalType=UINT16, DcmDspRoutineSignalEndianness=BIG_ENDIAN:
                In_blockLength: DcmDspRoutineSignalPos=32  # Diagnostics Data Import
                In_blockOffset: DcmDspRoutineSignalPos=16  # Diagnostics Data Import
                In_blockID: DcmDspRoutineSignalPos=0  # Diagnostics Data Import
            DcmDspRoutineAuthorization: DcmDspRoutineSessionRef=INX_End_Of_Line_Session, DcmDspRoutineSessionRef=INX_Development_Session, DcmDspRoutineSecurityLevelRef=Level_17  # Diagnostics Data Import
          RoutineInfo_Verify_partial_software_checksum_Start  # Diagnostics Data Import
            DcmDspStartRoutineOut  # Diagnostics Data Import
              Out_RoutineResult (DcmDspStartRoutineOutSignal): DcmDspRoutineSignalLength=8, DcmDspRoutineSignalType=UINT8, DcmDspRoutineSignalPos=0  # Diagnostics Data Import
            DcmDspStartRoutineIn  # Diagnostics Data Import
              3 x DcmDspStartRoutineInSignal, all with DcmDspRoutineSignalEndianness=BIG_ENDIAN:
                In_CRC32: DcmDspRoutineSignalLength=32, DcmDspRoutineSignalType=UINT32, DcmDspRoutineSignalPos=32  # Diagnostics Data Import
                In_MemoryAddress: DcmDspRoutineSignalLength=16, DcmDspRoutineSignalType=UINT16, DcmDspRoutineSignalPos=16  # Diagnostics Data Import
                In_ALFID: DcmDspRoutineSignalLength=16, DcmDspRoutineSignalType=UINT16, DcmDspRoutineSignalPos=0  # Diagnostics Data Import
            DcmDspRoutineAuthorization  # Diagnostics Data Import
          RoutineInfo_CheckProgrammingPreconditions_Start  # Diagnostics Data Import
            DcmDspStartRoutineOut  # Diagnostics Data Import
              Out_ProgrammingPreconditionsList (DcmDspStartRoutineOutSignal): DcmDspRoutineSignalLength=128, DcmDspRoutineSignalType=VARIABLE_LENGTH, DcmDspRoutineSignalEndianness=opaque, DcmDspRoutineSignalPos=0  # Diagnostics Data Import
            DcmDspRoutineAuthorization:  # Diagnostics Data Import
              DcmDspRoutineSessionRef = DcmDspSession/Default
              DcmDspRoutineSessionRef = DcmDspSession/Extended
              DcmDspRoutineSessionRef = INX_End_Of_Line_Session
              DcmDspRoutineSessionRef = INX_Development_Session
          RoutineInfo_CheckMemory_Start  # Diagnostics Data Import
            DcmDspStartRoutineOut  # Diagnostics Data Import
              Out_RoutineResult (DcmDspStartRoutineOutSignal): DcmDspRoutineSignalLength=8, DcmDspRoutineSignalType=UINT8, DcmDspRoutineSignalPos=0  # Diagnostics Data Import
            DcmDspStartRoutineIn  # Diagnostics Data Import
              In_CRC32 (DcmDspStartRoutineInSignal): DcmDspRoutineSignalLength=3104, DcmDspRoutineSignalType=UINT8, DcmDspRoutineSignalEndianness=opaque, DcmDspRoutineSignalPos=0  # Diagnostics Data Import
            DcmDspRoutineAuthorization: DcmDspRoutineSessionRef=DcmDspSession/Programming, DcmDspRoutineSecurityLevelRef=Level_17  # Diagnostics Data Import
        79 x DcmDspRoutine:
          CheckProgrammingDependencies_Start: DcmDspRequestResultsRoutineSupported=false, DcmDspStopRoutineSupported=false, DcmDspRoutineIdentifier=65281, DcmDspRoutineInfoRef=RoutineInfo_CheckProgrammingDependencies_Start  # Diagnostics Data Import
          EraseMemory_Start: DcmDspRequestResultsRoutineSupported=false, DcmDspStopRoutineSupported=false, DcmDspRoutineIdentifier=65280, DcmDspRoutineInfoRef=RoutineInfo_EraseMemory_Start  # Diagnostics Data Import
          SwcDisplayInfo_ModuleVersionInfo_Start: DcmDspRequestResultsRoutineSupported=false, DcmDspStopRoutineSupported=false, DcmDspRoutineIdentifier=61824, DcmDspRoutineInfoRef=RoutineInfo_SwcDisplayInfo_ModuleVersionInfo_Start  # Diagnostics Data Import
          CddHWRNXPRT1171_SeverityLevelSimulation_Start: DcmDspRequestResultsRoutineSupported=false, DcmDspStopRoutineSupported=true, DcmDspRoutineIdentifier=61792, DcmDspRoutineInfoRef=RoutineInfo_CddHWRNXPRT1171_SeverityLevelSimulation_Start  # Diagnostics Data Import
          SwcVerify_RecoveryRequest_Start: DcmDspRequestResultsRoutineSupported=true, DcmDspStopRoutineSupported=false, DcmDspRoutineIdentifier=61778, DcmDspRoutineInfoRef=RoutineInfo_SwcVerify_RecoveryRequest_Start  # Diagnostics Data Import
          SwcVerify_VerifyRequest_Start: DcmDspRequestResultsRoutineSupported=true, DcmDspStopRoutineSupported=false, DcmDspRoutineIdentifier=61777, DcmDspRoutineInfoRef=RoutineInfo_SwcVerify_VerifyRequest_Start  # Diagnostics Data Import
          SwcVerify_ModuleVerifyDisable_Start: DcmDspRequestResultsRoutineSupported=false, DcmDspStopRoutineSupported=true, DcmDspRoutineIdentifier=61776, DcmDspRoutineInfoRef=RoutineInfo_SwcVerify_ModuleVerifyDisable_Start  # Diagnostics Data Import
          SwcSelfDiagnostics_StackUsage_Start: DcmDspRequestResultsRoutineSupported=false, DcmDspStopRoutineSupported=false, DcmDspRoutineIdentifier=61769, DcmDspRoutineInfoRef=RoutineInfo_SwcSelfDiagnostics_StackUsage_Start  # Diagnostics Data Import
          SwcSelfDiagnostics_AverageCpuLoad_Start: DcmDspRequestResultsRoutineSupported=true, DcmDspStopRoutineSupported=true, DcmDspRoutineIdentifier=61768, DcmDspRoutineInfoRef=RoutineInfo_SwcSelfDiagnostics_AverageCpuLoad_Start  # Diagnostics Data Import
          SwcDimming_SetDisplayDampingInterval_Start: DcmDspRequestResultsRoutineSupported=false, DcmDspStopRoutineSupported=false, DcmDspRoutineIdentifier=61750, DcmDspRoutineInfoRef=RoutineInfo_SwcDimming_SetDisplayDampingInterval_Start  # Diagnostics Data Import
          SwcDimming_SetTauNightToDay_Start: DcmDspRequestResultsRoutineSupported=false, DcmDspStopRoutineSupported=false, DcmDspRoutineIdentifier=61749, DcmDspRoutineInfoRef=RoutineInfo_SwcDimming_SetTauNightToDay_Start  # Diagnostics Data Import
          SwcDimming_SetTauDayToNight_Start: DcmDspRequestResultsRoutineSupported=false, DcmDspStopRoutineSupported=false, DcmDspRoutineIdentifier=61748, DcmDspRoutineInfoRef=RoutineInfo_SwcDimming_SetTauDayToNight_Start  # Diagnostics Data Import
          SwcDimming_SetTauDampDown_Start: DcmDspRequestResultsRoutineSupported=false, DcmDspStopRoutineSupported=false, DcmDspRoutineIdentifier=61747, DcmDspRoutineInfoRef=RoutineInfo_SwcDimming_SetTauDampDown_Start  # Diagnostics Data Import
          SwcDimming_SetTauDampUp_Start: DcmDspRequestResultsRoutineSupported=false, DcmDspStopRoutineSupported=false, DcmDspRoutineIdentifier=61746, DcmDspRoutineInfoRef=RoutineInfo_SwcDimming_SetTauDampUp_Start  # Diagnostics Data Import
          SwcDimming_SetDisplayOffsetMultiplier_Start: DcmDspRequestResultsRoutineSupported=false, DcmDspStopRoutineSupported=false, DcmDspRoutineIdentifier=61745, DcmDspRoutineInfoRef=RoutineInfo_SwcDimming_SetDisplayOffsetMultiplier_Start  # Diagnostics Data Import
          SwcDimming_SetDisplayErrorDefault_Start: DcmDspRequestResultsRoutineSupported=false, DcmDspStopRoutineSupported=false, DcmDspRoutineIdentifier=61744, DcmDspRoutineInfoRef=RoutineInfo_SwcDimming_SetDisplayErrorDefault_Start  # Diagnostics Data Import
          SwcError_GetErrorCounters_Start: DcmDspRequestResultsRoutineSupported=false, DcmDspStopRoutineSupported=false, DcmDspRoutineIdentifier=61735, DcmDspRoutineInfoRef=RoutineInfo_SwcError_GetErrorCounters_Start  # Diagnostics Data Import
          SwcError_GetErrorTrace_Start: DcmDspRequestResultsRoutineSupported=false, DcmDspStopRoutineSupported=false, DcmDspRoutineIdentifier=61734, DcmDspRoutineInfoRef=RoutineInfo_SwcError_GetErrorTrace_Start  # Diagnostics Data Import
          SwcError_TraceSeverityLevelSimulation_Start: DcmDspRequestResultsRoutineSupported=false, DcmDspStopRoutineSupported=true, DcmDspRoutineIdentifier=61733, DcmDspRoutineInfoRef=RoutineInfo_SwcError_TraceSeverityLevelSimulation_Start  # Diagnostics Data Import
          SwcError_ErrorCountSeverityLevelSimulation_Start: DcmDspRequestResultsRoutineSupported=false, DcmDspStopRoutineSupported=true, DcmDspRoutineIdentifier=61732, DcmDspRoutineInfoRef=RoutineInfo_SwcError_ErrorCountSeverityLevelSimulation_Start  # Diagnostics Data Import
          SwcError_UartSeverityLevelSimulation_Start: DcmDspRequestResultsRoutineSupported=false, DcmDspStopRoutineSupported=true, DcmDspRoutineIdentifier=61731, DcmDspRoutineInfoRef=RoutineInfo_SwcError_UartSeverityLevelSimulation_Start  # Diagnostics Data Import
          SwcError_ClearErrorCounters_Start: DcmDspRequestResultsRoutineSupported=false, DcmDspStopRoutineSupported=false, DcmDspRoutineIdentifier=61730, DcmDspRoutineInfoRef=RoutineInfo_SwcError_ClearErrorCounters_Start  # Diagnostics Data Import
          SwcError_ClearErrorTrace_Start: DcmDspRequestResultsRoutineSupported=false, DcmDspStopRoutineSupported=false, DcmDspRoutineIdentifier=61729, DcmDspRoutineInfoRef=RoutineInfo_SwcError_ClearErrorTrace_Start  # Diagnostics Data Import
          SwcError_GetErrorStatus_Start: DcmDspRequestResultsRoutineSupported=false, DcmDspStopRoutineSupported=false, DcmDspRoutineIdentifier=61728, DcmDspRoutineInfoRef=RoutineInfo_SwcError_GetErrorStatus_Start  # Diagnostics Data Import
          SwcDisplayControl_TestPattern_Start: DcmDspRequestResultsRoutineSupported=false, DcmDspStopRoutineSupported=true, DcmDspRoutineIdentifier=61720, DcmDspRoutineInfoRef=RoutineInfo_SwcDisplayControl_TestPattern_Start  # Diagnostics Data Import
          SwcDimming_SetSliderXtErrorDefault_Start: DcmDspRequestResultsRoutineSupported=false, DcmDspStopRoutineSupported=false, DcmDspRoutineIdentifier=61719, DcmDspRoutineInfoRef=RoutineInfo_SwcDimming_SetSliderXtErrorDefault_Start  # Diagnostics Data Import
          SwcDimming_SetSliderXsErrorDefault_Start: DcmDspRequestResultsRoutineSupported=false, DcmDspStopRoutineSupported=false, DcmDspRoutineIdentifier=61718, DcmDspRoutineInfoRef=RoutineInfo_SwcDimming_SetSliderXsErrorDefault_Start  # Diagnostics Data Import
          SwcDimming_SetDisplayPwmMin_Start: DcmDspRequestResultsRoutineSupported=false, DcmDspStopRoutineSupported=false, DcmDspRoutineIdentifier=61717, DcmDspRoutineInfoRef=RoutineInfo_SwcDimming_SetDisplayPwmMin_Start  # Diagnostics Data Import
          SwcDimming_SetSliderLut_Start: DcmDspRequestResultsRoutineSupported=false, DcmDspStopRoutineSupported=false, DcmDspRoutineIdentifier=61716, DcmDspRoutineInfoRef=RoutineInfo_SwcDimming_SetSliderLut_Start  # Diagnostics Data Import
          SwcDimming_SetDisplayLutNight_Start: DcmDspRequestResultsRoutineSupported=false, DcmDspStopRoutineSupported=false, DcmDspRoutineIdentifier=61715, DcmDspRoutineInfoRef=RoutineInfo_SwcDimming_SetDisplayLutNight_Start  # Diagnostics Data Import
          SwcDimming_SetDisplayLutDay_Start: DcmDspRequestResultsRoutineSupported=false, DcmDspStopRoutineSupported=false, DcmDspRoutineIdentifier=61714, DcmDspRoutineInfoRef=RoutineInfo_SwcDimming_SetDisplayLutDay_Start  # Diagnostics Data Import
          SwcDimming_SetSliderPwmOutput_Start: DcmDspRequestResultsRoutineSupported=false, DcmDspStopRoutineSupported=true, DcmDspRoutineIdentifier=61713, DcmDspRoutineInfoRef=RoutineInfo_SwcDimming_SetSliderPwmOutput_Start  # Diagnostics Data Import
          SwcDimming_SetDisplayPwmOutput_Start: DcmDspRequestResultsRoutineSupported=false, DcmDspStopRoutineSupported=true, DcmDspRoutineIdentifier=61712, DcmDspRoutineInfoRef=RoutineInfo_SwcDimming_SetDisplayPwmOutput_Start  # Diagnostics Data Import
          CddHWRNXPRT1171_SetSwUpdateReq_Start: DcmDspRequestResultsRoutineSupported=false, DcmDspStopRoutineSupported=true, DcmDspRoutineIdentifier=61586, DcmDspRoutineInfoRef=RoutineInfo_CddHWRNXPRT1171_SetSwUpdateReq_Start  # Diagnostics Data Import
          CddHWRNXPRT1171_ConfigPropRequest_Start: DcmDspRequestResultsRoutineSupported=false, DcmDspStopRoutineSupported=false, DcmDspRoutineIdentifier=61585, DcmDspRoutineInfoRef=RoutineInfo_CddHWRNXPRT1171_ConfigPropRequest_Start  # Diagnostics Data Import
          CddHWRNXPRT1171_RoutineRequest_Start: DcmDspRequestResultsRoutineSupported=false, DcmDspStopRoutineSupported=false, DcmDspRoutineIdentifier=61584, DcmDspRoutineInfoRef=RoutineInfo_CddHWRNXPRT1171_RoutineRequest_Start  # Diagnostics Data Import
          CddSliderBackLightTiSN1903001_BacklightLedCurrentSimulation_Start: DcmDspRequestResultsRoutineSupported=false, DcmDspStopRoutineSupported=true, DcmDspRoutineIdentifier=61571, DcmDspRoutineInfoRef=RoutineInfo_CddSliderBackLightTiSN1903001_BacklightLedCurrentSimulation_Start  # Diagnostics Data Import
          CddSliderBackLightTiSN1903001_BacklightPercentageSimulation_Start: DcmDspRequestResultsRoutineSupported=false, DcmDspStopRoutineSupported=true, DcmDspRoutineIdentifier=61570, DcmDspRoutineInfoRef=RoutineInfo_CddSliderBackLightTiSN1903001_BacklightPercentageSimulation_Start  # Diagnostics Data Import
          CddSliderBackLightTiSN1903001_Write_Start: DcmDspRequestResultsRoutineSupported=false, DcmDspStopRoutineSupported=false, DcmDspRoutineIdentifier=61569, DcmDspRoutineInfoRef=RoutineInfo_CddSliderBackLightTiSN1903001_Write_Start  # Diagnostics Data Import
          CddSliderBackLightTiSN1903001_Read_Start: DcmDspRequestResultsRoutineSupported=false, DcmDspStopRoutineSupported=false, DcmDspRoutineIdentifier=61568, DcmDspRoutineInfoRef=RoutineInfo_CddSliderBackLightTiSN1903001_Read_Start  # Diagnostics Data Import
          CddBist_BistMode_Start: DcmDspRequestResultsRoutineSupported=false, DcmDspStopRoutineSupported=true, DcmDspRoutineIdentifier=61560, DcmDspRoutineInfoRef=RoutineInfo_CddBist_BistMode_Start  # Diagnostics Data Import
          CddWatchdogInterface_SimulateWatchdogPeriod_Start: DcmDspRequestResultsRoutineSupported=false, DcmDspStopRoutineSupported=true, DcmDspRoutineIdentifier=61545, DcmDspRoutineInfoRef=RoutineInfo_CddWatchdogInterface_SimulateWatchdogPeriod_Start  # Diagnostics Data Import
          CddWatchdogInterface_WatchdogTriggering_Start: DcmDspRequestResultsRoutineSupported=false, DcmDspStopRoutineSupported=true, DcmDspRoutineIdentifier=61544, DcmDspRoutineInfoRef=RoutineInfo_CddWatchdogInterface_WatchdogTriggering_Start  # Diagnostics Data Import
          CddHeadUnitInterface_SimulateResetTrigger_Start: DcmDspRequestResultsRoutineSupported=false, DcmDspStopRoutineSupported=false, DcmDspRoutineIdentifier=61537, DcmDspRoutineInfoRef=RoutineInfo_CddHeadUnitInterface_SimulateResetTrigger_Start  # Diagnostics Data Import
          CddButton_ButtonStatusSimulation_Start: DcmDspRequestResultsRoutineSupported=false, DcmDspStopRoutineSupported=true, DcmDspRoutineIdentifier=61528, DcmDspRoutineInfoRef=RoutineInfo_CddButton_ButtonStatusSimulation_Start  # Diagnostics Data Import
          CddPerCtrl_WriteI2cDevice_Start: DcmDspRequestResultsRoutineSupported=false, DcmDspStopRoutineSupported=true, DcmDspRoutineIdentifier=61525, DcmDspRoutineInfoRef=RoutineInfo_CddPerCtrl_WriteI2cDevice_Start  # Diagnostics Data Import
          CddPerCtrl_ReadI2cDevice_Start: DcmDspRequestResultsRoutineSupported=false, DcmDspStopRoutineSupported=true, DcmDspRoutineIdentifier=61524, DcmDspRoutineInfoRef=RoutineInfo_CddPerCtrl_ReadI2cDevice_Start  # Diagnostics Data Import
          CddPerCtrl_SpiTransfer_Start: DcmDspRequestResultsRoutineSupported=false, DcmDspStopRoutineSupported=true, DcmDspRoutineIdentifier=61523, DcmDspRoutineInfoRef=RoutineInfo_CddPerCtrl_SpiTransfer_Start  # Diagnostics Data Import
          CddPerCtrl_TrgWdgReset_Start: DcmDspRequestResultsRoutineSupported=false, DcmDspStopRoutineSupported=false, DcmDspRoutineIdentifier=61522, DcmDspRoutineInfoRef=RoutineInfo_CddPerCtrl_TrgWdgReset_Start  # Diagnostics Data Import
          CddPerCtrl_DioControl_Start: DcmDspRequestResultsRoutineSupported=false, DcmDspStopRoutineSupported=true, DcmDspRoutineIdentifier=61521, DcmDspRoutineInfoRef=RoutineInfo_CddPerCtrl_DioControl_Start  # Diagnostics Data Import
          CddPerCtrl_GetAdcRawValues_Start: DcmDspRequestResultsRoutineSupported=false, DcmDspStopRoutineSupported=false, DcmDspRoutineIdentifier=61520, DcmDspRoutineInfoRef=RoutineInfo_CddPerCtrl_GetAdcRawValues_Start  # Diagnostics Data Import
          CddVoltageMonitor_VoltControl_Start: DcmDspRequestResultsRoutineSupported=true, DcmDspStopRoutineSupported=true, DcmDspRoutineIdentifier=61496, DcmDspRoutineInfoRef=RoutineInfo_CddVoltageMonitor_VoltControl_Start  # Diagnostics Data Import
          CddTemperatureMonitor_TemperatureControl_Start: DcmDspRequestResultsRoutineSupported=true, DcmDspStopRoutineSupported=true, DcmDspRoutineIdentifier=61488, DcmDspRoutineInfoRef=RoutineInfo_CddTemperatureMonitor_TemperatureControl_Start  # Diagnostics Data Import
          CddPanelHimaxHx8249B_GammaVoltageSetting_Start: DcmDspRequestResultsRoutineSupported=false, DcmDspStopRoutineSupported=true, DcmDspRoutineIdentifier=61486, DcmDspRoutineInfoRef=RoutineInfo_CddPanelHimaxHx8249B_GammaVoltageSetting_Start  # Diagnostics Data Import
          CddPanelHimaxHx8249B_VcomSimulation_Start: DcmDspRequestResultsRoutineSupported=false, DcmDspStopRoutineSupported=true, DcmDspRoutineIdentifier=61484, DcmDspRoutineInfoRef=RoutineInfo_CddPanelHimaxHx8249B_VcomSimulation_Start  # Diagnostics Data Import
          CddPanelHimaxHx8249B_GammaSimulation_Start: DcmDspRequestResultsRoutineSupported=false, DcmDspStopRoutineSupported=true, DcmDspRoutineIdentifier=61483, DcmDspRoutineInfoRef=RoutineInfo_CddPanelHimaxHx8249B_GammaSimulation_Start  # Diagnostics Data Import
          CddPanelHimaxHx8249B_Write_Start: DcmDspRequestResultsRoutineSupported=false, DcmDspStopRoutineSupported=false, DcmDspRoutineIdentifier=61481, DcmDspRoutineInfoRef=RoutineInfo_CddPanelHimaxHx8249B_Write_Start  # Diagnostics Data Import
          CddPanelHimaxHx8249B_Read_Start: DcmDspRequestResultsRoutineSupported=false, DcmDspStopRoutineSupported=false, DcmDspRoutineIdentifier=61480, DcmDspRoutineInfoRef=RoutineInfo_CddPanelHimaxHx8249B_Read_Start  # Diagnostics Data Import
          CddBoosterDriver_BacklightPercentageSimulation_Start: DcmDspRequestResultsRoutineSupported=false, DcmDspStopRoutineSupported=true, DcmDspRoutineIdentifier=61474, DcmDspRoutineInfoRef=RoutineInfo_CddBoosterDriver_BacklightPercentageSimulation_Start  # Diagnostics Data Import
          CddBoosterDriver_Write_Start: DcmDspRequestResultsRoutineSupported=false, DcmDspStopRoutineSupported=false, DcmDspRoutineIdentifier=61473, DcmDspRoutineInfoRef=RoutineInfo_CddBoosterDriver_Write_Start  # Diagnostics Data Import
          CddBoosterDriver_Read_Start: DcmDspRequestResultsRoutineSupported=false, DcmDspStopRoutineSupported=false, DcmDspRoutineIdentifier=61472, DcmDspRoutineInfoRef=RoutineInfo_CddBoosterDriver_Read_Start  # Diagnostics Data Import
          CddTouchCypressGen7_CalibrateTouchSensor_Start: DcmDspRequestResultsRoutineSupported=false, DcmDspStopRoutineSupported=false, DcmDspRoutineIdentifier=61470, DcmDspRoutineInfoRef=RoutineInfo_CddTouchCypressGen7_CalibrateTouchSensor_Start  # Diagnostics Data Import
          CddTouchCypressGen7_SetRamParameter_Start: DcmDspRequestResultsRoutineSupported=false, DcmDspStopRoutineSupported=false, DcmDspRoutineIdentifier=61469, DcmDspRoutineInfoRef=RoutineInfo_CddTouchCypressGen7_SetRamParameter_Start  # Diagnostics Data Import
          CddTouchCypressGen7_GetRamParameter_Start: DcmDspRequestResultsRoutineSupported=false, DcmDspStopRoutineSupported=false, DcmDspRoutineIdentifier=61468, DcmDspRoutineInfoRef=RoutineInfo_CddTouchCypressGen7_GetRamParameter_Start  # Diagnostics Data Import
          CddTouchCypressGen7_MtkMode_Start: DcmDspRequestResultsRoutineSupported=true, DcmDspStopRoutineSupported=true, DcmDspRoutineIdentifier=61466, DcmDspRoutineInfoRef=RoutineInfo_CddTouchCypressGen7_MtkMode_Start  # Diagnostics Data Import
          CddTouchCypressGen7_Write_Start: DcmDspRequestResultsRoutineSupported=false, DcmDspStopRoutineSupported=false, DcmDspRoutineIdentifier=61465, DcmDspRoutineInfoRef=RoutineInfo_CddTouchCypressGen7_Write_Start  # Diagnostics Data Import
          CddTouchCypressGen7_Read_Start: DcmDspRequestResultsRoutineSupported=false, DcmDspStopRoutineSupported=false, DcmDspRoutineIdentifier=61464, DcmDspRoutineInfoRef=RoutineInfo_CddTouchCypressGen7_Read_Start  # Diagnostics Data Import
          CddDeserializerTIDS90Ux948_LvdsLockSimulation_Start: DcmDspRequestResultsRoutineSupported=false, DcmDspStopRoutineSupported=true, DcmDspRoutineIdentifier=61458, DcmDspRoutineInfoRef=RoutineInfo_CddDeserializerTIDS90Ux948_LvdsLockSimulation_Start  # Diagnostics Data Import
          CddDeserializerTIDS90Ux948_Write_Start: DcmDspRequestResultsRoutineSupported=false, DcmDspStopRoutineSupported=false, DcmDspRoutineIdentifier=61457, DcmDspRoutineInfoRef=RoutineInfo_CddDeserializerTIDS90Ux948_Write_Start  # Diagnostics Data Import
          CddDeserializerTIDS90Ux948_Read_Start: DcmDspRequestResultsRoutineSupported=false, DcmDspStopRoutineSupported=false, DcmDspRoutineIdentifier=61456, DcmDspRoutineInfoRef=RoutineInfo_CddDeserializerTIDS90Ux948_Read_Start  # Diagnostics Data Import
          CddNvmManager_EepromStateSimulation_Start: DcmDspRequestResultsRoutineSupported=false, DcmDspStopRoutineSupported=true, DcmDspRoutineIdentifier=61453, DcmDspRoutineInfoRef=RoutineInfo_CddNvmManager_EepromStateSimulation_Start  # Diagnostics Data Import
          CddNvmManager_DataToUart_Start: DcmDspRequestResultsRoutineSupported=false, DcmDspStopRoutineSupported=false, DcmDspRoutineIdentifier=61452, DcmDspRoutineInfoRef=RoutineInfo_CddNvmManager_DataToUart_Start  # Diagnostics Data Import
          CddNvmManager_GetEepromBlockSizes_Start: DcmDspRequestResultsRoutineSupported=false, DcmDspStopRoutineSupported=false, DcmDspRoutineIdentifier=61451, DcmDspRoutineInfoRef=RoutineInfo_CddNvmManager_GetEepromBlockSizes_Start  # Diagnostics Data Import
          CddNvmManager_CopyNvData_Start: DcmDspRequestResultsRoutineSupported=false, DcmDspStopRoutineSupported=false, DcmDspRoutineIdentifier=61450, DcmDspRoutineInfoRef=RoutineInfo_CddNvmManager_CopyNvData_Start  # Diagnostics Data Import
          CddNvmManager_EepromDataWrite_Start: DcmDspRequestResultsRoutineSupported=false, DcmDspStopRoutineSupported=false, DcmDspRoutineIdentifier=61449, DcmDspRoutineInfoRef=RoutineInfo_CddNvmManager_EepromDataWrite_Start  # Diagnostics Data Import
          CddNvmManager_EepromDataRead_Start: DcmDspRequestResultsRoutineSupported=false, DcmDspStopRoutineSupported=false, DcmDspRoutineIdentifier=61448, DcmDspRoutineInfoRef=RoutineInfo_CddNvmManager_EepromDataRead_Start  # Diagnostics Data Import
          Verify_partial_software_checksum_Start: DcmDspRequestResultsRoutineSupported=false, DcmDspStopRoutineSupported=false, DcmDspRoutineIdentifier=1348, DcmDspRoutineInfoRef=RoutineInfo_Verify_partial_software_checksum_Start  # Diagnostics Data Import
          CheckProgrammingPreconditions_Start: DcmDspRequestResultsRoutineSupported=false, DcmDspStopRoutineSupported=false, DcmDspRoutineIdentifier=515, DcmDspRoutineInfoRef=RoutineInfo_CheckProgrammingPreconditions_Start  # Diagnostics Data Import
          CheckMemory_Start: DcmDspRequestResultsRoutineSupported=false, DcmDspStopRoutineSupported=false, DcmDspRoutineIdentifier=514, DcmDspRoutineInfoRef=RoutineInfo_CheckMemory_Start  # Diagnostics Data Import
        59 x DcmDspDidInfo:
          DidInfo_SwcDisplayInfo_HardwareIdentification_Read  # Diagnostics Data Import
            DcmDspDidAccess  # Diagnostics Data Import
              DcmDspDidRead: DcmDspDidReadSessionRef=INX_End_Of_Line_Session, DcmDspDidReadSessionRef=INX_Development_Session, DcmDspDidReadSecurityLevelRef=Level_17  # Diagnostics Data Import
          DidInfo_SwcDisplayInfo_SvnRevision_Read  # Diagnostics Data Import
            DcmDspDidAccess  # Diagnostics Data Import
              DcmDspDidRead: DcmDspDidReadSessionRef=INX_End_Of_Line_Session, DcmDspDidReadSessionRef=INX_Development_Session, DcmDspDidReadSecurityLevelRef=Level_17  # Diagnostics Data Import
          DidInfo_SwcDisplayInfo_SvnUrl_Read  # Diagnostics Data Import
            DcmDspDidAccess  # Diagnostics Data Import
              DcmDspDidRead: DcmDspDidReadSessionRef=INX_End_Of_Line_Session, DcmDspDidReadSessionRef=INX_Development_Session, DcmDspDidReadSecurityLevelRef=Level_17  # Diagnostics Data Import
          DidInfo_SwcDisplayInfo_ApplicationSoftwareVersion_Read  # Diagnostics Data Import
            DcmDspDidAccess  # Diagnostics Data Import
              DcmDspDidRead: DcmDspDidReadSessionRef=INX_End_Of_Line_Session, DcmDspDidReadSessionRef=INX_Development_Session, DcmDspDidReadSecurityLevelRef=Level_17  # Diagnostics Data Import
          DidInfo_SwcDisplayInfo_DisplayHardwareVersion_Read  # Diagnostics Data Import
            DcmDspDidAccess  # Diagnostics Data Import
              DcmDspDidRead: DcmDspDidReadSessionRef=INX_End_Of_Line_Session, DcmDspDidReadSessionRef=INX_Development_Session, DcmDspDidReadSecurityLevelRef=Level_17  # Diagnostics Data Import
          DidInfo_SwcDisplayInfo_DisplayVariant_Read  # Diagnostics Data Import
            DcmDspDidAccess  # Diagnostics Data Import
              DcmDspDidRead: DcmDspDidReadSessionRef=INX_End_Of_Line_Session, DcmDspDidReadSessionRef=INX_Development_Session, DcmDspDidReadSecurityLevelRef=Level_17  # Diagnostics Data Import
          DidInfo_SwcDisplayInfo_DisplayName_Read  # Diagnostics Data Import
            DcmDspDidAccess  # Diagnostics Data Import
              DcmDspDidRead: DcmDspDidReadSessionRef=INX_End_Of_Line_Session, DcmDspDidReadSessionRef=INX_Development_Session, DcmDspDidReadSecurityLevelRef=Level_17  # Diagnostics Data Import
          DidInfo_SwcComHandlerTx_PropEepromWriteCounter_Read  # Diagnostics Data Import
            DcmDspDidAccess  # Diagnostics Data Import
              DcmDspDidWrite: DcmDspDidWriteSessionRef=INX_End_Of_Line_Session, DcmDspDidWriteSessionRef=INX_Development_Session, DcmDspDidWriteSecurityLevelRef=Level_17  # Diagnostics Data Import
              DcmDspDidRead: DcmDspDidReadSessionRef=INX_End_Of_Line_Session, DcmDspDidReadSessionRef=INX_Development_Session, DcmDspDidReadSecurityLevelRef=Level_17  # Diagnostics Data Import
          DidInfo_SwcVerify_VerifyEnable_Read  # Diagnostics Data Import
            DcmDspDidAccess  # Diagnostics Data Import
              DcmDspDidWrite: DcmDspDidWriteSessionRef=INX_End_Of_Line_Session, DcmDspDidWriteSessionRef=INX_Development_Session, DcmDspDidWriteSecurityLevelRef=Level_17  # Diagnostics Data Import
              DcmDspDidRead: DcmDspDidReadSessionRef=INX_End_Of_Line_Session, DcmDspDidReadSessionRef=INX_Development_Session, DcmDspDidReadSecurityLevelRef=Level_17  # Diagnostics Data Import
          DidInfo_SwcSelfDiagnostics_CpuLoad_Read  # Diagnostics Data Import
            DcmDspDidAccess  # Diagnostics Data Import
              DcmDspDidWrite: DcmDspDidWriteSessionRef=INX_End_Of_Line_Session, DcmDspDidWriteSessionRef=INX_Development_Session, DcmDspDidWriteSecurityLevelRef=Level_17  # Diagnostics Data Import
              DcmDspDidRead: DcmDspDidReadSessionRef=INX_End_Of_Line_Session, DcmDspDidReadSessionRef=INX_Development_Session, DcmDspDidReadSecurityLevelRef=Level_17  # Diagnostics Data Import
          DidInfo_SwcSelfDiagnostics_EcuRuntime_Read  # Diagnostics Data Import
            DcmDspDidAccess  # Diagnostics Data Import
              DcmDspDidWrite: DcmDspDidWriteSessionRef=INX_End_Of_Line_Session, DcmDspDidWriteSessionRef=INX_Development_Session, DcmDspDidWriteSecurityLevelRef=Level_17  # Diagnostics Data Import
              DcmDspDidRead: DcmDspDidReadSessionRef=INX_End_Of_Line_Session, DcmDspDidReadSessionRef=INX_Development_Session, DcmDspDidReadSecurityLevelRef=Level_17  # Diagnostics Data Import
          DidInfo_SwcDimming_SliderDimmingOutPwm_Read  # Diagnostics Data Import
            DcmDspDidAccess  # Diagnostics Data Import
              DcmDspDidRead:  # Diagnostics Data Import
                DcmDspDidReadSessionRef = DcmDspSession/Programming
                DcmDspDidReadSessionRef = DcmDspSession/Extended
                DcmDspDidReadSessionRef = INX_End_Of_Line_Session
                DcmDspDidReadSessionRef = INX_Development_Session
                DcmDspDidReadSecurityLevelRef = Level_17
          DidInfo_SwcDimming_DisplayDimmingOutPwm_Read  # Diagnostics Data Import
            DcmDspDidAccess  # Diagnostics Data Import
              DcmDspDidRead:  # Diagnostics Data Import
                DcmDspDidReadSessionRef = DcmDspSession/Programming
                DcmDspDidReadSessionRef = DcmDspSession/Extended
                DcmDspDidReadSessionRef = INX_End_Of_Line_Session
                DcmDspDidReadSessionRef = INX_Development_Session
                DcmDspDidReadSecurityLevelRef = Level_17
          DidInfo_SwcDimming_DisplayDimmingOutPostOffset_Read  # Diagnostics Data Import
            DcmDspDidAccess  # Diagnostics Data Import
              DcmDspDidRead:  # Diagnostics Data Import
                DcmDspDidReadSessionRef = DcmDspSession/Programming
                DcmDspDidReadSessionRef = DcmDspSession/Extended
                DcmDspDidReadSessionRef = INX_End_Of_Line_Session
                DcmDspDidReadSessionRef = INX_Development_Session
                DcmDspDidReadSecurityLevelRef = Level_17
          DidInfo_SwcDimming_DisplayDimmingOutPreOffset_Read  # Diagnostics Data Import
            DcmDspDidAccess  # Diagnostics Data Import
              DcmDspDidRead:  # Diagnostics Data Import
                DcmDspDidReadSessionRef = DcmDspSession/Programming
                DcmDspDidReadSessionRef = DcmDspSession/Extended
                DcmDspDidReadSessionRef = INX_End_Of_Line_Session
                DcmDspDidReadSessionRef = INX_Development_Session
                DcmDspDidReadSecurityLevelRef = Level_17
          DidInfo_CddCodeFlashAccess_ResetVector_Read  # Diagnostics Data Import
            DcmDspDidAccess  # Diagnostics Data Import
              DcmDspDidRead: DcmDspDidReadSessionRef=INX_End_Of_Line_Session, DcmDspDidReadSessionRef=INX_Development_Session  # Diagnostics Data Import
          DidInfo_CddWakeupDetect_ResetCounters_Read  # Diagnostics Data Import
            DcmDspDidAccess  # Diagnostics Data Import
              DcmDspDidRead: DcmDspDidReadSessionRef=INX_End_Of_Line_Session, DcmDspDidReadSessionRef=INX_Development_Session, DcmDspDidReadSecurityLevelRef=Level_17  # Diagnostics Data Import
          DidInfo_CddSliderBackLightTiSN1903001_BacklightDutyCycle_Read  # Diagnostics Data Import
            DcmDspDidAccess  # Diagnostics Data Import
              DcmDspDidRead:  # Diagnostics Data Import
                DcmDspDidReadSessionRef = DcmDspSession/Programming
                DcmDspDidReadSessionRef = DcmDspSession/Extended
                DcmDspDidReadSessionRef = INX_End_Of_Line_Session
                DcmDspDidReadSessionRef = INX_Development_Session
                DcmDspDidReadSecurityLevelRef = Level_17
          DidInfo_CddVoltageMonitor_MinBatteryVoltage_Read  # Diagnostics Data Import
            DcmDspDidAccess  # Diagnostics Data Import
              DcmDspDidWrite: DcmDspDidWriteSessionRef=INX_End_Of_Line_Session, DcmDspDidWriteSessionRef=INX_Development_Session  # Diagnostics Data Import
              DcmDspDidRead: DcmDspDidReadSessionRef=INX_End_Of_Line_Session, DcmDspDidReadSessionRef=INX_Development_Session  # Diagnostics Data Import
          DidInfo_CddVoltageMonitor_MaxBatteryVoltage_Read  # Diagnostics Data Import
            DcmDspDidAccess  # Diagnostics Data Import
              DcmDspDidWrite: DcmDspDidWriteSessionRef=INX_End_Of_Line_Session, DcmDspDidWriteSessionRef=INX_Development_Session, DcmDspDidWriteSecurityLevelRef=Level_17  # Diagnostics Data Import
              DcmDspDidRead: DcmDspDidReadSessionRef=INX_End_Of_Line_Session, DcmDspDidReadSessionRef=INX_Development_Session, DcmDspDidReadSecurityLevelRef=Level_17  # Diagnostics Data Import
          DidInfo_CddTemperatureMonitor_MinimumTemperature_Read  # Diagnostics Data Import
            DcmDspDidAccess  # Diagnostics Data Import
              DcmDspDidWrite: DcmDspDidWriteSessionRef=INX_End_Of_Line_Session, DcmDspDidWriteSessionRef=INX_Development_Session, DcmDspDidWriteSecurityLevelRef=Level_17  # Diagnostics Data Import
              DcmDspDidRead: DcmDspDidReadSessionRef=INX_End_Of_Line_Session, DcmDspDidReadSessionRef=INX_Development_Session, DcmDspDidReadSecurityLevelRef=Level_17  # Diagnostics Data Import
          DidInfo_CddTemperatureMonitor_MaximumTemperature_Read  # Diagnostics Data Import
            DcmDspDidAccess  # Diagnostics Data Import
              DcmDspDidWrite: DcmDspDidWriteSessionRef=INX_End_Of_Line_Session, DcmDspDidWriteSessionRef=INX_Development_Session, DcmDspDidWriteSecurityLevelRef=Level_17  # Diagnostics Data Import
              DcmDspDidRead: DcmDspDidReadSessionRef=INX_End_Of_Line_Session, DcmDspDidReadSessionRef=INX_Development_Session, DcmDspDidReadSecurityLevelRef=Level_17  # Diagnostics Data Import
          DidInfo_CddBooster_BacklightDutyCycle_Read  # Diagnostics Data Import
            DcmDspDidAccess  # Diagnostics Data Import
              DcmDspDidRead: DcmDspDidReadSessionRef=INX_End_Of_Line_Session, DcmDspDidReadSessionRef=INX_Development_Session, DcmDspDidReadSecurityLevelRef=Level_17  # Diagnostics Data Import
          DidInfo_CddTouchCypressGen7_ManufacturerData_Read  # Diagnostics Data Import
            DcmDspDidAccess  # Diagnostics Data Import
              DcmDspDidRead: DcmDspDidReadSessionRef=INX_End_Of_Line_Session, DcmDspDidReadSessionRef=INX_Development_Session, DcmDspDidReadSecurityLevelRef=Level_17  # Diagnostics Data Import
          DidInfo_CddTouchCypressGen7_SoftwareVersion_Read  # Diagnostics Data Import
            DcmDspDidAccess  # Diagnostics Data Import
              DcmDspDidRead: DcmDspDidReadSessionRef=INX_End_Of_Line_Session, DcmDspDidReadSessionRef=INX_Development_Session, DcmDspDidReadSecurityLevelRef=Level_17  # Diagnostics Data Import
          DidInfo_CddTouchCypressGen7_HardwareVersion_Read  # Diagnostics Data Import
            DcmDspDidAccess  # Diagnostics Data Import
              DcmDspDidRead: DcmDspDidReadSessionRef=INX_End_Of_Line_Session, DcmDspDidReadSessionRef=INX_Development_Session, DcmDspDidReadSecurityLevelRef=Level_17  # Diagnostics Data Import
          DidInfo_CddNvMManager_DiagEepromWriteCounter_Read  # Diagnostics Data Import
            DcmDspDidAccess  # Diagnostics Data Import
              DcmDspDidWrite: DcmDspDidWriteSessionRef=INX_End_Of_Line_Session, DcmDspDidWriteSessionRef=INX_Development_Session, DcmDspDidWriteSecurityLevelRef=Level_17  # Diagnostics Data Import
              DcmDspDidRead: DcmDspDidReadSessionRef=INX_End_Of_Line_Session, DcmDspDidReadSessionRef=INX_Development_Session, DcmDspDidReadSecurityLevelRef=Level_17  # Diagnostics Data Import
          DidInfo_CddConnectionCheck_ConnectionCheck_Read  # Diagnostics Data Import
            DcmDspDidAccess  # Diagnostics Data Import
              DcmDspDidRead: DcmDspDidReadSessionRef=INX_End_Of_Line_Session, DcmDspDidReadSessionRef=INX_Development_Session, DcmDspDidReadSecurityLevelRef=Level_17  # Diagnostics Data Import
          DidInfo_ECUProgrammingInformation_Read  # Diagnostics Data Import
            DcmDspDidAccess  # Diagnostics Data Import
              DcmDspDidRead  # Diagnostics Data Import
          DidInfo_FDS_Project_Data_Read  # Diagnostics Data Import
            DcmDspDidAccess  # Diagnostics Data Import
              DcmDspDidRead  # Diagnostics Data Import
          DidInfo_TechnicalSpecificationsVersion_Read  # Diagnostics Data Import
            DcmDspDidAccess  # Diagnostics Data Import
              DcmDspDidRead:  # Diagnostics Data Import
                DcmDspDidReadSessionRef = DcmDspSession/Default
                DcmDspDidReadSessionRef = DcmDspSession/Extended
                DcmDspDidReadSessionRef = INX_End_Of_Line_Session
                DcmDspDidReadSessionRef = INX_Development_Session
          DidInfo_VWLogicalBlockVersion_Read  # Diagnostics Data Import
            DcmDspDidAccess  # Diagnostics Data Import
              DcmDspDidRead  # Diagnostics Data Import
          DidInfo_VWECUHardwareVersionNumber_Read  # Diagnostics Data Import
            DcmDspDidAccess  # Diagnostics Data Import
              DcmDspDidRead  # Diagnostics Data Import
          DidInfo_ASAMODXFileVersion_Read  # Diagnostics Data Import
            DcmDspDidAccess  # Diagnostics Data Import
              DcmDspDidRead  # Diagnostics Data Import
          DidInfo_ASAMODXFileIdentifier_Read  # Diagnostics Data Import
            DcmDspDidAccess  # Diagnostics Data Import
              DcmDspDidRead  # Diagnostics Data Import
          DidInfo_VWSystemNameOrEngineType_Read  # Diagnostics Data Import
            DcmDspDidAccess  # Diagnostics Data Import
              DcmDspDidRead:  # Diagnostics Data Import
                DcmDspDidReadSessionRef = DcmDspSession/Default
                DcmDspDidReadSessionRef = DcmDspSession/Extended
                DcmDspDidReadSessionRef = INX_End_Of_Line_Session
                DcmDspDidReadSessionRef = INX_Development_Session
          DidInfo_VWECUHardwareNumber_Read  # Diagnostics Data Import
            DcmDspDidAccess  # Diagnostics Data Import
              DcmDspDidRead  # Diagnostics Data Import
          DidInfo_ECUSerialNumber_Read  # Diagnostics Data Import
            DcmDspDidAccess  # Diagnostics Data Import
              DcmDspDidRead  # Diagnostics Data Import
          DidInfo_VWApplicationSoftwareVersionNumber_Read  # Diagnostics Data Import
            DcmDspDidAccess  # Diagnostics Data Import
              DcmDspDidRead  # Diagnostics Data Import
          DidInfo_VWSparePartNumber_Read  # Diagnostics Data Import
            DcmDspDidAccess  # Diagnostics Data Import
              DcmDspDidRead  # Diagnostics Data Import
          DidInfo_ActiveDiagnosticSession_Read  # Diagnostics Data Import
            DcmDspDidAccess  # Diagnostics Data Import
              DcmDspDidRead  # Diagnostics Data Import
          DidInfo_VWFAZITIdentificationString_Read  # Diagnostics Data Import
            DcmDspDidAccess  # Diagnostics Data Import
              DcmDspDidRead  # Diagnostics Data Import
          DidInfo_FingerprintLogicalBlock_Read  # Diagnostics Data Import
            DcmDspDidAccess  # Diagnostics Data Import
              DcmDspDidRead  # Diagnostics Data Import
          DidInfo_Fingerprint_Read  # Diagnostics Data Import
            DcmDspDidAccess  # Diagnostics Data Import
              DcmDspDidWrite: DcmDspDidWriteSessionRef=DcmDspSession/Programming, DcmDspDidWriteSecurityLevelRef=Level_17  # Diagnostics Data Import
              DcmDspDidRead: DcmDspDidReadSessionRef=DcmDspSession/Programming, DcmDspDidReadSecurityLevelRef=Level_17  # Diagnostics Data Import
          DidInfo_SwcTestInterface_DeveloperMode_Read  # Diagnostics Data Import
            DcmDspDidAccess  # Diagnostics Data Import
              DcmDspDidWrite:  # Diagnostics Data Import
                DcmDspDidWriteSessionRef = DcmDspSession/Programming
                DcmDspDidWriteSessionRef = DcmDspSession/Extended
                DcmDspDidWriteSessionRef = INX_End_Of_Line_Session
                DcmDspDidWriteSessionRef = INX_Development_Session
              DcmDspDidRead  # Diagnostics Data Import
          DidInfo_CddNvmManager_NvmDisplayDimLutNight_Read  # Diagnostics Data Import
            DcmDspDidAccess  # Diagnostics Data Import
              DcmDspDidWrite: DcmDspDidWriteSessionRef=DcmDspSession/Extended  # Diagnostics Data Import
              DcmDspDidRead: DcmDspDidReadSessionRef=DcmDspSession/Default, DcmDspDidReadSessionRef=DcmDspSession/Programming, DcmDspDidReadSessionRef=DcmDspSession/Extended  # Diagnostics Data Import
          DidInfo_CddNvmManager_NvmSliderDimLut_Read  # Diagnostics Data Import
            DcmDspDidAccess  # Diagnostics Data Import
              DcmDspDidWrite: DcmDspDidWriteSessionRef=DcmDspSession/Extended  # Diagnostics Data Import
              DcmDspDidRead: DcmDspDidReadSessionRef=DcmDspSession/Default, DcmDspDidReadSessionRef=DcmDspSession/Programming, DcmDspDidReadSessionRef=DcmDspSession/Extended  # Diagnostics Data Import
          DidInfo_CddNvmManager_NvmDisplayDimLutDay_Read  # Diagnostics Data Import
            DcmDspDidAccess  # Diagnostics Data Import
              DcmDspDidWrite: DcmDspDidWriteSessionRef=DcmDspSession/Extended  # Diagnostics Data Import
              DcmDspDidRead: DcmDspDidReadSessionRef=DcmDspSession/Default, DcmDspDidReadSessionRef=DcmDspSession/Programming, DcmDspDidReadSessionRef=DcmDspSession/Extended  # Diagnostics Data Import
          DidInfo_CddTouchCypressGen7_SlideTouchConfiguration_Read  # Diagnostics Data Import
            DcmDspDidAccess  # Diagnostics Data Import
              DcmDspDidWrite: DcmDspDidWriteSessionRef=DcmDspSession/Extended  # Diagnostics Data Import
              DcmDspDidRead: DcmDspDidReadSessionRef=DcmDspSession/Default, DcmDspDidReadSessionRef=DcmDspSession/Programming, DcmDspDidReadSessionRef=DcmDspSession/Extended  # Diagnostics Data Import
          DidInfo_CddTouchCypressGen7_DisplayTouchConfiguration_Read  # Diagnostics Data Import
            DcmDspDidAccess  # Diagnostics Data Import
              DcmDspDidWrite: DcmDspDidWriteSessionRef=DcmDspSession/Extended  # Diagnostics Data Import
              DcmDspDidRead: DcmDspDidReadSessionRef=DcmDspSession/Default, DcmDspDidReadSessionRef=DcmDspSession/Programming, DcmDspDidReadSessionRef=DcmDspSession/Extended  # Diagnostics Data Import
          DidInfo_ProgrammingPreconditions_Read  # Diagnostics Data Import
            DcmDspDidAccess  # Diagnostics Data Import
              DcmDspDidRead  # Diagnostics Data Import
          DidInfo_BootloaderTPBlocksize_Read  # Diagnostics Data Import
            DcmDspDidAccess  # Diagnostics Data Import
              DcmDspDidWrite:  # Diagnostics Data Import
                DcmDspDidWriteSessionRef = DcmDspSession/Programming
                DcmDspDidWriteSessionRef = DcmDspSession/Extended
                DcmDspDidWriteSessionRef = INX_End_Of_Line_Session
                DcmDspDidWriteSessionRef = INX_Development_Session
              DcmDspDidRead  # Diagnostics Data Import
          DidInfo_VWLogicalBlockLockValue_Read  # Diagnostics Data Import
            DcmDspDidAccess  # Diagnostics Data Import
              DcmDspDidRead  # Diagnostics Data Import
          DidInfo_VWLogicalBlockCounterOfProgrammingAttempts_Read  # Diagnostics Data Import
            DcmDspDidAccess  # Diagnostics Data Import
              DcmDspDidRead  # Diagnostics Data Import
          DidInfo_Integrity_validation_data_configuration_list_Read  # Diagnostics Data Import
            DcmDspDidAccess  # Diagnostics Data Import
              DcmDspDidRead  # Diagnostics Data Import
          DidInfo_Programming_hash_Read  # Diagnostics Data Import
            DcmDspDidAccess  # Diagnostics Data Import
              DcmDspDidRead  # Diagnostics Data Import
          DidInfo_Configuration_hash_Read  # Diagnostics Data Import
            DcmDspDidAccess  # Diagnostics Data Import
              DcmDspDidRead: DcmDspDidReadSessionRef=INX_Development_Session  # Diagnostics Data Import
          DidInfo_VWLogicalBlockDowngradeVersions_Read  # Diagnostics Data Import
            DcmDspDidAccess  # Diagnostics Data Import
              DcmDspDidRead  # Diagnostics Data Import
          DidInfo_BasicSettingsStatus_Read  # Diagnostics Data Import
            DcmDspDidAccess  # Diagnostics Data Import
              DcmDspDidRead:  # Diagnostics Data Import
                DcmDspDidReadSessionRef = DcmDspSession/Default
                DcmDspDidReadSessionRef = DcmDspSession/Extended
                DcmDspDidReadSessionRef = INX_End_Of_Line_Session
                DcmDspDidReadSessionRef = INX_Development_Session
        59 x DcmDspDid:
          SwcDisplayInfo_HardwareIdentification_Read: DcmDspDidIdentifier=65158, DcmDspDidInfoRef=DidInfo_SwcDisplayInfo_HardwareIdentification_Read  # Diagnostics Data Import
            hwId (DcmDspDidSignal): DcmDspDidDataPos=0, DcmDspDidDataRef=SwcDisplayInfo_HardwareIdentification_Read_hwId  # Diagnostics Data Import
          SwcDisplayInfo_SvnRevision_Read: DcmDspDidIdentifier=65157, DcmDspDidInfoRef=DidInfo_SwcDisplayInfo_SvnRevision_Read  # Diagnostics Data Import
            svnRevision (DcmDspDidSignal): DcmDspDidDataPos=0, DcmDspDidDataRef=SwcDisplayInfo_SvnRevision_Read_svnRevision  # Diagnostics Data Import
          SwcDisplayInfo_SvnUrl_Read: DcmDspDidIdentifier=65156, DcmDspDidInfoRef=DidInfo_SwcDisplayInfo_SvnUrl_Read  # Diagnostics Data Import
            svnUrl (DcmDspDidSignal): DcmDspDidDataPos=0, DcmDspDidDataRef=SwcDisplayInfo_SvnUrl_Read_svnUrl  # Diagnostics Data Import
          SwcDisplayInfo_ApplicationSoftwareVersion_Read: DcmDspDidIdentifier=65155, DcmDspDidInfoRef=DidInfo_SwcDisplayInfo_ApplicationSoftwareVersion_Read  # Diagnostics Data Import
            appSwVersion (DcmDspDidSignal): DcmDspDidDataPos=0, DcmDspDidDataRef=SwcDisplayInfo_ApplicationSoftwareVersion_Read_appSwVersion  # Diagnostics Data Import
          SwcDisplayInfo_DisplayHardwareVersion_Read: DcmDspDidIdentifier=65154, DcmDspDidInfoRef=DidInfo_SwcDisplayInfo_DisplayHardwareVersion_Read  # Diagnostics Data Import
            dispHwVersion (DcmDspDidSignal): DcmDspDidDataPos=0, DcmDspDidDataRef=SwcDisplayInfo_DisplayHardwareVersion_Read_dispHwVersion  # Diagnostics Data Import
          SwcDisplayInfo_DisplayVariant_Read: DcmDspDidIdentifier=65153, DcmDspDidInfoRef=DidInfo_SwcDisplayInfo_DisplayVariant_Read  # Diagnostics Data Import
            dispVariant (DcmDspDidSignal): DcmDspDidDataPos=0, DcmDspDidDataRef=SwcDisplayInfo_DisplayVariant_Read_dispVariant  # Diagnostics Data Import
          SwcDisplayInfo_DisplayName_Read: DcmDspDidIdentifier=65152, DcmDspDidInfoRef=DidInfo_SwcDisplayInfo_DisplayName_Read  # Diagnostics Data Import
            dispName (DcmDspDidSignal): DcmDspDidDataPos=0, DcmDspDidDataRef=SwcDisplayInfo_DisplayName_Read_dispName  # Diagnostics Data Import
          SwcComHandlerTx_PropEepromWriteCounter_Read: DcmDspDidIdentifier=65128, DcmDspDidInfoRef=DidInfo_SwcComHandlerTx_PropEepromWriteCounter_Read  # Diagnostics Data Import
            counter (DcmDspDidSignal): DcmDspDidDataPos=0, DcmDspDidDataRef=SwcComHandlerTx_PropEepromWriteCounter_Read_counter  # Diagnostics Data Import
          SwcVerify_VerifyEnable_Read: DcmDspDidIdentifier=65104, DcmDspDidInfoRef=DidInfo_SwcVerify_VerifyEnable_Read  # Diagnostics Data Import
            verifyMode (DcmDspDidSignal): DcmDspDidDataPos=0, DcmDspDidDataRef=SwcVerify_VerifyEnable_Read_verifyMode  # Diagnostics Data Import
          SwcSelfDiagnostics_CpuLoad_Read: DcmDspDidIdentifier=65097, DcmDspDidInfoRef=DidInfo_SwcSelfDiagnostics_CpuLoad_Read  # Diagnostics Data Import
            pData (DcmDspDidSignal): DcmDspDidDataPos=0, DcmDspDidDataRef=SwcSelfDiagnostics_CpuLoad_Read_pData  # Diagnostics Data Import
          SwcSelfDiagnostics_EcuRuntime_Read: DcmDspDidIdentifier=65096, DcmDspDidInfoRef=DidInfo_SwcSelfDiagnostics_EcuRuntime_Read  # Diagnostics Data Import
            ecuRuntime (DcmDspDidSignal): DcmDspDidDataPos=0, DcmDspDidDataRef=SwcSelfDiagnostics_EcuRuntime_Read_ecuRuntime  # Diagnostics Data Import
          SwcDimming_SliderDimmingOutPwm_Read: DcmDspDidIdentifier=65043, DcmDspDidInfoRef=DidInfo_SwcDimming_SliderDimmingOutPwm_Read  # Diagnostics Data Import
            data (DcmDspDidSignal): DcmDspDidDataPos=0, DcmDspDidDataRef=SwcDimming_SliderDimmingOutPwm_Read_data  # Diagnostics Data Import
          SwcDimming_DisplayDimmingOutPwm_Read: DcmDspDidIdentifier=65042, DcmDspDidInfoRef=DidInfo_SwcDimming_DisplayDimmingOutPwm_Read  # Diagnostics Data Import
            data (DcmDspDidSignal): DcmDspDidDataPos=0, DcmDspDidDataRef=SwcDimming_DisplayDimmingOutPwm_Read_data  # Diagnostics Data Import
          SwcDimming_DisplayDimmingOutPostOffset_Read: DcmDspDidIdentifier=65041, DcmDspDidInfoRef=DidInfo_SwcDimming_DisplayDimmingOutPostOffset_Read  # Diagnostics Data Import
            data (DcmDspDidSignal): DcmDspDidDataPos=0, DcmDspDidDataRef=SwcDimming_DisplayDimmingOutPostOffset_Read_data  # Diagnostics Data Import
          SwcDimming_DisplayDimmingOutPreOffset_Read: DcmDspDidIdentifier=65040, DcmDspDidInfoRef=DidInfo_SwcDimming_DisplayDimmingOutPreOffset_Read  # Diagnostics Data Import
            data (DcmDspDidSignal): DcmDspDidDataPos=0, DcmDspDidDataRef=SwcDimming_DisplayDimmingOutPreOffset_Read_data  # Diagnostics Data Import
          CddCodeFlashAccess_ResetVector_Read: DcmDspDidIdentifier=64929, DcmDspDidInfoRef=DidInfo_CddCodeFlashAccess_ResetVector_Read  # Diagnostics Data Import
            ResetVector (DcmDspDidSignal): DcmDspDidDataPos=0, DcmDspDidDataRef=CddCodeFlashAccess_ResetVector_Read_ResetVector  # Diagnostics Data Import
          CddWakeupDetect_ResetCounters_Read: DcmDspDidIdentifier=64920, DcmDspDidInfoRef=DidInfo_CddWakeupDetect_ResetCounters_Read  # Diagnostics Data Import
            rstCntrs (DcmDspDidSignal): DcmDspDidDataPos=0, DcmDspDidDataRef=CddWakeupDetect_ResetCounters_Read_rstCntrs  # Diagnostics Data Import
          CddSliderBackLightTiSN1903001_BacklightDutyCycle_Read: DcmDspDidIdentifier=64896, DcmDspDidInfoRef=DidInfo_CddSliderBackLightTiSN1903001_BacklightDutyCycle_Read  # Diagnostics Data Import
            percentage (DcmDspDidSignal): DcmDspDidDataPos=0, DcmDspDidDataRef=CddSliderBackLightTiSN1903001_BacklightDutyCycle_Read_percentage  # Diagnostics Data Import
          CddVoltageMonitor_MinBatteryVoltage_Read: DcmDspDidIdentifier=64825, DcmDspDidInfoRef=DidInfo_CddVoltageMonitor_MinBatteryVoltage_Read  # Diagnostics Data Import
            pData (DcmDspDidSignal): DcmDspDidDataPos=0, DcmDspDidDataRef=CddVoltageMonitor_MinBatteryVoltage_Read_pData  # Diagnostics Data Import
          CddVoltageMonitor_MaxBatteryVoltage_Read: DcmDspDidIdentifier=64824, DcmDspDidInfoRef=DidInfo_CddVoltageMonitor_MaxBatteryVoltage_Read  # Diagnostics Data Import
            pData (DcmDspDidSignal): DcmDspDidDataPos=0, DcmDspDidDataRef=CddVoltageMonitor_MaxBatteryVoltage_Read_pData  # Diagnostics Data Import
          CddTemperatureMonitor_MinimumTemperature_Read: DcmDspDidIdentifier=64817, DcmDspDidInfoRef=DidInfo_CddTemperatureMonitor_MinimumTemperature_Read  # Diagnostics Data Import
            temperature (DcmDspDidSignal): DcmDspDidDataPos=0, DcmDspDidDataRef=CddTemperatureMonitor_MinimumTemperature_Read_temperature  # Diagnostics Data Import
          CddTemperatureMonitor_MaximumTemperature_Read: DcmDspDidIdentifier=64816, DcmDspDidInfoRef=DidInfo_CddTemperatureMonitor_MaximumTemperature_Read  # Diagnostics Data Import
            temperature (DcmDspDidSignal): DcmDspDidDataPos=0, DcmDspDidDataRef=CddTemperatureMonitor_MaximumTemperature_Read_temperature  # Diagnostics Data Import
          CddBooster_BacklightDutyCycle_Read: DcmDspDidIdentifier=64801, DcmDspDidInfoRef=DidInfo_CddBooster_BacklightDutyCycle_Read  # Diagnostics Data Import
            percentage (DcmDspDidSignal): DcmDspDidDataPos=0, DcmDspDidDataRef=CddBooster_BacklightDutyCycle_Read_percentage  # Diagnostics Data Import
          CddTouchCypressGen7_ManufacturerData_Read: DcmDspDidIdentifier=64794, DcmDspDidInfoRef=DidInfo_CddTouchCypressGen7_ManufacturerData_Read  # Diagnostics Data Import
            manufacturerData (DcmDspDidSignal): DcmDspDidDataPos=0, DcmDspDidDataRef=CddTouchCypressGen7_ManufacturerData_Read_manufacturerData  # Diagnostics Data Import
          CddTouchCypressGen7_SoftwareVersion_Read: DcmDspDidIdentifier=64793, DcmDspDidInfoRef=DidInfo_CddTouchCypressGen7_SoftwareVersion_Read  # Diagnostics Data Import
            swVersion (DcmDspDidSignal): DcmDspDidDataPos=0, DcmDspDidDataRef=CddTouchCypressGen7_SoftwareVersion_Read_swVersion  # Diagnostics Data Import
          CddTouchCypressGen7_HardwareVersion_Read: DcmDspDidIdentifier=64792, DcmDspDidInfoRef=DidInfo_CddTouchCypressGen7_HardwareVersion_Read  # Diagnostics Data Import
            hwVersion (DcmDspDidSignal): DcmDspDidDataPos=0, DcmDspDidDataRef=CddTouchCypressGen7_HardwareVersion_Read_hwVersion  # Diagnostics Data Import
          CddNvMManager_DiagEepromWriteCounter_Read: DcmDspDidIdentifier=64776, DcmDspDidInfoRef=DidInfo_CddNvMManager_DiagEepromWriteCounter_Read  # Diagnostics Data Import
            counter (DcmDspDidSignal): DcmDspDidDataPos=0, DcmDspDidDataRef=CddNvMManager_DiagEepromWriteCounter_Read_counter  # Diagnostics Data Import
          CddConnectionCheck_ConnectionCheck_Read: DcmDspDidIdentifier=64768, DcmDspDidInfoRef=DidInfo_CddConnectionCheck_ConnectionCheck_Read  # Diagnostics Data Import
            pData (DcmDspDidSignal): DcmDspDidDataPos=0, DcmDspDidDataRef=CddConnectionCheck_ConnectionCheck_Read_pData  # Diagnostics Data Import
          ECUProgrammingInformation_Read: DcmDspDidIdentifier=61919, DcmDspDidInfoRef=DidInfo_ECUProgrammingInformation_Read  # Diagnostics Data Import
            Info (DcmDspDidSignal): DcmDspDidDataPos=0, DcmDspDidDataRef=ECUProgrammingInformation_Read_Info  # Diagnostics Data Import
          FDS_Project_Data_Read: DcmDspDidIdentifier=61909, DcmDspDidInfoRef=DidInfo_FDS_Project_Data_Read  # Diagnostics Data Import
            Data (DcmDspDidSignal): DcmDspDidDataPos=0, DcmDspDidDataRef=FDS_Project_Data_Read_Data  # Diagnostics Data Import
          TechnicalSpecificationsVersion_Read: DcmDspDidIdentifier=61876, DcmDspDidInfoRef=DidInfo_TechnicalSpecificationsVersion_Read  # Diagnostics Data Import
            techSpecVer (DcmDspDidSignal): DcmDspDidDataPos=0, DcmDspDidDataRef=TechnicalSpecificationsVersion_Read_techSpecVer  # Diagnostics Data Import
          VWLogicalBlockVersion_Read: DcmDspDidIdentifier=61867, DcmDspDidInfoRef=DidInfo_VWLogicalBlockVersion_Read  # Diagnostics Data Import
            data (DcmDspDidSignal): DcmDspDidDataPos=0, DcmDspDidDataRef=VWLogicalBlockVersion_Read_data  # Diagnostics Data Import
          VWECUHardwareVersionNumber_Read: DcmDspDidIdentifier=61859, DcmDspDidInfoRef=DidInfo_VWECUHardwareVersionNumber_Read  # Diagnostics Data Import
            ecuHwVerNo (DcmDspDidSignal): DcmDspDidDataPos=0, DcmDspDidDataRef=VWECUHardwareVersionNumber_Read_ecuHwVerNo  # Diagnostics Data Import
          ASAMODXFileVersion_Read: DcmDspDidIdentifier=61858, DcmDspDidInfoRef=DidInfo_ASAMODXFileVersion_Read  # Diagnostics Data Import
            asamOdxFileVer (DcmDspDidSignal): DcmDspDidDataPos=0, DcmDspDidDataRef=ASAMODXFileVersion_Read_asamOdxFileVer  # Diagnostics Data Import
          ASAMODXFileIdentifier_Read: DcmDspDidIdentifier=61854, DcmDspDidInfoRef=DidInfo_ASAMODXFileIdentifier_Read  # Diagnostics Data Import
            asamOdxFileId (DcmDspDidSignal): DcmDspDidDataPos=0, DcmDspDidDataRef=ASAMODXFileIdentifier_Read_asamOdxFileId  # Diagnostics Data Import
          VWSystemNameOrEngineType_Read: DcmDspDidIdentifier=61847, DcmDspDidInfoRef=DidInfo_VWSystemNameOrEngineType_Read  # Diagnostics Data Import
            sysNameOrEngType (DcmDspDidSignal): DcmDspDidDataPos=0, DcmDspDidDataRef=VWSystemNameOrEngineType_Read_sysNameOrEngType  # Diagnostics Data Import
          VWECUHardwareNumber_Read: DcmDspDidIdentifier=61841, DcmDspDidInfoRef=DidInfo_VWECUHardwareNumber_Read  # Diagnostics Data Import
            ecuHwNo (DcmDspDidSignal): DcmDspDidDataPos=0, DcmDspDidDataRef=VWECUHardwareNumber_Read_ecuHwNo  # Diagnostics Data Import
          ECUSerialNumber_Read: DcmDspDidIdentifier=61836, DcmDspDidInfoRef=DidInfo_ECUSerialNumber_Read  # Diagnostics Data Import
            ecuSerNo (DcmDspDidSignal): DcmDspDidDataPos=0, DcmDspDidDataRef=ECUSerialNumber_Read_ecuSerNo  # Diagnostics Data Import
          VWApplicationSoftwareVersionNumber_Read: DcmDspDidIdentifier=61833, DcmDspDidInfoRef=DidInfo_VWApplicationSoftwareVersionNumber_Read  # Diagnostics Data Import
            appSwVersion (DcmDspDidSignal): DcmDspDidDataPos=0, DcmDspDidDataRef=VWApplicationSoftwareVersionNumber_Read_appSwVersion  # Diagnostics Data Import
          VWSparePartNumber_Read: DcmDspDidIdentifier=61831, DcmDspDidInfoRef=DidInfo_VWSparePartNumber_Read  # Diagnostics Data Import
            sparePartNr (DcmDspDidSignal): DcmDspDidDataPos=0, DcmDspDidDataRef=VWSparePartNumber_Read_sparePartNr  # Diagnostics Data Import
          ActiveDiagnosticSession_Read: DcmDspDidIdentifier=61830, DcmDspDidInfoRef=DidInfo_ActiveDiagnosticSession_Read  # Diagnostics Data Import
            Session (DcmDspDidSignal): DcmDspDidDataPos=0, DcmDspDidDataRef=ActiveDiagnosticSession_Read_Session  # Diagnostics Data Import
          VWFAZITIdentificationString_Read: DcmDspDidIdentifier=61820, DcmDspDidInfoRef=DidInfo_VWFAZITIdentificationString_Read  # Diagnostics Data Import
            fazitIdString (DcmDspDidSignal): DcmDspDidDataPos=0, DcmDspDidDataRef=VWFAZITIdentificationString_Read_fazitIdString  # Diagnostics Data Import
          FingerprintLogicalBlock_Read: DcmDspDidIdentifier=61787, DcmDspDidInfoRef=DidInfo_FingerprintLogicalBlock_Read  # Diagnostics Data Import
            data (DcmDspDidSignal): DcmDspDidDataPos=0, DcmDspDidDataRef=FingerprintLogicalBlock_Read_data  # Diagnostics Data Import
          Fingerprint_Read: DcmDspDidIdentifier=61786, DcmDspDidInfoRef=DidInfo_Fingerprint_Read  # Diagnostics Data Import
            data (DcmDspDidSignal): DcmDspDidDataPos=0, DcmDspDidDataRef=Fingerprint_Read_data  # Diagnostics Data Import
          SwcTestInterface_DeveloperMode_Read: DcmDspDidIdentifier=9279, DcmDspDidInfoRef=DidInfo_SwcTestInterface_DeveloperMode_Read  # Diagnostics Data Import
            developerMode (DcmDspDidSignal): DcmDspDidDataPos=0, DcmDspDidDataRef=SwcTestInterface_DeveloperMode_Read_developerMode  # Diagnostics Data Import
          CddNvmManager_NvmDisplayDimLutNight_Read: DcmDspDidIdentifier=2887, DcmDspDidInfoRef=DidInfo_CddNvmManager_NvmDisplayDimLutNight_Read  # Diagnostics Data Import
            data (DcmDspDidSignal): DcmDspDidDataPos=0, DcmDspDidDataRef=CddNvmManager_NvmDisplayDimLutNight_Read_data  # Diagnostics Data Import
          CddNvmManager_NvmSliderDimLut_Read: DcmDspDidIdentifier=2885, DcmDspDidInfoRef=DidInfo_CddNvmManager_NvmSliderDimLut_Read  # Diagnostics Data Import
            data (DcmDspDidSignal): DcmDspDidDataPos=0, DcmDspDidDataRef=CddNvmManager_NvmSliderDimLut_Read_data  # Diagnostics Data Import
          CddNvmManager_NvmDisplayDimLutDay_Read: DcmDspDidIdentifier=1408, DcmDspDidInfoRef=DidInfo_CddNvmManager_NvmDisplayDimLutDay_Read  # Diagnostics Data Import
            data (DcmDspDidSignal): DcmDspDidDataPos=0, DcmDspDidDataRef=CddNvmManager_NvmDisplayDimLutDay_Read_data  # Diagnostics Data Import
          CddTouchCypressGen7_SlideTouchConfiguration_Read: DcmDspDidIdentifier=1321, DcmDspDidInfoRef=DidInfo_CddTouchCypressGen7_SlideTouchConfiguration_Read  # Diagnostics Data Import
            pData (DcmDspDidSignal): DcmDspDidDataPos=0, DcmDspDidDataRef=CddTouchCypressGen7_SlideTouchConfiguration_Read_pData  # Diagnostics Data Import
          CddTouchCypressGen7_DisplayTouchConfiguration_Read: DcmDspDidIdentifier=1320, DcmDspDidInfoRef=DidInfo_CddTouchCypressGen7_DisplayTouchConfiguration_Read  # Diagnostics Data Import
            pData (DcmDspDidSignal): DcmDspDidDataPos=0, DcmDspDidDataRef=CddTouchCypressGen7_DisplayTouchConfiguration_Read_pData  # Diagnostics Data Import
          ProgrammingPreconditions_Read: DcmDspDidIdentifier=1096, DcmDspDidInfoRef=DidInfo_ProgrammingPreconditions_Read  # Diagnostics Data Import
            ProgrammingPreconditions (DcmDspDidSignal): DcmDspDidDataPos=0, DcmDspDidDataRef=ProgrammingPreconditions_Read_ProgrammingPreconditions  # Diagnostics Data Import
          BootloaderTPBlocksize_Read: DcmDspDidIdentifier=1040, DcmDspDidInfoRef=DidInfo_BootloaderTPBlocksize_Read  # Diagnostics Data Import
            Blocksize (DcmDspDidSignal): DcmDspDidDataPos=0, DcmDspDidDataRef=BootloaderTPBlocksize_Read_Blocksize  # Diagnostics Data Import
          VWLogicalBlockLockValue_Read: DcmDspDidIdentifier=1039, DcmDspDidInfoRef=DidInfo_VWLogicalBlockLockValue_Read  # Diagnostics Data Import
            data (DcmDspDidSignal): DcmDspDidDataPos=0, DcmDspDidDataRef=VWLogicalBlockLockValue_Read_data  # Diagnostics Data Import
          VWLogicalBlockCounterOfProgrammingAttempts_Read: DcmDspDidIdentifier=1031, DcmDspDidInfoRef=DidInfo_VWLogicalBlockCounterOfProgrammingAttempts_Read  # Diagnostics Data Import
            data (DcmDspDidSignal): DcmDspDidDataPos=0, DcmDspDidDataRef=VWLogicalBlockCounterOfProgrammingAttempts_Read_data  # Diagnostics Data Import
          Integrity_validation_data_configuration_list_Read: DcmDspDidIdentifier=592, DcmDspDidInfoRef=DidInfo_Integrity_validation_data_configuration_list_Read  # Diagnostics Data Import
            Data (DcmDspDidSignal): DcmDspDidDataPos=0, DcmDspDidDataRef=Integrity_validation_data_configuration_list_Read_Data  # Diagnostics Data Import
          Programming_hash_Read: DcmDspDidIdentifier=585, DcmDspDidInfoRef=DidInfo_Programming_hash_Read  # Diagnostics Data Import
            Data (DcmDspDidSignal): DcmDspDidDataPos=0, DcmDspDidDataRef=Programming_hash_Read_Data  # Diagnostics Data Import
          Configuration_hash_Read: DcmDspDidIdentifier=581, DcmDspDidInfoRef=DidInfo_Configuration_hash_Read  # Diagnostics Data Import
            Data (DcmDspDidSignal): DcmDspDidDataPos=0, DcmDspDidDataRef=Configuration_hash_Read_Data  # Diagnostics Data Import
          VWLogicalBlockDowngradeVersions_Read: DcmDspDidIdentifier=393, DcmDspDidInfoRef=DidInfo_VWLogicalBlockDowngradeVersions_Read  # Diagnostics Data Import
            data (DcmDspDidSignal): DcmDspDidDataPos=0, DcmDspDidDataRef=VWLogicalBlockDowngradeVersions_Read_data  # Diagnostics Data Import
          BasicSettingsStatus_Read: DcmDspDidIdentifier=258, DcmDspDidInfoRef=DidInfo_BasicSettingsStatus_Read  # Diagnostics Data Import
            Status (DcmDspDidSignal): DcmDspDidDataPos=0, DcmDspDidDataRef=BasicSettingsStatus_Read_Status  # Diagnostics Data Import
        DataInfo_SwcDisplayInfo_HardwareIdentification_Read_hwId (DcmDspDataInfo): DcmDspDataFixedLength=true  # Diagnostics Data Import
        SwcDisplayInfo_HardwareIdentification_Read_hwId (DcmDspData): DcmDspDataSize=416, DcmDspDataType=UINT8_N, DcmDspDataInfoRef=DataInfo_SwcDisplayInfo_HardwareIdentification_Read_hwId  # Diagnostics Data Import
        DataInfo_SwcDisplayInfo_SvnRevision_Read_svnRevision (DcmDspDataInfo): DcmDspDataFixedLength=true  # Diagnostics Data Import
        SwcDisplayInfo_SvnRevision_Read_svnRevision (DcmDspData): DcmDspDataSize=512, DcmDspDataType=UINT8_N, DcmDspDataInfoRef=DataInfo_SwcDisplayInfo_SvnRevision_Read_svnRevision  # Diagnostics Data Import
        DataInfo_SwcDisplayInfo_SvnUrl_Read_svnUrl (DcmDspDataInfo): DcmDspDataFixedLength=true  # Diagnostics Data Import
        SwcDisplayInfo_SvnUrl_Read_svnUrl (DcmDspData): DcmDspDataSize=2048, DcmDspDataType=UINT8_N, DcmDspDataInfoRef=DataInfo_SwcDisplayInfo_SvnUrl_Read_svnUrl  # Diagnostics Data Import
        DataInfo_SwcDisplayInfo_ApplicationSoftwareVersion_Read_appSwVersion (DcmDspDataInfo): DcmDspDataFixedLength=true  # Diagnostics Data Import
        SwcDisplayInfo_ApplicationSoftwareVersion_Read_appSwVersion (DcmDspData): DcmDspDataSize=128, DcmDspDataType=UINT8_N, DcmDspDataInfoRef=DataInfo_SwcDisplayInfo_ApplicationSoftwareVersion_Read_appSwVersion  # Diagnostics Data Import
        DataInfo_SwcDisplayInfo_DisplayHardwareVersion_Read_dispHwVersion (DcmDspDataInfo): DcmDspDataFixedLength=true  # Diagnostics Data Import
        SwcDisplayInfo_DisplayHardwareVersion_Read_dispHwVersion (DcmDspData): DcmDspDataSize=128, DcmDspDataType=UINT8_N, DcmDspDataInfoRef=DataInfo_SwcDisplayInfo_DisplayHardwareVersion_Read_dispHwVersion  # Diagnostics Data Import
        DataInfo_SwcDisplayInfo_DisplayVariant_Read_dispVariant (DcmDspDataInfo): DcmDspDataFixedLength=true  # Diagnostics Data Import
        SwcDisplayInfo_DisplayVariant_Read_dispVariant (DcmDspData): DcmDspDataSize=512, DcmDspDataType=UINT8_N, DcmDspDataInfoRef=DataInfo_SwcDisplayInfo_DisplayVariant_Read_dispVariant  # Diagnostics Data Import
        DataInfo_SwcDisplayInfo_DisplayName_Read_dispName (DcmDspDataInfo): DcmDspDataFixedLength=true  # Diagnostics Data Import
        SwcDisplayInfo_DisplayName_Read_dispName (DcmDspData): DcmDspDataSize=512, DcmDspDataType=UINT8_N, DcmDspDataInfoRef=DataInfo_SwcDisplayInfo_DisplayName_Read_dispName  # Diagnostics Data Import
        DataInfo_SwcComHandlerTx_PropEepromWriteCounter_Read_counter (DcmDspDataInfo): DcmDspDataFixedLength=true  # Diagnostics Data Import
        SwcComHandlerTx_PropEepromWriteCounter_Read_counter (DcmDspData): DcmDspDataSize=16, DcmDspDataType=UINT16, DcmDspDataInfoRef=DataInfo_SwcComHandlerTx_PropEepromWriteCounter_Read_counter  # Diagnostics Data Import
        DataInfo_SwcVerify_VerifyEnable_Read_verifyMode (DcmDspDataInfo): DcmDspDataFixedLength=true  # Diagnostics Data Import
        SwcVerify_VerifyEnable_Read_verifyMode (DcmDspData): DcmDspDataSize=8, DcmDspDataType=UINT8, DcmDspDataInfoRef=DataInfo_SwcVerify_VerifyEnable_Read_verifyMode  # Diagnostics Data Import
        DataInfo_SwcSelfDiagnostics_CpuLoad_Read_pData (DcmDspDataInfo): DcmDspDataFixedLength=true  # Diagnostics Data Import
        SwcSelfDiagnostics_CpuLoad_Read_pData (DcmDspData): DcmDspDataSize=16, DcmDspDataType=UINT16, DcmDspDataInfoRef=DataInfo_SwcSelfDiagnostics_CpuLoad_Read_pData  # Diagnostics Data Import
        DataInfo_SwcSelfDiagnostics_EcuRuntime_Read_ecuRuntime (DcmDspDataInfo): DcmDspDataFixedLength=true  # Diagnostics Data Import
        SwcSelfDiagnostics_EcuRuntime_Read_ecuRuntime (DcmDspData): DcmDspDataSize=32, DcmDspDataType=UINT32, DcmDspDataInfoRef=DataInfo_SwcSelfDiagnostics_EcuRuntime_Read_ecuRuntime  # Diagnostics Data Import
        DataInfo_SwcDimming_SliderDimmingOutPwm_Read_data (DcmDspDataInfo): DcmDspDataFixedLength=true  # Diagnostics Data Import
        SwcDimming_SliderDimmingOutPwm_Read_data (DcmDspData): DcmDspDataSize=32, DcmDspDataType=UINT8_N, DcmDspDataInfoRef=DataInfo_SwcDimming_SliderDimmingOutPwm_Read_data  # Diagnostics Data Import
        DataInfo_SwcDimming_DisplayDimmingOutPwm_Read_data (DcmDspDataInfo): DcmDspDataFixedLength=true  # Diagnostics Data Import
        SwcDimming_DisplayDimmingOutPwm_Read_data (DcmDspData): DcmDspDataSize=32, DcmDspDataType=UINT8_N, DcmDspDataInfoRef=DataInfo_SwcDimming_DisplayDimmingOutPwm_Read_data  # Diagnostics Data Import
        DataInfo_SwcDimming_DisplayDimmingOutPostOffset_Read_data (DcmDspDataInfo): DcmDspDataFixedLength=true  # Diagnostics Data Import
        SwcDimming_DisplayDimmingOutPostOffset_Read_data (DcmDspData): DcmDspDataSize=32, DcmDspDataType=UINT8_N, DcmDspDataInfoRef=DataInfo_SwcDimming_DisplayDimmingOutPostOffset_Read_data  # Diagnostics Data Import
        DataInfo_SwcDimming_DisplayDimmingOutPreOffset_Read_data (DcmDspDataInfo): DcmDspDataFixedLength=true  # Diagnostics Data Import
        SwcDimming_DisplayDimmingOutPreOffset_Read_data (DcmDspData): DcmDspDataSize=32, DcmDspDataType=UINT8_N, DcmDspDataInfoRef=DataInfo_SwcDimming_DisplayDimmingOutPreOffset_Read_data  # Diagnostics Data Import
        DataInfo_CddCodeFlashAccess_ResetVector_Read_ResetVector (DcmDspDataInfo): DcmDspDataFixedLength=true  # Diagnostics Data Import
        CddCodeFlashAccess_ResetVector_Read_ResetVector (DcmDspData): DcmDspDataSize=32, DcmDspDataType=UINT32, DcmDspDataInfoRef=DataInfo_CddCodeFlashAccess_ResetVector_Read_ResetVector  # Diagnostics Data Import
        DataInfo_CddWakeupDetect_ResetCounters_Read_rstCntrs (DcmDspDataInfo): DcmDspDataFixedLength=true  # Diagnostics Data Import
        CddWakeupDetect_ResetCounters_Read_rstCntrs (DcmDspData): DcmDspDataSize=144, DcmDspDataType=UINT8_N, DcmDspDataInfoRef=DataInfo_CddWakeupDetect_ResetCounters_Read_rstCntrs  # Diagnostics Data Import
        DataInfo_CddSliderBackLightTiSN1903001_BacklightDutyCycle_Read_percentage (DcmDspDataInfo): DcmDspDataFixedLength=true  # Diagnostics Data Import
        CddSliderBackLightTiSN1903001_BacklightDutyCycle_Read_percentage (DcmDspData): DcmDspDataSize=16, DcmDspDataType=UINT16, DcmDspDataInfoRef=DataInfo_CddSliderBackLightTiSN1903001_BacklightDutyCycle_Read_percentage  # Diagnostics Data Import
        DataInfo_CddVoltageMonitor_MinBatteryVoltage_Read_pData (DcmDspDataInfo): DcmDspDataFixedLength=true  # Diagnostics Data Import
        CddVoltageMonitor_MinBatteryVoltage_Read_pData (DcmDspData): DcmDspDataSize=8, DcmDspDataType=UINT8, DcmDspDataInfoRef=DataInfo_CddVoltageMonitor_MinBatteryVoltage_Read_pData  # Diagnostics Data Import
        DataInfo_CddVoltageMonitor_MaxBatteryVoltage_Read_pData (DcmDspDataInfo): DcmDspDataFixedLength=true  # Diagnostics Data Import
        CddVoltageMonitor_MaxBatteryVoltage_Read_pData (DcmDspData): DcmDspDataSize=8, DcmDspDataType=UINT8, DcmDspDataInfoRef=DataInfo_CddVoltageMonitor_MaxBatteryVoltage_Read_pData  # Diagnostics Data Import
        DataInfo_CddTemperatureMonitor_MinimumTemperature_Read_temperature (DcmDspDataInfo): DcmDspDataFixedLength=true  # Diagnostics Data Import
        CddTemperatureMonitor_MinimumTemperature_Read_temperature (DcmDspData): DcmDspDataSize=8, DcmDspDataType=SINT8, DcmDspDataInfoRef=DataInfo_CddTemperatureMonitor_MinimumTemperature_Read_temperature  # Diagnostics Data Import
        DataInfo_CddTemperatureMonitor_MaximumTemperature_Read_temperature (DcmDspDataInfo): DcmDspDataFixedLength=true  # Diagnostics Data Import
        CddTemperatureMonitor_MaximumTemperature_Read_temperature (DcmDspData): DcmDspDataSize=8, DcmDspDataType=SINT8, DcmDspDataInfoRef=DataInfo_CddTemperatureMonitor_MaximumTemperature_Read_temperature  # Diagnostics Data Import
        DataInfo_CddBooster_BacklightDutyCycle_Read_percentage (DcmDspDataInfo): DcmDspDataFixedLength=true  # Diagnostics Data Import
        CddBooster_BacklightDutyCycle_Read_percentage (DcmDspData): DcmDspDataSize=16, DcmDspDataType=UINT16, DcmDspDataInfoRef=DataInfo_CddBooster_BacklightDutyCycle_Read_percentage  # Diagnostics Data Import
        DataInfo_CddTouchCypressGen7_ManufacturerData_Read_manufacturerData (DcmDspDataInfo): DcmDspDataFixedLength=true  # Diagnostics Data Import
        CddTouchCypressGen7_ManufacturerData_Read_manufacturerData (DcmDspData): DcmDspDataSize=80, DcmDspDataType=UINT8_N, DcmDspDataInfoRef=DataInfo_CddTouchCypressGen7_ManufacturerData_Read_manufacturerData  # Diagnostics Data Import
        DataInfo_CddTouchCypressGen7_SoftwareVersion_Read_swVersion (DcmDspDataInfo): DcmDspDataFixedLength=true  # Diagnostics Data Import
        CddTouchCypressGen7_SoftwareVersion_Read_swVersion (DcmDspData): DcmDspDataSize=128, DcmDspDataType=UINT8_N, DcmDspDataInfoRef=DataInfo_CddTouchCypressGen7_SoftwareVersion_Read_swVersion  # Diagnostics Data Import
        DataInfo_CddTouchCypressGen7_HardwareVersion_Read_hwVersion (DcmDspDataInfo): DcmDspDataFixedLength=true  # Diagnostics Data Import
        CddTouchCypressGen7_HardwareVersion_Read_hwVersion (DcmDspData): DcmDspDataSize=32, DcmDspDataType=UINT8_N, DcmDspDataInfoRef=DataInfo_CddTouchCypressGen7_HardwareVersion_Read_hwVersion  # Diagnostics Data Import
        DataInfo_CddNvMManager_DiagEepromWriteCounter_Read_counter (DcmDspDataInfo): DcmDspDataFixedLength=true  # Diagnostics Data Import
        CddNvMManager_DiagEepromWriteCounter_Read_counter (DcmDspData): DcmDspDataSize=16, DcmDspDataType=UINT16, DcmDspDataInfoRef=DataInfo_CddNvMManager_DiagEepromWriteCounter_Read_counter  # Diagnostics Data Import
        DataInfo_CddConnectionCheck_ConnectionCheck_Read_pData (DcmDspDataInfo): DcmDspDataFixedLength=true  # Diagnostics Data Import
        CddConnectionCheck_ConnectionCheck_Read_pData (DcmDspData): DcmDspDataSize=40, DcmDspDataType=UINT8_N, DcmDspDataInfoRef=DataInfo_CddConnectionCheck_ConnectionCheck_Read_pData  # Diagnostics Data Import
        DataInfo_ECUProgrammingInformation_Read_Info (DcmDspDataInfo): DcmDspDataFixedLength=true  # Diagnostics Data Import
        ECUProgrammingInformation_Read_Info (DcmDspData): DcmDspDataSize=8, DcmDspDataType=UINT8, DcmDspDataInfoRef=DataInfo_ECUProgrammingInformation_Read_Info  # Diagnostics Data Import
        DataInfo_FDS_Project_Data_Read_Data (DcmDspDataInfo): DcmDspDataFixedLength=true  # Diagnostics Data Import
        FDS_Project_Data_Read_Data (DcmDspData): DcmDspDataSize=312, DcmDspDataType=UINT8_N, DcmDspDataInfoRef=DataInfo_FDS_Project_Data_Read_Data  # Diagnostics Data Import
        DataInfo_TechnicalSpecificationsVersion_Read_techSpecVer (DcmDspDataInfo): DcmDspDataFixedLength=true  # Diagnostics Data Import
        TechnicalSpecificationsVersion_Read_techSpecVer (DcmDspData): DcmDspDataSize=208, DcmDspDataType=UINT8_N, DcmDspDataInfoRef=DataInfo_TechnicalSpecificationsVersion_Read_techSpecVer  # Diagnostics Data Import
        DataInfo_VWLogicalBlockVersion_Read_data (DcmDspDataInfo): DcmDspDataFixedLength=true  # Diagnostics Data Import
        VWLogicalBlockVersion_Read_data (DcmDspData): DcmDspDataSize=192, DcmDspDataType=UINT8_N, DcmDspDataInfoRef=DataInfo_VWLogicalBlockVersion_Read_data  # Diagnostics Data Import
        DataInfo_VWECUHardwareVersionNumber_Read_ecuHwVerNo (DcmDspDataInfo): DcmDspDataFixedLength=true  # Diagnostics Data Import
        VWECUHardwareVersionNumber_Read_ecuHwVerNo (DcmDspData): DcmDspDataSize=24, DcmDspDataType=UINT8_N, DcmDspDataInfoRef=DataInfo_VWECUHardwareVersionNumber_Read_ecuHwVerNo  # Diagnostics Data Import
        DataInfo_ASAMODXFileVersion_Read_asamOdxFileVer (DcmDspDataInfo): DcmDspDataFixedLength=true  # Diagnostics Data Import
        ASAMODXFileVersion_Read_asamOdxFileVer (DcmDspData): DcmDspDataSize=48, DcmDspDataType=UINT8_N, DcmDspDataInfoRef=DataInfo_ASAMODXFileVersion_Read_asamOdxFileVer  # Diagnostics Data Import
        DataInfo_ASAMODXFileIdentifier_Read_asamOdxFileId (DcmDspDataInfo): DcmDspDataFixedLength=false  # Diagnostics Data Import
        ASAMODXFileIdentifier_Read_asamOdxFileId (DcmDspData): DcmDspDataSize=208, DcmDspDataType=UINT8_N, DcmDspDataInfoRef=DataInfo_ASAMODXFileIdentifier_Read_asamOdxFileId  # Diagnostics Data Import
        DataInfo_VWSystemNameOrEngineType_Read_sysNameOrEngType (DcmDspDataInfo): DcmDspDataFixedLength=true  # Diagnostics Data Import
        VWSystemNameOrEngineType_Read_sysNameOrEngType (DcmDspData): DcmDspDataSize=104, DcmDspDataType=UINT8_N, DcmDspDataInfoRef=DataInfo_VWSystemNameOrEngineType_Read_sysNameOrEngType  # Diagnostics Data Import
        DataInfo_VWECUHardwareNumber_Read_ecuHwNo (DcmDspDataInfo): DcmDspDataFixedLength=true  # Diagnostics Data Import
        VWECUHardwareNumber_Read_ecuHwNo (DcmDspData): DcmDspDataSize=88, DcmDspDataType=UINT8_N, DcmDspDataInfoRef=DataInfo_VWECUHardwareNumber_Read_ecuHwNo  # Diagnostics Data Import
        DataInfo_ECUSerialNumber_Read_ecuSerNo (DcmDspDataInfo): DcmDspDataFixedLength=true  # Diagnostics Data Import
        ECUSerialNumber_Read_ecuSerNo (DcmDspData): DcmDspDataSize=160, DcmDspDataType=UINT8_N, DcmDspDataInfoRef=DataInfo_ECUSerialNumber_Read_ecuSerNo  # Diagnostics Data Import
        DataInfo_VWApplicationSoftwareVersionNumber_Read_appSwVersion (DcmDspDataInfo): DcmDspDataFixedLength=true  # Diagnostics Data Import
        VWApplicationSoftwareVersionNumber_Read_appSwVersion (DcmDspData): DcmDspDataSize=32, DcmDspDataType=UINT8_N, DcmDspDataInfoRef=DataInfo_VWApplicationSoftwareVersionNumber_Read_appSwVersion  # Diagnostics Data Import
        DataInfo_VWSparePartNumber_Read_sparePartNr (DcmDspDataInfo): DcmDspDataFixedLength=true  # Diagnostics Data Import
        VWSparePartNumber_Read_sparePartNr (DcmDspData): DcmDspDataSize=88, DcmDspDataType=UINT8_N, DcmDspDataInfoRef=DataInfo_VWSparePartNumber_Read_sparePartNr  # Diagnostics Data Import
        DataInfo_ActiveDiagnosticSession_Read_Session (DcmDspDataInfo): DcmDspDataFixedLength=true  # Diagnostics Data Import
        ActiveDiagnosticSession_Read_Session (DcmDspData): DcmDspDataSize=8, DcmDspDataType=UINT8, DcmDspDataInfoRef=DataInfo_ActiveDiagnosticSession_Read_Session  # Diagnostics Data Import
        DataInfo_VWFAZITIdentificationString_Read_fazitIdString (DcmDspDataInfo): DcmDspDataFixedLength=true  # Diagnostics Data Import
        VWFAZITIdentificationString_Read_fazitIdString (DcmDspData): DcmDspDataSize=184, DcmDspDataType=UINT8_N, DcmDspDataInfoRef=DataInfo_VWFAZITIdentificationString_Read_fazitIdString  # Diagnostics Data Import
        DataInfo_FingerprintLogicalBlock_Read_data (DcmDspDataInfo): DcmDspDataFixedLength=true  # Diagnostics Data Import
        FingerprintLogicalBlock_Read_data (DcmDspData): DcmDspDataSize=480, DcmDspDataType=UINT8_N, DcmDspDataInfoRef=DataInfo_FingerprintLogicalBlock_Read_data  # Diagnostics Data Import
        DataInfo_Fingerprint_Read_data (DcmDspDataInfo): DcmDspDataFixedLength=true  # Diagnostics Data Import
        Fingerprint_Read_data (DcmDspData): DcmDspDataSize=72, DcmDspDataType=UINT8_N, DcmDspDataInfoRef=DataInfo_Fingerprint_Read_data  # Diagnostics Data Import
        DataInfo_SwcTestInterface_DeveloperMode_Read_developerMode (DcmDspDataInfo): DcmDspDataFixedLength=true  # Diagnostics Data Import
        SwcTestInterface_DeveloperMode_Read_developerMode (DcmDspData): DcmDspDataSize=8, DcmDspDataType=UINT8, DcmDspDataInfoRef=DataInfo_SwcTestInterface_DeveloperMode_Read_developerMode  # Diagnostics Data Import
        DataInfo_CddNvmManager_NvmDisplayDimLutNight_Read_data (DcmDspDataInfo): DcmDspDataFixedLength=true  # Diagnostics Data Import
        CddNvmManager_NvmDisplayDimLutNight_Read_data (DcmDspData): DcmDspDataSize=144, DcmDspDataType=UINT8_N, DcmDspDataInfoRef=DataInfo_CddNvmManager_NvmDisplayDimLutNight_Read_data  # Diagnostics Data Import
        DataInfo_CddNvmManager_NvmSliderDimLut_Read_data (DcmDspDataInfo): DcmDspDataFixedLength=true  # Diagnostics Data Import
        CddNvmManager_NvmSliderDimLut_Read_data (DcmDspData): DcmDspDataSize=48, DcmDspDataType=UINT8_N, DcmDspDataInfoRef=DataInfo_CddNvmManager_NvmSliderDimLut_Read_data  # Diagnostics Data Import
        DataInfo_CddNvmManager_NvmDisplayDimLutDay_Read_data (DcmDspDataInfo): DcmDspDataFixedLength=true  # Diagnostics Data Import
        CddNvmManager_NvmDisplayDimLutDay_Read_data (DcmDspData): DcmDspDataSize=144, DcmDspDataType=UINT8_N, DcmDspDataInfoRef=DataInfo_CddNvmManager_NvmDisplayDimLutDay_Read_data  # Diagnostics Data Import
        DataInfo_CddTouchCypressGen7_SlideTouchConfiguration_Read_pData (DcmDspDataInfo): DcmDspDataFixedLength=true  # Diagnostics Data Import
        CddTouchCypressGen7_SlideTouchConfiguration_Read_pData (DcmDspData): DcmDspDataSize=160, DcmDspDataType=UINT8_N, DcmDspDataInfoRef=DataInfo_CddTouchCypressGen7_SlideTouchConfiguration_Read_pData  # Diagnostics Data Import
        DataInfo_CddTouchCypressGen7_DisplayTouchConfiguration_Read_pData (DcmDspDataInfo): DcmDspDataFixedLength=true  # Diagnostics Data Import
        CddTouchCypressGen7_DisplayTouchConfiguration_Read_pData (DcmDspData): DcmDspDataSize=480, DcmDspDataType=UINT8_N, DcmDspDataInfoRef=DataInfo_CddTouchCypressGen7_DisplayTouchConfiguration_Read_pData  # Diagnostics Data Import
        DataInfo_ProgrammingPreconditions_Read_ProgrammingPreconditions (DcmDspDataInfo): DcmDspDataFixedLength=true  # Diagnostics Data Import
        ProgrammingPreconditions_Read_ProgrammingPreconditions (DcmDspData): DcmDspDataSize=16, DcmDspDataType=UINT8_N, DcmDspDataInfoRef=DataInfo_ProgrammingPreconditions_Read_ProgrammingPreconditions  # Diagnostics Data Import
        DataInfo_BootloaderTPBlocksize_Read_Blocksize (DcmDspDataInfo): DcmDspDataFixedLength=true  # Diagnostics Data Import
        BootloaderTPBlocksize_Read_Blocksize (DcmDspData): DcmDspDataSize=8, DcmDspDataType=UINT8, DcmDspDataInfoRef=DataInfo_BootloaderTPBlocksize_Read_Blocksize  # Diagnostics Data Import
        DataInfo_VWLogicalBlockLockValue_Read_data (DcmDspDataInfo): DcmDspDataFixedLength=true  # Diagnostics Data Import
        VWLogicalBlockLockValue_Read_data (DcmDspData): DcmDspDataSize=96, DcmDspDataType=UINT8_N, DcmDspDataInfoRef=DataInfo_VWLogicalBlockLockValue_Read_data  # Diagnostics Data Import
        DataInfo_VWLogicalBlockCounterOfProgrammingAttempts_Read_data (DcmDspDataInfo): DcmDspDataFixedLength=true  # Diagnostics Data Import
        VWLogicalBlockCounterOfProgrammingAttempts_Read_data (DcmDspData): DcmDspDataSize=96, DcmDspDataType=UINT8_N, DcmDspDataInfoRef=DataInfo_VWLogicalBlockCounterOfProgrammingAttempts_Read_data  # Diagnostics Data Import
        DataInfo_Integrity_validation_data_configuration_list_Read_Data (DcmDspDataInfo): DcmDspDataFixedLength=false  # Diagnostics Data Import
        Integrity_validation_data_configuration_list_Read_Data (DcmDspData): DcmDspDataSize=32736, DcmDspDataType=UINT8_N, DcmDspDataInfoRef=DataInfo_Integrity_validation_data_configuration_list_Read_Data  # Diagnostics Data Import
        DataInfo_Programming_hash_Read_Data (DcmDspDataInfo): DcmDspDataFixedLength=true  # Diagnostics Data Import
        Programming_hash_Read_Data (DcmDspData): DcmDspDataSize=256, DcmDspDataType=UINT8_N, DcmDspDataInfoRef=DataInfo_Programming_hash_Read_Data  # Diagnostics Data Import
        DataInfo_Configuration_hash_Read_Data (DcmDspDataInfo): DcmDspDataFixedLength=true  # Diagnostics Data Import
        Configuration_hash_Read_Data (DcmDspData): DcmDspDataSize=256, DcmDspDataType=UINT8_N, DcmDspDataInfoRef=DataInfo_Configuration_hash_Read_Data  # Diagnostics Data Import
        DataInfo_VWLogicalBlockDowngradeVersions_Read_data (DcmDspDataInfo): DcmDspDataFixedLength=true  # Diagnostics Data Import
        VWLogicalBlockDowngradeVersions_Read_data (DcmDspData): DcmDspDataSize=392, DcmDspDataType=UINT8_N, DcmDspDataInfoRef=DataInfo_VWLogicalBlockDowngradeVersions_Read_data  # Diagnostics Data Import
        DataInfo_BasicSettingsStatus_Read_Status (DcmDspDataInfo): DcmDspDataFixedLength=true  # Diagnostics Data Import
        BasicSettingsStatus_Read_Status (DcmDspData): DcmDspDataSize=8, DcmDspDataType=UINT8, DcmDspDataInfoRef=DataInfo_BasicSettingsStatus_Read_Status  # Diagnostics Data Import
      DcmDsd  # Diagnostics Data Import
        DcmDsdServiceTable  # Diagnostics Data Import
          14 x DcmDsdService:
            ControlDtcSetting: DcmDsdSidTabServiceId=133, DcmDsdSidTabSubfuncAvail=true, DcmDsdSidTabSessionLevelRef=DcmDspSession/Programming, DcmDsdSidTabSessionLevelRef=DcmDspSession/Extended, DcmDsdSidTabSessionLevelRef=INX_End_Of_Line_Session, DcmDsdSidTabSessionLevelRef=INX_Development_Session  # Diagnostics Data Import
              Disable (DcmDsdSubService):  # Diagnostics Data Import
                DcmDsdSubServiceId = 2
                DcmDsdSubServiceSessionLevelRef = DcmDspSession/Programming
                DcmDsdSubServiceSessionLevelRef = DcmDspSession/Extended
                DcmDsdSubServiceSessionLevelRef = INX_End_Of_Line_Session
                DcmDsdSubServiceSessionLevelRef = INX_Development_Session
              Enable (DcmDsdSubService):  # Diagnostics Data Import
                DcmDsdSubServiceId = 1
                DcmDsdSubServiceSessionLevelRef = DcmDspSession/Programming
                DcmDsdSubServiceSessionLevelRef = DcmDspSession/Extended
                DcmDsdSubServiceSessionLevelRef = INX_End_Of_Line_Session
                DcmDsdSubServiceSessionLevelRef = INX_Development_Session
            TesterPresent: DcmDsdSidTabServiceId=62, DcmDsdSidTabSubfuncAvail=true  # Diagnostics Data Import
              TesterPresent (DcmDsdSubService): DcmDsdSubServiceId=0  # Diagnostics Data Import
            RequestTransferExit: DcmDsdSidTabServiceId=55, DcmDsdSidTabSubfuncAvail=false, DcmDsdSidTabSessionLevelRef=DcmDspSession/Programming, DcmDsdSidTabSecurityLevelRef=Level_17  # Diagnostics Data Import
            TransferData: DcmDsdSidTabServiceId=54, DcmDsdSidTabSubfuncAvail=false, DcmDsdSidTabSessionLevelRef=DcmDspSession/Programming, DcmDsdSidTabSecurityLevelRef=Level_17  # Diagnostics Data Import
            RequestDownload: DcmDsdSidTabServiceId=52, DcmDsdSidTabSubfuncAvail=false, DcmDsdSidTabSessionLevelRef=DcmDspSession/Programming, DcmDsdSidTabSecurityLevelRef=Level_17  # Diagnostics Data Import
            RoutineControl: DcmDsdSidTabServiceId=49, DcmDsdSidTabSubfuncAvail=true  # Diagnostics Data Import
            WriteDataById: DcmDsdSidTabServiceId=46, DcmDsdSidTabSubfuncAvail=false, DcmDsdSidTabSessionLevelRef=DcmDspSession/Programming, DcmDsdSidTabSessionLevelRef=DcmDspSession/Extended, DcmDsdSidTabSessionLevelRef=INX_End_Of_Line_Session, DcmDsdSidTabSessionLevelRef=INX_Development_Session  # Diagnostics Data Import
            CommunicationControl: DcmDsdSidTabServiceId=40, DcmDsdSidTabSubfuncAvail=true, DcmDsdSidTabSessionLevelRef=DcmDspSession/Programming, DcmDsdSidTabSessionLevelRef=DcmDspSession/Extended, DcmDsdSidTabSessionLevelRef=INX_End_Of_Line_Session, DcmDsdSidTabSessionLevelRef=INX_Development_Session  # Diagnostics Data Import
              EnableRxAndDisableTx (DcmDsdSubService):  # Diagnostics Data Import
                DcmDsdSubServiceId = 1
                DcmDsdSubServiceSessionLevelRef = DcmDspSession/Programming
                DcmDsdSubServiceSessionLevelRef = DcmDspSession/Extended
                DcmDsdSubServiceSessionLevelRef = INX_End_Of_Line_Session
                DcmDsdSubServiceSessionLevelRef = INX_Development_Session
              EnableRxAndTx (DcmDsdSubService):  # Diagnostics Data Import
                DcmDsdSubServiceId = 0
                DcmDsdSubServiceSessionLevelRef = DcmDspSession/Programming
                DcmDsdSubServiceSessionLevelRef = DcmDspSession/Extended
                DcmDsdSubServiceSessionLevelRef = INX_End_Of_Line_Session
                DcmDsdSubServiceSessionLevelRef = INX_Development_Session
            SecurityAccess: DcmDsdSidTabServiceId=39, DcmDsdSidTabSubfuncAvail=true, DcmDsdSidTabSessionLevelRef=DcmDspSession/Programming, DcmDsdSidTabSessionLevelRef=DcmDspSession/Extended, DcmDsdSidTabSessionLevelRef=INX_End_Of_Line_Session, DcmDsdSidTabSessionLevelRef=INX_Development_Session  # Diagnostics Data Import
              Key_Send (DcmDsdSubService):  # Diagnostics Data Import
                DcmDsdSubServiceId = 18
                DcmDsdSubServiceSessionLevelRef = DcmDspSession/Programming
                DcmDsdSubServiceSessionLevelRef = DcmDspSession/Extended
                DcmDsdSubServiceSessionLevelRef = INX_End_Of_Line_Session
                DcmDsdSubServiceSessionLevelRef = INX_Development_Session
              Seed_Request (DcmDsdSubService):  # Diagnostics Data Import
                DcmDsdSubServiceId = 17
                DcmDsdSubServiceSessionLevelRef = DcmDspSession/Programming
                DcmDsdSubServiceSessionLevelRef = DcmDspSession/Extended
                DcmDsdSubServiceSessionLevelRef = INX_End_Of_Line_Session
                DcmDsdSubServiceSessionLevelRef = INX_Development_Session
            ReadDataById: DcmDsdSidTabServiceId=34, DcmDsdSidTabSubfuncAvail=false  # Diagnostics Data Import
            ReadDtcInfo: DcmDsdSidTabServiceId=25, DcmDsdSidTabSubfuncAvail=true, DcmDsdSidTabSessionLevelRef=DcmDspSession/Default, DcmDsdSidTabSessionLevelRef=DcmDspSession/Extended, DcmDsdSidTabSessionLevelRef=INX_End_Of_Line_Session, DcmDsdSidTabSessionLevelRef=INX_Development_Session  # Diagnostics Data Import
              6 x DcmDsdSubService, all with DcmDsdSubServiceSessionLevelRef=DcmDspSession/Default, DcmDsdSubServiceSessionLevelRef=DcmDspSession/Extended, DcmDsdSubServiceSessionLevelRef=INX_End_Of_Line_Session:
                RDTCFDC: DcmDsdSubServiceId=20, DcmDsdSubServiceSessionLevelRef=INX_Development_Session  # Diagnostics Data Import
                RDTCEDRBDN: DcmDsdSubServiceId=6  # Diagnostics Data Import
                RDTCSSBDTC: DcmDsdSubServiceId=4, DcmDsdSubServiceSessionLevelRef=INX_Development_Session  # Diagnostics Data Import
                RDTCSSI: DcmDsdSubServiceId=3, DcmDsdSubServiceSessionLevelRef=INX_Development_Session  # Diagnostics Data Import
                RNODTCBSM: DcmDsdSubServiceId=1, DcmDsdSubServiceSessionLevelRef=INX_Development_Session  # Diagnostics Data Import
                RDTCBSM: DcmDsdSubServiceId=2, DcmDsdSubServiceSessionLevelRef=INX_Development_Session  # Diagnostics Data Import
            ClearDiagInfo: DcmDsdSidTabServiceId=20, DcmDsdSidTabSubfuncAvail=false, DcmDsdSidTabSessionLevelRef=DcmDspSession/Default, DcmDsdSidTabSessionLevelRef=DcmDspSession/Extended, DcmDsdSidTabSessionLevelRef=INX_End_Of_Line_Session, DcmDsdSidTabSessionLevelRef=INX_Development_Session  # Diagnostics Data Import
            EcuReset: DcmDsdSidTabServiceId=17, DcmDsdSidTabSubfuncAvail=true  # Diagnostics Data Import
              KeyOffOn (DcmDsdSubService): DcmDsdSubServiceId=2  # Diagnostics Data Import
              Hard (DcmDsdSubService): DcmDsdSubServiceId=1  # Diagnostics Data Import
            DiagSessionControl: DcmDsdSidTabServiceId=16, DcmDsdSidTabSubfuncAvail=true  # Diagnostics Data Import
              5 x DcmDsdSubService, all with DcmDsdSubServiceSessionLevelRef=DcmDspSession/Extended:
                INXDevelopmentSession_Start: DcmDsdSubServiceId=97, DcmDsdSubServiceSessionLevelRef=DcmDspSession/Default, DcmDsdSubServiceSessionLevelRef=INX_End_Of_Line_Session, DcmDsdSubServiceSessionLevelRef=INX_Development_Session  # Diagnostics Data Import
                INXEndOfLineSession_Start: DcmDsdSubServiceId=96, DcmDsdSubServiceSessionLevelRef=DcmDspSession/Default, DcmDsdSubServiceSessionLevelRef=INX_End_Of_Line_Session, DcmDsdSubServiceSessionLevelRef=INX_Development_Session  # Diagnostics Data Import
                Extended: DcmDsdSubServiceId=3, DcmDsdSubServiceSessionLevelRef=DcmDspSession/Default, DcmDsdSubServiceSessionLevelRef=INX_End_Of_Line_Session, DcmDsdSubServiceSessionLevelRef=INX_Development_Session  # Diagnostics Data Import
                Programming: DcmDsdSubServiceId=2, DcmDsdSubServiceSessionLevelRef=DcmDspSession/Programming  # Diagnostics Data Import
                Default: DcmDsdSubServiceId=1, DcmDsdSubServiceSessionLevelRef=DcmDspSession/Default, DcmDsdSubServiceSessionLevelRef=INX_End_Of_Line_Session, DcmDsdSubServiceSessionLevelRef=INX_Development_Session  # Diagnostics Data Import
      DcmGeneral  # Diagnostics Data Import
  module config Dem
    DemGeneral:  # Diagnostics Data Import
      DemAgingCycleCounterProcessing = DEM_PROCESS_AGINGCTR_INTERN
      DemDebounceCounterBasedSupport = true
      DemPTOSupport = false
      DemDtcStatusAvailabilityMask = 0
      DemTypeOfFreezeFrameRecordNumeration = DEM_FF_RECNUM_CALCULATED
      ExtendedDataRecord0x01_ExtendedDataRecord (DemDataClass): DemDataElementDataSize=1, DemDataElementInternalData=DEM_PRIORITY, DemDataElementUsePort=USE_DATA_INTERNAL  # Diagnostics Data Import
      ExtendedDataRecord0x01_ExtendedDataRecord_1 (DemDataClass): DemDataElementDataSize=1, DemDataElementInternalData=DEM_OCCCTR, DemDataElementUsePort=USE_DATA_INTERNAL  # Diagnostics Data Import
      PowerCycle (DemOperationCycle): DemOperationCycleType=DEM_OPCYC_POWER  # Diagnostics Data Import
      ExtendedDataRecord0x01 (DemExtendedDataRecordClass):  # Diagnostics Data Import
        DemExtendedDataRecordNumber = 1
        DemExtendedDataRecordUpdate = DEM_UPDATE_RECORD_NO
        DemDataClassRef = ExtendedDataRecord0x01_ExtendedDataRecord
        DemDataClassRef = ExtendedDataRecord0x01_ExtendedDataRecord_1
      ExtendedDataClass_83dcefb7 (DemExtendedDataClass): DemExtendedDataRecordClassRef=ExtendedDataRecord0x01  # Diagnostics Data Import
    DemConfigSet  # Diagnostics Data Import
      DTC_0x902101 (DemEventParameter): DemEventKind=DEM_EVENT_KIND_SWC, DemDTCClassRef=DTCClass_DTC_0x902101, DemExtendedDataClassRef=ExtendedDataClass_83dcefb7  # Diagnostics Data Import
        DemEventClass:  # Diagnostics Data Import
          DemAgingAllowed = false
          DemAgingCycleCounterThreshold = 0
          DemEventDestination = DEM_DTC_ORIGIN_PRIMARY_MEMORY
          DemEventPriority = 2
          DemEventSignificance = DEM_EVENT_SIGNIFICANCE_FAULT
          DemEventFailureCycleCounterThreshold = 0
          DemAgingCycleRef = PowerCycle
          DemOperationCycleRef = PowerCycle
          DemDebounceAlgorithmClass  # Diagnostics Data Import
            DemDebounceCounterBased:  # Diagnostics Data Import
              DemDebounceCounterDecrementStepSize = 1
              DemDebounceCounterIncrementStepSize = 1
              DemDebounceCounterJumpDown = true
              DemDebounceCounterJumpDownValue = 0
              DemDebounceCounterJumpUp = true
              DemDebounceCounterJumpUpValue = 0
      DTCClass_DTC_0x902101 (DemDTCClass): DemDTCSeverity=DEM_DTC_SEV_NO_SEVERITY, DemUdsDTC=9445633  # Diagnostics Data Import
      DTC_0x902001 (DemEventParameter): DemEventKind=DEM_EVENT_KIND_SWC, DemDTCClassRef=DTCClass_DTC_0x902001, DemExtendedDataClassRef=ExtendedDataClass_83dcefb7  # Diagnostics Data Import
        DemEventClass:  # Diagnostics Data Import
          DemAgingAllowed = false
          DemAgingCycleCounterThreshold = 0
          DemEventDestination = DEM_DTC_ORIGIN_PRIMARY_MEMORY
          DemEventPriority = 2
          DemEventSignificance = DEM_EVENT_SIGNIFICANCE_FAULT
          DemEventFailureCycleCounterThreshold = 0
          DemAgingCycleRef = PowerCycle
          DemOperationCycleRef = PowerCycle
          DemDebounceAlgorithmClass  # Diagnostics Data Import
            DemDebounceCounterBased:  # Diagnostics Data Import
              DemDebounceCounterDecrementStepSize = 1
              DemDebounceCounterIncrementStepSize = 1
              DemDebounceCounterJumpDown = true
              DemDebounceCounterJumpDownValue = 0
              DemDebounceCounterJumpUp = true
              DemDebounceCounterJumpUpValue = 0
      DTCClass_DTC_0x902001 (DemDTCClass): DemDTCSeverity=DEM_DTC_SEV_NO_SEVERITY, DemUdsDTC=9445377  # Diagnostics Data Import
      DTC_0x901f01 (DemEventParameter): DemEventKind=DEM_EVENT_KIND_SWC, DemDTCClassRef=DTCClass_DTC_0x901f01, DemExtendedDataClassRef=ExtendedDataClass_83dcefb7  # Diagnostics Data Import
        DemEventClass:  # Diagnostics Data Import
          DemAgingAllowed = false
          DemAgingCycleCounterThreshold = 0
          DemEventDestination = DEM_DTC_ORIGIN_PRIMARY_MEMORY
          DemEventPriority = 2
          DemEventSignificance = DEM_EVENT_SIGNIFICANCE_FAULT
          DemEventFailureCycleCounterThreshold = 0
          DemAgingCycleRef = PowerCycle
          DemOperationCycleRef = PowerCycle
          DemDebounceAlgorithmClass  # Diagnostics Data Import
            DemDebounceCounterBased:  # Diagnostics Data Import
              DemDebounceCounterDecrementStepSize = 1
              DemDebounceCounterIncrementStepSize = 1
              DemDebounceCounterJumpDown = true
              DemDebounceCounterJumpDownValue = 0
              DemDebounceCounterJumpUp = true
              DemDebounceCounterJumpUpValue = 0
      DTCClass_DTC_0x901f01 (DemDTCClass): DemDTCSeverity=DEM_DTC_SEV_NO_SEVERITY, DemUdsDTC=9445121  # Diagnostics Data Import
      DTC_0x901e01 (DemEventParameter): DemEventKind=DEM_EVENT_KIND_SWC, DemDTCClassRef=DTCClass_DTC_0x901e01, DemExtendedDataClassRef=ExtendedDataClass_83dcefb7  # Diagnostics Data Import
        DemEventClass:  # Diagnostics Data Import
          DemAgingAllowed = false
          DemAgingCycleCounterThreshold = 0
          DemEventDestination = DEM_DTC_ORIGIN_PRIMARY_MEMORY
          DemEventPriority = 2
          DemEventSignificance = DEM_EVENT_SIGNIFICANCE_FAULT
          DemEventFailureCycleCounterThreshold = 0
          DemAgingCycleRef = PowerCycle
          DemOperationCycleRef = PowerCycle
          DemDebounceAlgorithmClass  # Diagnostics Data Import
            DemDebounceCounterBased:  # Diagnostics Data Import
              DemDebounceCounterDecrementStepSize = 1
              DemDebounceCounterIncrementStepSize = 1
              DemDebounceCounterJumpDown = true
              DemDebounceCounterJumpDownValue = 0
              DemDebounceCounterJumpUp = true
              DemDebounceCounterJumpUpValue = 0
      DTCClass_DTC_0x901e01 (DemDTCClass): DemDTCSeverity=DEM_DTC_SEV_NO_SEVERITY, DemUdsDTC=9444865  # Diagnostics Data Import
      DTC_0x901d01 (DemEventParameter): DemEventKind=DEM_EVENT_KIND_SWC, DemDTCClassRef=DTCClass_DTC_0x901d01, DemExtendedDataClassRef=ExtendedDataClass_83dcefb7  # Diagnostics Data Import
        DemEventClass:  # Diagnostics Data Import
          DemAgingAllowed = false
          DemAgingCycleCounterThreshold = 0
          DemEventDestination = DEM_DTC_ORIGIN_PRIMARY_MEMORY
          DemEventPriority = 2
          DemEventSignificance = DEM_EVENT_SIGNIFICANCE_FAULT
          DemEventFailureCycleCounterThreshold = 0
          DemAgingCycleRef = PowerCycle
          DemOperationCycleRef = PowerCycle
          DemDebounceAlgorithmClass  # Diagnostics Data Import
            DemDebounceCounterBased:  # Diagnostics Data Import
              DemDebounceCounterDecrementStepSize = 1
              DemDebounceCounterIncrementStepSize = 1
              DemDebounceCounterJumpDown = true
              DemDebounceCounterJumpDownValue = 0
              DemDebounceCounterJumpUp = true
              DemDebounceCounterJumpUpValue = 0
      DTCClass_DTC_0x901d01 (DemDTCClass): DemDTCSeverity=DEM_DTC_SEV_NO_SEVERITY, DemUdsDTC=9444609  # Diagnostics Data Import
      DTC_0x901c01 (DemEventParameter): DemEventKind=DEM_EVENT_KIND_SWC, DemDTCClassRef=DTCClass_DTC_0x901c01, DemExtendedDataClassRef=ExtendedDataClass_83dcefb7  # Diagnostics Data Import
        DemEventClass:  # Diagnostics Data Import
          DemAgingAllowed = false
          DemAgingCycleCounterThreshold = 0
          DemEventDestination = DEM_DTC_ORIGIN_PRIMARY_MEMORY
          DemEventPriority = 2
          DemEventSignificance = DEM_EVENT_SIGNIFICANCE_FAULT
          DemEventFailureCycleCounterThreshold = 0
          DemAgingCycleRef = PowerCycle
          DemOperationCycleRef = PowerCycle
          DemDebounceAlgorithmClass  # Diagnostics Data Import
            DemDebounceCounterBased:  # Diagnostics Data Import
              DemDebounceCounterDecrementStepSize = 1
              DemDebounceCounterIncrementStepSize = 1
              DemDebounceCounterJumpDown = true
              DemDebounceCounterJumpDownValue = 0
              DemDebounceCounterJumpUp = true
              DemDebounceCounterJumpUpValue = 0
      DTCClass_DTC_0x901c01 (DemDTCClass): DemDTCSeverity=DEM_DTC_SEV_NO_SEVERITY, DemUdsDTC=9444353  # Diagnostics Data Import
      DTC_0x901b01 (DemEventParameter): DemEventKind=DEM_EVENT_KIND_SWC, DemDTCClassRef=DTCClass_DTC_0x901b01, DemExtendedDataClassRef=ExtendedDataClass_83dcefb7  # Diagnostics Data Import
        DemEventClass:  # Diagnostics Data Import
          DemAgingAllowed = false
          DemAgingCycleCounterThreshold = 0
          DemEventDestination = DEM_DTC_ORIGIN_PRIMARY_MEMORY
          DemEventPriority = 2
          DemEventSignificance = DEM_EVENT_SIGNIFICANCE_FAULT
          DemEventFailureCycleCounterThreshold = 0
          DemAgingCycleRef = PowerCycle
          DemOperationCycleRef = PowerCycle
          DemDebounceAlgorithmClass  # Diagnostics Data Import
            DemDebounceCounterBased:  # Diagnostics Data Import
              DemDebounceCounterDecrementStepSize = 1
              DemDebounceCounterIncrementStepSize = 1
              DemDebounceCounterJumpDown = true
              DemDebounceCounterJumpDownValue = 0
              DemDebounceCounterJumpUp = true
              DemDebounceCounterJumpUpValue = 0
      DTCClass_DTC_0x901b01 (DemDTCClass): DemDTCSeverity=DEM_DTC_SEV_NO_SEVERITY, DemUdsDTC=9444097  # Diagnostics Data Import
      DTC_0x901a01 (DemEventParameter): DemEventKind=DEM_EVENT_KIND_SWC, DemDTCClassRef=DTCClass_DTC_0x901a01, DemExtendedDataClassRef=ExtendedDataClass_83dcefb7  # Diagnostics Data Import
        DemEventClass:  # Diagnostics Data Import
          DemAgingAllowed = false
          DemAgingCycleCounterThreshold = 0
          DemEventDestination = DEM_DTC_ORIGIN_PRIMARY_MEMORY
          DemEventPriority = 2
          DemEventSignificance = DEM_EVENT_SIGNIFICANCE_FAULT
          DemEventFailureCycleCounterThreshold = 0
          DemAgingCycleRef = PowerCycle
          DemOperationCycleRef = PowerCycle
          DemDebounceAlgorithmClass  # Diagnostics Data Import
            DemDebounceCounterBased:  # Diagnostics Data Import
              DemDebounceCounterDecrementStepSize = 1
              DemDebounceCounterIncrementStepSize = 1
              DemDebounceCounterJumpDown = true
              DemDebounceCounterJumpDownValue = 0
              DemDebounceCounterJumpUp = true
              DemDebounceCounterJumpUpValue = 0
      DTCClass_DTC_0x901a01 (DemDTCClass): DemDTCSeverity=DEM_DTC_SEV_NO_SEVERITY, DemUdsDTC=9443841  # Diagnostics Data Import
      DTC_0x901901 (DemEventParameter): DemEventKind=DEM_EVENT_KIND_SWC, DemDTCClassRef=DTCClass_DTC_0x901901, DemExtendedDataClassRef=ExtendedDataClass_83dcefb7  # Diagnostics Data Import
        DemEventClass:  # Diagnostics Data Import
          DemAgingAllowed = false
          DemAgingCycleCounterThreshold = 0
          DemEventDestination = DEM_DTC_ORIGIN_PRIMARY_MEMORY
          DemEventPriority = 2
          DemEventSignificance = DEM_EVENT_SIGNIFICANCE_FAULT
          DemEventFailureCycleCounterThreshold = 0
          DemAgingCycleRef = PowerCycle
          DemOperationCycleRef = PowerCycle
          DemDebounceAlgorithmClass  # Diagnostics Data Import
            DemDebounceCounterBased:  # Diagnostics Data Import
              DemDebounceCounterDecrementStepSize = 1
              DemDebounceCounterIncrementStepSize = 1
              DemDebounceCounterJumpDown = true
              DemDebounceCounterJumpDownValue = 0
              DemDebounceCounterJumpUp = true
              DemDebounceCounterJumpUpValue = 0
      DTCClass_DTC_0x901901 (DemDTCClass): DemDTCSeverity=DEM_DTC_SEV_NO_SEVERITY, DemUdsDTC=9443585  # Diagnostics Data Import
      DTC_0x901801 (DemEventParameter): DemEventKind=DEM_EVENT_KIND_SWC, DemDTCClassRef=DTCClass_DTC_0x901801, DemExtendedDataClassRef=ExtendedDataClass_83dcefb7  # Diagnostics Data Import
        DemEventClass:  # Diagnostics Data Import
          DemAgingAllowed = false
          DemAgingCycleCounterThreshold = 0
          DemEventDestination = DEM_DTC_ORIGIN_PRIMARY_MEMORY
          DemEventPriority = 2
          DemEventSignificance = DEM_EVENT_SIGNIFICANCE_FAULT
          DemEventFailureCycleCounterThreshold = 0
          DemAgingCycleRef = PowerCycle
          DemOperationCycleRef = PowerCycle
          DemDebounceAlgorithmClass  # Diagnostics Data Import
            DemDebounceCounterBased:  # Diagnostics Data Import
              DemDebounceCounterDecrementStepSize = 1
              DemDebounceCounterIncrementStepSize = 1
              DemDebounceCounterJumpDown = true
              DemDebounceCounterJumpDownValue = 0
              DemDebounceCounterJumpUp = true
              DemDebounceCounterJumpUpValue = 0
      DTCClass_DTC_0x901801 (DemDTCClass): DemDTCSeverity=DEM_DTC_SEV_NO_SEVERITY, DemUdsDTC=9443329  # Diagnostics Data Import
      DTC_0x901701 (DemEventParameter): DemEventKind=DEM_EVENT_KIND_SWC, DemDTCClassRef=DTCClass_DTC_0x901701, DemExtendedDataClassRef=ExtendedDataClass_83dcefb7  # Diagnostics Data Import
        DemEventClass:  # Diagnostics Data Import
          DemAgingAllowed = false
          DemAgingCycleCounterThreshold = 0
          DemEventDestination = DEM_DTC_ORIGIN_PRIMARY_MEMORY
          DemEventPriority = 2
          DemEventSignificance = DEM_EVENT_SIGNIFICANCE_FAULT
          DemEventFailureCycleCounterThreshold = 0
          DemAgingCycleRef = PowerCycle
          DemOperationCycleRef = PowerCycle
          DemDebounceAlgorithmClass  # Diagnostics Data Import
            DemDebounceCounterBased:  # Diagnostics Data Import
              DemDebounceCounterDecrementStepSize = 1
              DemDebounceCounterIncrementStepSize = 1
              DemDebounceCounterJumpDown = true
              DemDebounceCounterJumpDownValue = 0
              DemDebounceCounterJumpUp = true
              DemDebounceCounterJumpUpValue = 0
      DTCClass_DTC_0x901701 (DemDTCClass): DemDTCSeverity=DEM_DTC_SEV_NO_SEVERITY, DemUdsDTC=9443073  # Diagnostics Data Import
      DTC_0x901601 (DemEventParameter): DemEventKind=DEM_EVENT_KIND_SWC, DemDTCClassRef=DTCClass_DTC_0x901601, DemExtendedDataClassRef=ExtendedDataClass_83dcefb7  # Diagnostics Data Import
        DemEventClass:  # Diagnostics Data Import
          DemAgingAllowed = false
          DemAgingCycleCounterThreshold = 0
          DemEventDestination = DEM_DTC_ORIGIN_PRIMARY_MEMORY
          DemEventPriority = 2
          DemEventSignificance = DEM_EVENT_SIGNIFICANCE_FAULT
          DemEventFailureCycleCounterThreshold = 0
          DemAgingCycleRef = PowerCycle
          DemOperationCycleRef = PowerCycle
          DemDebounceAlgorithmClass  # Diagnostics Data Import
            DemDebounceCounterBased:  # Diagnostics Data Import
              DemDebounceCounterDecrementStepSize = 1
              DemDebounceCounterIncrementStepSize = 1
              DemDebounceCounterJumpDown = true
              DemDebounceCounterJumpDownValue = 0
              DemDebounceCounterJumpUp = true
              DemDebounceCounterJumpUpValue = 0
      DTCClass_DTC_0x901601 (DemDTCClass): DemDTCSeverity=DEM_DTC_SEV_NO_SEVERITY, DemUdsDTC=9442817  # Diagnostics Data Import
      DTC_0x901501 (DemEventParameter): DemEventKind=DEM_EVENT_KIND_SWC, DemDTCClassRef=DTCClass_DTC_0x901501, DemExtendedDataClassRef=ExtendedDataClass_83dcefb7  # Diagnostics Data Import
        DemEventClass:  # Diagnostics Data Import
          DemAgingAllowed = false
          DemAgingCycleCounterThreshold = 0
          DemEventDestination = DEM_DTC_ORIGIN_PRIMARY_MEMORY
          DemEventPriority = 2
          DemEventSignificance = DEM_EVENT_SIGNIFICANCE_FAULT
          DemEventFailureCycleCounterThreshold = 0
          DemAgingCycleRef = PowerCycle
          DemOperationCycleRef = PowerCycle
          DemDebounceAlgorithmClass  # Diagnostics Data Import
            DemDebounceCounterBased:  # Diagnostics Data Import
              DemDebounceCounterDecrementStepSize = 1
              DemDebounceCounterIncrementStepSize = 1
              DemDebounceCounterJumpDown = true
              DemDebounceCounterJumpDownValue = 0
              DemDebounceCounterJumpUp = true
              DemDebounceCounterJumpUpValue = 0
      DTCClass_DTC_0x901501 (DemDTCClass): DemDTCSeverity=DEM_DTC_SEV_NO_SEVERITY, DemUdsDTC=9442561  # Diagnostics Data Import
      DTC_0x901401 (DemEventParameter): DemEventKind=DEM_EVENT_KIND_SWC, DemDTCClassRef=DTCClass_DTC_0x901401, DemExtendedDataClassRef=ExtendedDataClass_83dcefb7  # Diagnostics Data Import
        DemEventClass:  # Diagnostics Data Import
          DemAgingAllowed = false
          DemAgingCycleCounterThreshold = 0
          DemEventDestination = DEM_DTC_ORIGIN_PRIMARY_MEMORY
          DemEventPriority = 2
          DemEventSignificance = DEM_EVENT_SIGNIFICANCE_FAULT
          DemEventFailureCycleCounterThreshold = 0
          DemAgingCycleRef = PowerCycle
          DemOperationCycleRef = PowerCycle
          DemDebounceAlgorithmClass  # Diagnostics Data Import
            DemDebounceCounterBased:  # Diagnostics Data Import
              DemDebounceCounterDecrementStepSize = 1
              DemDebounceCounterIncrementStepSize = 1
              DemDebounceCounterJumpDown = true
              DemDebounceCounterJumpDownValue = 0
              DemDebounceCounterJumpUp = true
              DemDebounceCounterJumpUpValue = 0
      DTCClass_DTC_0x901401 (DemDTCClass): DemDTCSeverity=DEM_DTC_SEV_NO_SEVERITY, DemUdsDTC=9442305  # Diagnostics Data Import
      DTC_0x901301 (DemEventParameter): DemEventKind=DEM_EVENT_KIND_SWC, DemDTCClassRef=DTCClass_DTC_0x901301, DemExtendedDataClassRef=ExtendedDataClass_83dcefb7  # Diagnostics Data Import
        DemEventClass:  # Diagnostics Data Import
          DemAgingAllowed = false
          DemAgingCycleCounterThreshold = 0
          DemEventDestination = DEM_DTC_ORIGIN_PRIMARY_MEMORY
          DemEventPriority = 2
          DemEventSignificance = DEM_EVENT_SIGNIFICANCE_FAULT
          DemEventFailureCycleCounterThreshold = 0
          DemAgingCycleRef = PowerCycle
          DemOperationCycleRef = PowerCycle
          DemDebounceAlgorithmClass  # Diagnostics Data Import
            DemDebounceCounterBased:  # Diagnostics Data Import
              DemDebounceCounterDecrementStepSize = 1
              DemDebounceCounterIncrementStepSize = 1
              DemDebounceCounterJumpDown = true
              DemDebounceCounterJumpDownValue = 0
              DemDebounceCounterJumpUp = true
              DemDebounceCounterJumpUpValue = 0
      DTCClass_DTC_0x901301 (DemDTCClass): DemDTCSeverity=DEM_DTC_SEV_NO_SEVERITY, DemUdsDTC=9442049  # Diagnostics Data Import
      DTC_0x901201 (DemEventParameter): DemEventKind=DEM_EVENT_KIND_SWC, DemDTCClassRef=DTCClass_DTC_0x901201, DemExtendedDataClassRef=ExtendedDataClass_83dcefb7  # Diagnostics Data Import
        DemEventClass:  # Diagnostics Data Import
          DemAgingAllowed = false
          DemAgingCycleCounterThreshold = 0
          DemEventDestination = DEM_DTC_ORIGIN_PRIMARY_MEMORY
          DemEventPriority = 2
          DemEventSignificance = DEM_EVENT_SIGNIFICANCE_FAULT
          DemEventFailureCycleCounterThreshold = 0
          DemAgingCycleRef = PowerCycle
          DemOperationCycleRef = PowerCycle
          DemDebounceAlgorithmClass  # Diagnostics Data Import
            DemDebounceCounterBased:  # Diagnostics Data Import
              DemDebounceCounterDecrementStepSize = 1
              DemDebounceCounterIncrementStepSize = 1
              DemDebounceCounterJumpDown = true
              DemDebounceCounterJumpDownValue = 0
              DemDebounceCounterJumpUp = true
              DemDebounceCounterJumpUpValue = 0
      DTCClass_DTC_0x901201 (DemDTCClass): DemDTCSeverity=DEM_DTC_SEV_NO_SEVERITY, DemUdsDTC=9441793  # Diagnostics Data Import
      DTC_0x901101 (DemEventParameter): DemEventKind=DEM_EVENT_KIND_SWC, DemDTCClassRef=DTCClass_DTC_0x901101, DemExtendedDataClassRef=ExtendedDataClass_83dcefb7  # Diagnostics Data Import
        DemEventClass:  # Diagnostics Data Import
          DemAgingAllowed = false
          DemAgingCycleCounterThreshold = 0
          DemEventDestination = DEM_DTC_ORIGIN_PRIMARY_MEMORY
          DemEventPriority = 2
          DemEventSignificance = DEM_EVENT_SIGNIFICANCE_FAULT
          DemEventFailureCycleCounterThreshold = 0
          DemAgingCycleRef = PowerCycle
          DemOperationCycleRef = PowerCycle
          DemDebounceAlgorithmClass  # Diagnostics Data Import
            DemDebounceCounterBased:  # Diagnostics Data Import
              DemDebounceCounterDecrementStepSize = 1
              DemDebounceCounterIncrementStepSize = 1
              DemDebounceCounterJumpDown = true
              DemDebounceCounterJumpDownValue = 0
              DemDebounceCounterJumpUp = true
              DemDebounceCounterJumpUpValue = 0
      DTCClass_DTC_0x901101 (DemDTCClass): DemDTCSeverity=DEM_DTC_SEV_NO_SEVERITY, DemUdsDTC=9441537  # Diagnostics Data Import
      DTC_0x901001 (DemEventParameter): DemEventKind=DEM_EVENT_KIND_SWC, DemDTCClassRef=DTCClass_DTC_0x901001, DemExtendedDataClassRef=ExtendedDataClass_83dcefb7  # Diagnostics Data Import
        DemEventClass:  # Diagnostics Data Import
          DemAgingAllowed = false
          DemAgingCycleCounterThreshold = 0
          DemEventDestination = DEM_DTC_ORIGIN_PRIMARY_MEMORY
          DemEventPriority = 2
          DemEventSignificance = DEM_EVENT_SIGNIFICANCE_FAULT
          DemEventFailureCycleCounterThreshold = 0
          DemAgingCycleRef = PowerCycle
          DemOperationCycleRef = PowerCycle
          DemDebounceAlgorithmClass  # Diagnostics Data Import
            DemDebounceCounterBased:  # Diagnostics Data Import
              DemDebounceCounterDecrementStepSize = 1
              DemDebounceCounterIncrementStepSize = 1
              DemDebounceCounterJumpDown = true
              DemDebounceCounterJumpDownValue = 0
              DemDebounceCounterJumpUp = true
              DemDebounceCounterJumpUpValue = 0
      DTCClass_DTC_0x901001 (DemDTCClass): DemDTCSeverity=DEM_DTC_SEV_NO_SEVERITY, DemUdsDTC=9441281  # Diagnostics Data Import
  module config EcuC
    EcucPduCollection: PduIdTypeEnum=UINT8, PduLengthTypeEnum=UINT8
      77 x Pdu:
        ABT_1_MIB_ab_Gen3_46f0b378_Rx: PduLength=8
        BEM_02_oMIBCAN_4c571fd1_Rx: DynamicLength=false, PduLength=8, SysTPduToFrameMappingRef=BEM_02
        BEM_02_oMIBCAN_6aef04e3_Rx: DynamicLength=false, PduLength=8
        DEV_ABT_1_Gen3_Tx_01_oMIBCAN_8e08c6bd_Tx: PduLength=8, SysTPduToFrameMappingRef=DEV_ABT_1_Gen3_Tx_01
        DEV_ABT_1_Gen3_Tx_02_oMIBCAN_bbe570ee_Tx: PduLength=8, SysTPduToFrameMappingRef=DEV_ABT_1_Gen3_Tx_02
        DEV_ABT_1_Gen3_Tx_03_oMIBCAN_1e6ee0e0_Tx: PduLength=8, SysTPduToFrameMappingRef=DEV_ABT_1_Gen3_Tx_03
        DEV_ABT_1_Gen3_Tx_04_oMIBCAN_d03e1c48_Tx: PduLength=8, SysTPduToFrameMappingRef=DEV_ABT_1_Gen3_Tx_04
        DEV_ABT_1_Req_00_oMIBCAN_71c03311_Rx: PduLength=8, SysTPduToFrameMappingRef=DEV_ABT_1_Req_00
        DEV_ABT_1_Req_04_Tp_oMIBCAN_5e6f9bc1_Rx: DynamicLength=false, PduLength=8, SysTPduToFrameMappingRef=DEV_ABT_1_Req_04_Tp
        DEV_ABT_1_Req_04_oMIBCAN_8a7d79ea_Rx: DynamicLength=true, PduLength=8
        DEV_ABT_1_Req_04_oMIBCAN_bfaad34f_Rx: DynamicLength=true, PduLength=8
        DEV_ABT_1_Req_05_oMIBCAN_2ff6e9e4_Rx: PduLength=8, SysTPduToFrameMappingRef=DEV_ABT_1_Req_05
        DEV_ABT_1_Resp_01_oMIBCAN_3d488e5a_Tx: PduLength=8, SysTPduToFrameMappingRef=DEV_ABT_1_Resp_01
        DEV_ABT_1_Resp_02_oMIBCAN_08a53809_Tx: PduLength=8, SysTPduToFrameMappingRef=DEV_ABT_1_Resp_02
        DEV_ABT_1_Resp_03_oMIBCAN_ad2ea807_Tx: PduLength=8, SysTPduToFrameMappingRef=DEV_ABT_1_Resp_03
        DEV_ABT_1_Resp_04_Tp_oMIBCAN_911ddf56_Tx: DynamicLength=false, PduLength=8, SysTPduToFrameMappingRef=DEV_ABT_1_Resp_04_Tp
        DEV_ABT_1_Resp_04_oMIBCAN_637e54af_Tx: DynamicLength=true, PduLength=8
        DEV_ABT_1_Resp_04_oMIBCAN_b6bcfefc_Tx: DynamicLength=true, PduLength=8
        DEV_ABT_1_Resp_05_oMIBCAN_c6f5c4a1_Tx: PduLength=8, SysTPduToFrameMappingRef=DEV_ABT_1_Resp_05
        DIA_ABT_1_Req_Tp_oMIBCAN_f012988b_Rx: DynamicLength=false, PduLength=8, SysTPduToFrameMappingRef=DIA_ABT_1_Req_Tp
        DIA_ABT_1_Req_oMIBCAN_1394b6c8_Rx: DynamicLength=true, PduLength=8
        DIA_ABT_1_Req_oMIBCAN_57dc7f80_Rx: DynamicLength=true, PduLength=8
        DIA_ABT_1_Resp_Tp_oMIBCAN_e9ff9dc9_Tx: DynamicLength=false, PduLength=8, SysTPduToFrameMappingRef=DIA_ABT_1_Resp_Tp
        DIA_ABT_1_Resp_oMIBCAN_3ec297d7_Tx: DynamicLength=true, PduLength=8
        DIA_ABT_1_Resp_oMIBCAN_fa3ae601_Tx: DynamicLength=true, PduLength=8
        Diag_ABT_1_Req_Tp_oMIBCAN_87b87875_Rx: DynamicLength=false, PduLength=8, SysTPduToFrameMappingRef=Diag_ABT_1_Req_Tp
        Diag_ABT_1_Req_oMIBCAN_4e8fe7b6_Rx: DynamicLength=true, PduLength=8
        Diag_ABT_1_Req_oMIBCAN_55599102_Rx: DynamicLength=true, PduLength=8
        Diag_ABT_1_Resp_Tp_oMIBCAN_b38de832_Tx: DynamicLength=false, PduLength=8, SysTPduToFrameMappingRef=Diag_ABT_1_Resp_Tp
        Diag_ABT_1_Resp_oMIBCAN_8922d0bd_Tx: DynamicLength=true, PduLength=8
        Diag_ABT_1_Resp_oMIBCAN_f98e81e3_Tx: DynamicLength=true, PduLength=8
        Diagnose_01_oMIBCAN_26fceb25_Rx: DynamicLength=false, PduLength=8, SysTPduToFrameMappingRef=Diagnose_01
        Diagnose_01_oMIBCAN_a76d6db2_Rx: DynamicLength=false, PduLength=8
        Dimmung_01_oMIBCAN_65f0daf0_Rx: DynamicLength=false, PduLength=8
        Dimmung_01_oMIBCAN_b983c4ee_Rx: DynamicLength=false, PduLength=8, SysTPduToFrameMappingRef=Dimmung_01
        Display_1_01_oMIBCAN_7531a5df_Tx: DynamicLength=false, PduLength=8, SysTPduToFrameMappingRef=Display_1_01
        Display_1_01_oMIBCAN_8bfac915_Tx: DynamicLength=false, PduLength=8
        Display_1_02_oMIBCAN_40dc138c_Tx: DynamicLength=false, PduLength=8, SysTPduToFrameMappingRef=Display_1_02
        Display_1_02_oMIBCAN_b277f5d0_Tx: DynamicLength=false, PduLength=8
        Display_1_03_oMIBCAN_a50ce193_Tx: DynamicLength=false, PduLength=8
        Display_1_03_oMIBCAN_e5578382_Tx: DynamicLength=false, PduLength=8, SysTPduToFrameMappingRef=Display_1_03
        HID_ABT_1_ZR_Req_Tp_oMIBCAN_83fcf6ff_Tx: DynamicLength=false, PduLength=8, SysTPduToFrameMappingRef=HID_ABT_1_ZR_Req_Tp
        HID_ABT_1_ZR_Req_oMIBCAN_3b1cab3e_Tx: DynamicLength=true, PduLength=8
        HID_ABT_1_ZR_Req_oMIBCAN_8212e228_Tx: DynamicLength=true, PduLength=8
        HID_ABT_1_ZR_Resp_Tp_oMIBCAN_bee4c682_Rx: DynamicLength=false, PduLength=8, SysTPduToFrameMappingRef=HID_ABT_1_ZR_Resp_Tp
        HID_ABT_1_ZR_Resp_oMIBCAN_9e59f3fb_Rx: DynamicLength=true, PduLength=8
        HID_ABT_1_ZR_Resp_oMIBCAN_d68fb85e_Rx: DynamicLength=true, PduLength=8
        HID_ZR_ABT_1_Req_Tp_oMIBCAN_570e7390_Rx: DynamicLength=false, PduLength=8, SysTPduToFrameMappingRef=HID_ZR_ABT_1_Req_Tp
        HID_ZR_ABT_1_Req_oMIBCAN_4e88cb04_Rx: DynamicLength=true, PduLength=8
        HID_ZR_ABT_1_Req_oMIBCAN_9e31cb06_Rx: DynamicLength=true, PduLength=8
        HID_ZR_ABT_1_Resp_Tp_oMIBCAN_633d48ce_Tx: DynamicLength=false, PduLength=8, SysTPduToFrameMappingRef=HID_ZR_ABT_1_Resp_Tp
        HID_ZR_ABT_1_Resp_oMIBCAN_10f6f58c_Tx: DynamicLength=true, PduLength=8
        HID_ZR_ABT_1_Resp_oMIBCAN_4293dd1d_Tx: DynamicLength=true, PduLength=8
        KS_SSN_ABT_1_Req_Tp_oMIBCAN_2d9643dd_Rx: DynamicLength=false, PduLength=8, SysTPduToFrameMappingRef=KS_SSN_ABT_1_Req_Tp
        KS_SSN_ABT_1_Req_oMIBCAN_16c9b54b_Rx: DynamicLength=true, PduLength=8
        KS_SSN_ABT_1_Req_oMIBCAN_ef3b7efa_Rx: DynamicLength=true, PduLength=8
        KS_SSN_ABT_1_Resp_Tp_oMIBCAN_6b2aedd3_Tx: DynamicLength=false, PduLength=8, SysTPduToFrameMappingRef=KS_SSN_ABT_1_Resp_Tp
        KS_SSN_ABT_1_Resp_oMIBCAN_4a529922_Tx: DynamicLength=true, PduLength=8
        KS_SSN_ABT_1_Resp_oMIBCAN_4a76184e_Tx: DynamicLength=true, PduLength=8
        Klemmen_Status_01_oMIBCAN_c14dd5d5_Rx: DynamicLength=false, PduLength=4
        Klemmen_Status_01_oMIBCAN_cc9f7e61_Rx: DynamicLength=false, PduLength=4, SysTPduToFrameMappingRef=Klemmen_Status_01
        NMH_ABT_1_oMIBCAN_32c15a22_Tx: DynamicLength=false, PduLength=8, SysTPduToFrameMappingRef=NMH_ABT_1
        NMH_ABT_1_oMIBCAN_95150102_Tx: PduLength=6
        OBDC_SSN_ABT_1_Req_Tp_oMIBCAN_24a71a07_Rx: DynamicLength=false, PduLength=8, SysTPduToFrameMappingRef=OBDC_SSN_ABT_1_Req_Tp
        OBDC_SSN_ABT_1_Req_oMIBCAN_0f9cb27d_Rx: DynamicLength=true, PduLength=8
        OBDC_SSN_ABT_1_Req_oMIBCAN_f307405b_Rx: DynamicLength=true, PduLength=8
        OBDC_SSN_ABT_1_Resp_Tp_oMIBCAN_0d25e740_Tx: DynamicLength=false, PduLength=8, SysTPduToFrameMappingRef=OBDC_SSN_ABT_1_Resp_Tp
        OBDC_SSN_ABT_1_Resp_oMIBCAN_396e286d_Tx: DynamicLength=true, PduLength=8
        OBDC_SSN_ABT_1_Resp_oMIBCAN_5724c6df_Tx: DynamicLength=true, PduLength=8
        ORU_01_oMIBCAN_27f873fd_Rx: DynamicLength=false, PduLength=8
        ORU_01_oMIBCAN_ee71652b_Rx: DynamicLength=false, PduLength=8, SysTPduToFrameMappingRef=ORU_01
        Systeminfo_01_oMIBCAN_86e3ebe7_Rx: DynamicLength=false, PduLength=8
        Systeminfo_01_oMIBCAN_de81f20c_Rx: DynamicLength=false, PduLength=8, SysTPduToFrameMappingRef=Systeminfo_01
        Zentralrechner_01_oMIBCAN_76551c99_Rx: DynamicLength=false, PduLength=8, SysTPduToFrameMappingRef=Zentralrechner_01
        Zentralrechner_01_oMIBCAN_e5318f4e_Rx: DynamicLength=false, PduLength=8
        Zentralrechner_04_oMIBCAN_2863c66c_Rx: DynamicLength=false, PduLength=8, SysTPduToFrameMappingRef=Zentralrechner_04
        Zentralrechner_04_oMIBCAN_afa6ca01_Rx: DynamicLength=false, PduLength=8
  module config EcuM
    EcuMConfiguration
      EcuMCommonConfiguration
        EcuMDriverInitListOne
        EcuMDriverRestartList
        CN_MIBCAN_0d25aee7 (EcuMWakeupSource): EcuMWakeupSourceId=5, EcuMComMChannelRef=ComMConfigSet/CN_MIBCAN_0d25aee7
      EcuMFlexConfiguration: EcuMFlexModuleConfigurationRef=CanConfigSet
  module config Nm
    CN_MIBCAN_0d25aee7 (NmChannelConfig): NmComMChannelRef=ComMConfigSet/CN_MIBCAN_0d25aee7
      MIBCAN_9c128fcc (NmBusType)
        NmStandardBusNmConfig: NmStandardBusType=NM_BUSNM_CANNM  # MIBCAN
    NmGlobalConfig
      NmGlobalFeatures: NmComUserDataSupport=true, NmNodeIdEnabled=true, NmUserDataEnabled=true
      NmGlobalProperties
  module config PduR
    PduRGeneral
    PduRRoutingTables
      PduRRoutingTable
        26 x PduRRoutingPath:
          BEM_02_oMIBCAN_4c571fd1_Rx
            BEM_02_oMIBCAN_4c571fd1_Rx_19f76597_Rx (PduRDestPdu): PduRDestPduRef=EcucPduCollection/BEM_02_oMIBCAN_6aef04e3_Rx
            PduRSrcPdu_19f76597 (PduRSrcPdu): PduRSrcPduRef=EcucPduCollection/BEM_02_oMIBCAN_4c571fd1_Rx
          DEV_ABT_1_Req_04_oMIBCAN_8a7d79ea_Rx
            DEV_ABT_1_Req_04_oMIBCAN_8a7d79ea_Rx_defeebbe_Rx (PduRDestPdu): PduRDestPduRef=DEV_ABT_1_Req_04_oMIBCAN_bfaad34f_Rx
            PduRSrcPdu_defeebbe (PduRSrcPdu): PduRSrcPduRef=EcucPduCollection/DEV_ABT_1_Req_04_oMIBCAN_8a7d79ea_Rx
          DEV_ABT_1_Resp_04_oMIBCAN_b6bcfefc_Tx
            DEV_ABT_1_Resp_04_oMIBCAN_637e54af_Tx (PduRDestPdu): PduRDestPduRef=EcucPduCollection/DEV_ABT_1_Resp_04_oMIBCAN_637e54af_Tx
            PduRSrcPdu_76c34e4b (PduRSrcPdu): PduRSrcPduRef=EcucPduCollection/DEV_ABT_1_Resp_04_oMIBCAN_b6bcfefc_Tx
          DIA_ABT_1_Req_oMIBCAN_1394b6c8_Rx
            DIA_ABT_1_Req_oMIBCAN_1394b6c8_Rx_c7840e69_Rx (PduRDestPdu): PduRDestPduRef=DIA_ABT_1_Req_oMIBCAN_57dc7f80_Rx
            PduRSrcPdu_c7840e69 (PduRSrcPdu): PduRSrcPduRef=EcucPduCollection/DIA_ABT_1_Req_oMIBCAN_1394b6c8_Rx
          DIA_ABT_1_Resp_oMIBCAN_fa3ae601_Tx
            DIA_ABT_1_Resp_oMIBCAN_3ec297d7_Tx (PduRDestPdu): PduRDestPduRef=EcucPduCollection/DIA_ABT_1_Resp_oMIBCAN_3ec297d7_Tx
            PduRSrcPdu_7e82b0fd (PduRSrcPdu): PduRSrcPduRef=EcucPduCollection/DIA_ABT_1_Resp_oMIBCAN_fa3ae601_Tx
          Diag_ABT_1_Req_oMIBCAN_4e8fe7b6_Rx
            Diag_ABT_1_Req_oMIBCAN_4e8fe7b6_Rx_3c635459_Rx (PduRDestPdu): PduRDestPduRef=Diag_ABT_1_Req_oMIBCAN_55599102_Rx
            PduRSrcPdu_3c635459 (PduRSrcPdu): PduRSrcPduRef=EcucPduCollection/Diag_ABT_1_Req_oMIBCAN_4e8fe7b6_Rx
          Diag_ABT_1_Resp_oMIBCAN_f98e81e3_Tx
            Diag_ABT_1_Resp_oMIBCAN_8922d0bd_Tx (PduRDestPdu): PduRDestPduRef=EcucPduCollection/Diag_ABT_1_Resp_oMIBCAN_8922d0bd_Tx
            PduRSrcPdu_92910cbf (PduRSrcPdu): PduRSrcPduRef=EcucPduCollection/Diag_ABT_1_Resp_oMIBCAN_f98e81e3_Tx
          Diagnose_01_oMIBCAN_26fceb25_Rx
            Diagnose_01_oMIBCAN_26fceb25_Rx_6207d7c5_Rx (PduRDestPdu): PduRDestPduRef=EcucPduCollection/Diagnose_01_oMIBCAN_a76d6db2_Rx
            PduRSrcPdu_6207d7c5 (PduRSrcPdu): PduRSrcPduRef=EcucPduCollection/Diagnose_01_oMIBCAN_26fceb25_Rx
          Dimmung_01_oMIBCAN_b983c4ee_Rx
            Dimmung_01_oMIBCAN_b983c4ee_Rx_cce51ca9_Rx (PduRDestPdu): PduRDestPduRef=EcucPduCollection/Dimmung_01_oMIBCAN_65f0daf0_Rx
            PduRSrcPdu_cce51ca9 (PduRSrcPdu): PduRSrcPduRef=EcucPduCollection/Dimmung_01_oMIBCAN_b983c4ee_Rx
          Display_1_01_oMIBCAN_8bfac915_Tx
            Display_1_01_oMIBCAN_7531a5df_Tx (PduRDestPdu): PduRDestPduRef=EcucPduCollection/Display_1_01_oMIBCAN_7531a5df_Tx
            PduRSrcPdu_4e538a19 (PduRSrcPdu): PduRSrcPduRef=EcucPduCollection/Display_1_01_oMIBCAN_8bfac915_Tx
          Display_1_02_oMIBCAN_b277f5d0_Tx
            Display_1_02_oMIBCAN_40dc138c_Tx (PduRDestPdu): PduRDestPduRef=EcucPduCollection/Display_1_02_oMIBCAN_40dc138c_Tx
            PduRSrcPdu_02fffb33 (PduRSrcPdu): PduRSrcPduRef=EcucPduCollection/Display_1_02_oMIBCAN_b277f5d0_Tx
          Display_1_03_oMIBCAN_a50ce193_Tx
            Display_1_03_oMIBCAN_e5578382_Tx (PduRDestPdu): PduRDestPduRef=EcucPduCollection/Display_1_03_oMIBCAN_e5578382_Tx
            PduRSrcPdu_2b59693f (PduRSrcPdu): PduRSrcPduRef=EcucPduCollection/Display_1_03_oMIBCAN_a50ce193_Tx
          HID_ABT_1_ZR_Req_oMIBCAN_3b1cab3e_Tx
            HID_ABT_1_ZR_Req_oMIBCAN_8212e228_Tx (PduRDestPdu): PduRDestPduRef=EcucPduCollection/HID_ABT_1_ZR_Req_oMIBCAN_8212e228_Tx
            PduRSrcPdu_644f5d79 (PduRSrcPdu): PduRSrcPduRef=EcucPduCollection/HID_ABT_1_ZR_Req_oMIBCAN_3b1cab3e_Tx
          HID_ABT_1_ZR_Resp_oMIBCAN_9e59f3fb_Rx
            HID_ABT_1_ZR_Resp_oMIBCAN_9e59f3fb_Rx_ec0c806c_Rx (PduRDestPdu): PduRDestPduRef=HID_ABT_1_ZR_Resp_oMIBCAN_d68fb85e_Rx
            PduRSrcPdu_ec0c806c (PduRSrcPdu): PduRSrcPduRef=EcucPduCollection/HID_ABT_1_ZR_Resp_oMIBCAN_9e59f3fb_Rx
          HID_ZR_ABT_1_Req_oMIBCAN_9e31cb06_Rx
            HID_ZR_ABT_1_Req_oMIBCAN_9e31cb06_Rx_deaa48de_Rx (PduRDestPdu): PduRDestPduRef=HID_ZR_ABT_1_Req_oMIBCAN_4e88cb04_Rx
            PduRSrcPdu_deaa48de (PduRSrcPdu): PduRSrcPduRef=EcucPduCollection/HID_ZR_ABT_1_Req_oMIBCAN_9e31cb06_Rx
          HID_ZR_ABT_1_Resp_oMIBCAN_10f6f58c_Tx
            HID_ZR_ABT_1_Resp_oMIBCAN_4293dd1d_Tx (PduRDestPdu): PduRDestPduRef=EcucPduCollection/HID_ZR_ABT_1_Resp_oMIBCAN_4293dd1d_Tx
            PduRSrcPdu_484b3a65 (PduRSrcPdu): PduRSrcPduRef=EcucPduCollection/HID_ZR_ABT_1_Resp_oMIBCAN_10f6f58c_Tx
          KS_SSN_ABT_1_Req_oMIBCAN_16c9b54b_Rx
            KS_SSN_ABT_1_Req_oMIBCAN_16c9b54b_Rx_84908a83_Rx (PduRDestPdu): PduRDestPduRef=KS_SSN_ABT_1_Req_oMIBCAN_ef3b7efa_Rx
            PduRSrcPdu_84908a83 (PduRSrcPdu): PduRSrcPduRef=EcucPduCollection/KS_SSN_ABT_1_Req_oMIBCAN_16c9b54b_Rx
          KS_SSN_ABT_1_Resp_oMIBCAN_4a529922_Tx
            KS_SSN_ABT_1_Resp_oMIBCAN_4a76184e_Tx (PduRDestPdu): PduRDestPduRef=EcucPduCollection/KS_SSN_ABT_1_Resp_oMIBCAN_4a76184e_Tx
            PduRSrcPdu_b7c723e1 (PduRSrcPdu): PduRSrcPduRef=EcucPduCollection/KS_SSN_ABT_1_Resp_oMIBCAN_4a529922_Tx
          Klemmen_Status_01_oMIBCAN_cc9f7e61_Rx
            Klemmen_Status_01_oMIBCAN_cc9f7e61_Rx_9111e06e_Rx (PduRDestPdu): PduRDestPduRef=EcucPduCollection/Klemmen_Status_01_oMIBCAN_c14dd5d5_Rx
            PduRSrcPdu_9111e06e (PduRSrcPdu): PduRSrcPduRef=EcucPduCollection/Klemmen_Status_01_oMIBCAN_cc9f7e61_Rx
          NMH_ABT_1_oMIBCAN_95150102_Tx
            NMH_ABT_1_oMIBCAN_95150102_Tx_1ab2c35d_Tx (PduRDestPdu): PduRDestPduRef=EcucPduCollection/NMH_ABT_1_oMIBCAN_95150102_Tx
            PduRSrcPdu_1ab2c35d (PduRSrcPdu): PduRSrcPduRef=EcucPduCollection/NMH_ABT_1_oMIBCAN_95150102_Tx
          OBDC_SSN_ABT_1_Req_oMIBCAN_f307405b_Rx
            OBDC_SSN_ABT_1_Req_oMIBCAN_f307405b_Rx_8ad6bcae_Rx (PduRDestPdu): PduRDestPduRef=OBDC_SSN_ABT_1_Req_oMIBCAN_0f9cb27d_Rx
            PduRSrcPdu_8ad6bcae (PduRSrcPdu): PduRSrcPduRef=EcucPduCollection/OBDC_SSN_ABT_1_Req_oMIBCAN_f307405b_Rx
          OBDC_SSN_ABT_1_Resp_oMIBCAN_396e286d_Tx
            OBDC_SSN_ABT_1_Resp_oMIBCAN_5724c6df_Tx (PduRDestPdu): PduRDestPduRef=EcucPduCollection/OBDC_SSN_ABT_1_Resp_oMIBCAN_5724c6df_Tx
            PduRSrcPdu_6c45a23d (PduRSrcPdu): PduRSrcPduRef=EcucPduCollection/OBDC_SSN_ABT_1_Resp_oMIBCAN_396e286d_Tx
          ORU_01_oMIBCAN_ee71652b_Rx
            ORU_01_oMIBCAN_ee71652b_Rx_bc89ef96_Rx (PduRDestPdu): PduRDestPduRef=EcucPduCollection/ORU_01_oMIBCAN_27f873fd_Rx
            PduRSrcPdu_bc89ef96 (PduRSrcPdu): PduRSrcPduRef=EcucPduCollection/ORU_01_oMIBCAN_ee71652b_Rx
          Systeminfo_01_oMIBCAN_de81f20c_Rx
            Systeminfo_01_oMIBCAN_de81f20c_Rx_861d4304_Rx (PduRDestPdu): PduRDestPduRef=EcucPduCollection/Systeminfo_01_oMIBCAN_86e3ebe7_Rx
            PduRSrcPdu_861d4304 (PduRSrcPdu): PduRSrcPduRef=EcucPduCollection/Systeminfo_01_oMIBCAN_de81f20c_Rx
          Zentralrechner_01_oMIBCAN_76551c99_Rx
            Zentralrechner_01_oMIBCAN_76551c99_Rx_7d8f78e7_Rx (PduRDestPdu): PduRDestPduRef=EcucPduCollection/Zentralrechner_01_oMIBCAN_e5318f4e_Rx
            PduRSrcPdu_7d8f78e7 (PduRSrcPdu): PduRSrcPduRef=EcucPduCollection/Zentralrechner_01_oMIBCAN_76551c99_Rx
          Zentralrechner_04_oMIBCAN_2863c66c_Rx
            Zentralrechner_04_oMIBCAN_2863c66c_Rx_ae394fbc_Rx (PduRDestPdu): PduRDestPduRef=EcucPduCollection/Zentralrechner_04_oMIBCAN_afa6ca01_Rx
            PduRSrcPdu_ae394fbc (PduRSrcPdu): PduRSrcPduRef=EcucPduCollection/Zentralrechner_04_oMIBCAN_2863c66c_Rx
