AUTOSAR XML (schema 00048)
package /InitialEcuC
  ecuc value collection InitialEcuC: ecuc-values=[Dcm, Dem]
  module config Dcm: module-description=Dcm_Impl
    DcmConfigSet
      DcmGeneral
      DcmDsd
        DcmDsdServiceTable
          14 x DcmDsdService:
            DiagSessionControl: DcmDsdSidTabServiceId=16, DcmDsdSidTabSubfuncAvail=true
              5 x DcmDsdSubService, all with DcmDsdSubServiceSessionLevelRef=DcmDspSession/Extended:
                Default: DcmDsdSubServiceId=1, DcmDsdSubServiceSessionLevelRef=DcmDspSession/Default, DcmDsdSubServiceSessionLevelRef=INX_End_Of_Line_Session, DcmDsdSubServiceSessionLevelRef=INX_Development_Session
                Programming: DcmDsdSubServiceId=2, DcmDsdSubServiceSessionLevelRef=DcmDspSession/Programming
                Extended: DcmDsdSubServiceId=3, DcmDsdSubServiceSessionLevelRef=DcmDspSession/Default, DcmDsdSubServiceSessionLevelRef=INX_End_Of_Line_Session, DcmDsdSubServiceSessionLevelRef=INX_Development_Session
                INXEndOfLineSession_Start: DcmDsdSubServiceId=96, DcmDsdSubServiceSessionLevelRef=DcmDspSession/Default, DcmDsdSubServiceSessionLevelRef=INX_End_Of_Line_Session, DcmDsdSubServiceSessionLevelRef=INX_Development_Session
                INXDevelopmentSession_Start: DcmDsdSubServiceId=97, DcmDsdSubServiceSessionLevelRef=DcmDspSession/Default, DcmDsdSubServiceSessionLevelRef=INX_End_Of_Line_Session, DcmDsdSubServiceSessionLevelRef=INX_Development_Session
            EcuReset: DcmDsdSidTabServiceId=17, DcmDsdSidTabSubfuncAvail=true
              Hard (DcmDsdSubService): DcmDsdSubServiceId=1
              KeyOffOn (DcmDsdSubService): DcmDsdSubServiceId=2
            ClearDiagInfo: DcmDsdSidTabServiceId=20, DcmDsdSidTabSubfuncAvail=false, DcmDsdSidTabSessionLevelRef=DcmDspSession/Default, DcmDsdSidTabSessionLevelRef=DcmDspSession/Extended, DcmDsdSidTabSessionLevelRef=INX_End_Of_Line_Session, DcmDsdSidTabSessionLevelRef=INX_Development_Session
            ReadDtcInfo: DcmDsdSidTabServiceId=25, DcmDsdSidTabSubfuncAvail=true, DcmDsdSidTabSessionLevelRef=DcmDspSession/Default, DcmDsdSidTabSessionLevelRef=DcmDspSession/Extended, DcmDsdSidTabSessionLevelRef=INX_End_Of_Line_Session, DcmDsdSidTabSessionLevelRef=INX_Development_Session
              6 x DcmDsdSubService, all with DcmDsdSubServiceSessionLevelRef=DcmDspSession/Default, DcmDsdSubServiceSessionLevelRef=DcmDspSession/Extended, DcmDsdSubServiceSessionLevelRef=INX_End_Of_Line_Session:
                RDTCBSM: DcmDsdSubServiceId=2, DcmDsdSubServiceSessionLevelRef=INX_Development_Session
                RNODTCBSM: DcmDsdSubServiceId=1, DcmDsdSubServiceSessionLevelRef=INX_Development_Session
                RDTCSSI: DcmDsdSubServiceId=3, DcmDsdSubServiceSessionLevelRef=INX_Development_Session
                RDTCSSBDTC: DcmDsdSubServiceId=4, DcmDsdSubServiceSessionLevelRef=INX_Development_Session
                RDTCEDRBDN: DcmDsdSubServiceId=6
                RDTCFDC: DcmDsdSubServiceId=20, DcmDsdSubServiceSessionLevelRef=INX_Development_Session
            ReadDataById: DcmDsdSidTabServiceId=34, DcmDsdSidTabSubfuncAvail=false
            SecurityAccess: DcmDsdSidTabServiceId=39, DcmDsdSidTabSubfuncAvail=true, DcmDsdSidTabSessionLevelRef=DcmDspSession/Programming, DcmDsdSidTabSessionLevelRef=DcmDspSession/Extended, DcmDsdSidTabSessionLevelRef=INX_End_Of_Line_Session, DcmDsdSidTabSessionLevelRef=INX_Development_Session
              Seed_Request (DcmDsdSubService):
                DcmDsdSubServiceId = 17
                DcmDsdSubServiceSessionLevelRef = DcmDspSession/Programming
                DcmDsdSubServiceSessionLevelRef = DcmDspSession/Extended
                DcmDsdSubServiceSessionLevelRef = INX_End_Of_Line_Session
                DcmDsdSubServiceSessionLevelRef = INX_Development_Session
              Key_Send (DcmDsdSubService):
                DcmDsdSubServiceId = 18
                DcmDsdSubServiceSessionLevelRef = DcmDspSession/Programming
                DcmDsdSubServiceSessionLevelRef = DcmDspSession/Extended
                DcmDsdSubServiceSessionLevelRef = INX_End_Of_Line_Session
                DcmDsdSubServiceSessionLevelRef = INX_Development_Session
            CommunicationControl: DcmDsdSidTabServiceId=40, DcmDsdSidTabSubfuncAvail=true, DcmDsdSidTabSessionLevelRef=DcmDspSession/Programming, DcmDsdSidTabSessionLevelRef=DcmDspSession/Extended, DcmDsdSidTabSessionLevelRef=INX_End_Of_Line_Session, DcmDsdSidTabSessionLevelRef=INX_Development_Session
              EnableRxAndTx (DcmDsdSubService):
                DcmDsdSubServiceId = 0
                DcmDsdSubServiceSessionLevelRef = DcmDspSession/Programming
                DcmDsdSubServiceSessionLevelRef = DcmDspSession/Extended
                DcmDsdSubServiceSessionLevelRef = INX_End_Of_Line_Session
                DcmDsdSubServiceSessionLevelRef = INX_Development_Session
              EnableRxAndDisableTx (DcmDsdSubService):
                DcmDsdSubServiceId = 1
                DcmDsdSubServiceSessionLevelRef = DcmDspSession/Programming
                DcmDsdSubServiceSessionLevelRef = DcmDspSession/Extended
                DcmDsdSubServiceSessionLevelRef = INX_End_Of_Line_Session
                DcmDsdSubServiceSessionLevelRef = INX_Development_Session
            WriteDataById: DcmDsdSidTabServiceId=46, DcmDsdSidTabSubfuncAvail=false, DcmDsdSidTabSessionLevelRef=DcmDspSession/Programming, DcmDsdSidTabSessionLevelRef=DcmDspSession/Extended, DcmDsdSidTabSessionLevelRef=INX_End_Of_Line_Session, DcmDsdSidTabSessionLevelRef=INX_Development_Session
            RoutineControl: DcmDsdSidTabServiceId=49, DcmDsdSidTabSubfuncAvail=true
            RequestDownload: DcmDsdSidTabServiceId=52, DcmDsdSidTabSubfuncAvail=false, DcmDsdSidTabSessionLevelRef=DcmDspSession/Programming, DcmDsdSidTabSecurityLevelRef=Level_17
            TransferData: DcmDsdSidTabServiceId=54, DcmDsdSidTabSubfuncAvail=false, DcmDsdSidTabSessionLevelRef=DcmDspSession/Programming, DcmDsdSidTabSecurityLevelRef=Level_17
            RequestTransferExit: DcmDsdSidTabServiceId=55, DcmDsdSidTabSubfuncAvail=false, DcmDsdSidTabSessionLevelRef=DcmDspSession/Programming, DcmDsdSidTabSecurityLevelRef=Level_17
            TesterPresent: DcmDsdSidTabServiceId=62, DcmDsdSidTabSubfuncAvail=true
              TesterPresent (DcmDsdSubService): DcmDsdSubServiceId=0
            ControlDtcSetting: DcmDsdSidTabServiceId=133, DcmDsdSidTabSubfuncAvail=true, DcmDsdSidTabSessionLevelRef=DcmDspSession/Programming, DcmDsdSidTabSessionLevelRef=DcmDspSession/Extended, DcmDsdSidTabSessionLevelRef=INX_End_Of_Line_Session, DcmDsdSidTabSessionLevelRef=INX_Development_Session
              Enable (DcmDsdSubService):
                DcmDsdSubServiceId = 1
                DcmDsdSubServiceSessionLevelRef = DcmDspSession/Programming
                DcmDsdSubServiceSessionLevelRef = DcmDspSession/Extended
                DcmDsdSubServiceSessionLevelRef = INX_End_Of_Line_Session
                DcmDsdSubServiceSessionLevelRef = INX_Development_Session
              Disable (DcmDsdSubService):
                DcmDsdSubServiceId = 2
                DcmDsdSubServiceSessionLevelRef = DcmDspSession/Programming
                DcmDsdSubServiceSessionLevelRef = DcmDspSession/Extended
                DcmDsdSubServiceSessionLevelRef = INX_End_Of_Line_Session
                DcmDsdSubServiceSessionLevelRef = INX_Development_Session
      DcmDsp: DcmDspMaxDidToRead=1
        BasicSettingsStatus_Read_Status (DcmDspData): DcmDspDataSize=8, DcmDspDataType=UINT8, DcmDspDataInfoRef=DataInfo_BasicSettingsStatus_Read_Status
        DataInfo_BasicSettingsStatus_Read_Status (DcmDspDataInfo): DcmDspDataFixedLength=true
        VWLogicalBlockDowngradeVersions_Read_data (DcmDspData): DcmDspDataSize=392, DcmDspDataType=UINT8_N, DcmDspDataInfoRef=DataInfo_VWLogicalBlockDowngradeVersions_Read_data
        DataInfo_VWLogicalBlockDowngradeVersions_Read_data (DcmDspDataInfo): DcmDspDataFixedLength=true
        Configuration_hash_Read_Data (DcmDspData): DcmDspDataSize=256, DcmDspDataType=UINT8_N, DcmDspDataInfoRef=DataInfo_Configuration_hash_Read_Data
        DataInfo_Configuration_hash_Read_Data (DcmDspDataInfo): DcmDspDataFixedLength=true
        Programming_hash_Read_Data (DcmDspData): DcmDspDataSize=256, DcmDspDataType=UINT8_N, DcmDspDataInfoRef=DataInfo_Programming_hash_Read_Data
        DataInfo_Programming_hash_Read_Data (DcmDspDataInfo): DcmDspDataFixedLength=true
        Integrity_validation_data_configuration_list_Read_Data (DcmDspData): DcmDspDataSize=32736, DcmDspDataType=UINT8_N, DcmDspDataInfoRef=DataInfo_Integrity_validation_data_configuration_list_Read_Data
        DataInfo_Integrity_validation_data_configuration_list_Read_Data (DcmDspDataInfo): DcmDspDataFixedLength=false
        VWLogicalBlockCounterOfProgrammingAttempts_Read_data (DcmDspData): DcmDspDataSize=96, DcmDspDataType=UINT8_N, DcmDspDataInfoRef=DataInfo_VWLogicalBlockCounterOfProgrammingAttempts_Read_data
        DataInfo_VWLogicalBlockCounterOfProgrammingAttempts_Read_data (DcmDspDataInfo): DcmDspDataFixedLength=true
        VWLogicalBlockLockValue_Read_data (DcmDspData): DcmDspDataSize=96, DcmDspDataType=UINT8_N, DcmDspDataInfoRef=DataInfo_VWLogicalBlockLockValue_Read_data
        DataInfo_VWLogicalBlockLockValue_Read_data (DcmDspDataInfo): DcmDspDataFixedLength=true
        BootloaderTPBlocksize_Read_Blocksize (DcmDspData): DcmDspDataSize=8, DcmDspDataType=UINT8, DcmDspDataInfoRef=DataInfo_BootloaderTPBlocksize_Read_Blocksize
        DataInfo_BootloaderTPBlocksize_Read_Blocksize (DcmDspDataInfo): DcmDspDataFixedLength=true
        ProgrammingPreconditions_Read_ProgrammingPreconditions (DcmDspData): DcmDspDataSize=16, DcmDspDataType=UINT8_N, DcmDspDataInfoRef=DataInfo_ProgrammingPreconditions_Read_ProgrammingPreconditions
        DataInfo_ProgrammingPreconditions_Read_ProgrammingPreconditions (DcmDspDataInfo): DcmDspDataFixedLength=true
        CddTouchCypressGen7_DisplayTouchConfiguration_Read_pData (DcmDspData): DcmDspDataSize=480, DcmDspDataType=UINT8_N, DcmDspDataInfoRef=DataInfo_CddTouchCypressGen7_DisplayTouchConfiguration_Read_pData
        DataInfo_CddTouchCypressGen7_DisplayTouchConfiguration_Read_pData (DcmDspDataInfo): DcmDspDataFixedLength=true
        CddTouchCypressGen7_SlideTouchConfiguration_Read_pData (DcmDspData): DcmDspDataSize=160, DcmDspDataType=UINT8_N, DcmDspDataInfoRef=DataInfo_CddTouchCypressGen7_SlideTouchConfiguration_Read_pData
        DataInfo_CddTouchCypressGen7_SlideTouchConfiguration_Read_pData (DcmDspDataInfo): DcmDspDataFixedLength=true
        CddNvmManager_NvmDisplayDimLutDay_Read_data (DcmDspData): DcmDspDataSize=144, DcmDspDataType=UINT8_N, DcmDspDataInfoRef=DataInfo_CddNvmManager_NvmDisplayDimLutDay_Read_data
        DataInfo_CddNvmManager_NvmDisplayDimLutDay_Read_data (DcmDspDataInfo): DcmDspDataFixedLength=true
        CddNvmManager_NvmSliderDimLut_Read_data (DcmDspData): DcmDspDataSize=48, DcmDspDataType=UINT8_N, DcmDspDataInfoRef=DataInfo_CddNvmManager_NvmSliderDimLut_Read_data
        DataInfo_CddNvmManager_NvmSliderDimLut_Read_data (DcmDspDataInfo): DcmDspDataFixedLength=true
        CddNvmManager_NvmDisplayDimLutNight_Read_data (DcmDspData): DcmDspDataSize=144, DcmDspDataType=UINT8_N, DcmDspDataInfoRef=DataInfo_CddNvmManager_NvmDisplayDimLutNight_Read_data
        DataInfo_CddNvmManager_NvmDisplayDimLutNight_Read_data (DcmDspDataInfo): DcmDspDataFixedLength=true
        SwcTestInterface_DeveloperMode_Read_developerMode (DcmDspData): DcmDspDataSize=8, DcmDspDataType=UINT8, DcmDspDataInfoRef=DataInfo_SwcTestInterface_DeveloperMode_Read_developerMode
        DataInfo_SwcTestInterface_DeveloperMode_Read_developerMode (DcmDspDataInfo): DcmDspDataFixedLength=true
        Fingerprint_Read_data (DcmDspData): DcmDspDataSize=72, DcmDspDataType=UINT8_N, DcmDspDataInfoRef=DataInfo_Fingerprint_Read_data
        DataInfo_Fingerprint_Read_data (DcmDspDataInfo): DcmDspDataFixedLength=true
        FingerprintLogicalBlock_Read_data (DcmDspData): DcmDspDataSize=480, DcmDspDataType=UINT8_N, DcmDspDataInfoRef=DataInfo_FingerprintLogicalBlock_Read_data
        DataInfo_FingerprintLogicalBlock_Read_data (DcmDspDataInfo): DcmDspDataFixedLength=true
        VWFAZITIdentificationString_Read_fazitIdString (DcmDspData): DcmDspDataSize=184, DcmDspDataType=UINT8_N, DcmDspDataInfoRef=DataInfo_VWFAZITIdentificationString_Read_fazitIdString
        DataInfo_VWFAZITIdentificationString_Read_fazitIdString (DcmDspDataInfo): DcmDspDataFixedLength=true
        ActiveDiagnosticSession_Read_Session (DcmDspData): DcmDspDataSize=8, DcmDspDataType=UINT8, DcmDspDataInfoRef=DataInfo_ActiveDiagnosticSession_Read_Session
        DataInfo_ActiveDiagnosticSession_Read_Session (DcmDspDataInfo): DcmDspDataFixedLength=true
        VWSparePartNumber_Read_sparePartNr (DcmDspData): DcmDspDataSize=88, DcmDspDataType=UINT8_N, DcmDspDataInfoRef=DataInfo_VWSparePartNumber_Read_sparePartNr
        DataInfo_VWSparePartNumber_Read_sparePartNr (DcmDspDataInfo): DcmDspDataFixedLength=true
        VWApplicationSoftwareVersionNumber_Read_appSwVersion (DcmDspData): DcmDspDataSize=32, DcmDspDataType=UINT8_N, DcmDspDataInfoRef=DataInfo_VWApplicationSoftwareVersionNumber_Read_appSwVersion
        DataInfo_VWApplicationSoftwareVersionNumber_Read_appSwVersion (DcmDspDataInfo): DcmDspDataFixedLength=true
        ECUSerialNumber_Read_ecuSerNo (DcmDspData): DcmDspDataSize=160, DcmDspDataType=UINT8_N, DcmDspDataInfoRef=DataInfo_ECUSerialNumber_Read_ecuSerNo
        DataInfo_ECUSerialNumber_Read_ecuSerNo (DcmDspDataInfo): DcmDspDataFixedLength=true
        VWECUHardwareNumber_Read_ecuHwNo (DcmDspData): DcmDspDataSize=88, DcmDspDataType=UINT8_N, DcmDspDataInfoRef=DataInfo_VWECUHardwareNumber_Read_ecuHwNo
        DataInfo_VWECUHardwareNumber_Read_ecuHwNo (DcmDspDataInfo): DcmDspDataFixedLength=true
        VWSystemNameOrEngineType_Read_sysNameOrEngType (DcmDspData): DcmDspDataSize=104, DcmDspDataType=UINT8_N, DcmDspDataInfoRef=DataInfo_VWSystemNameOrEngineType_Read_sysNameOrEngType
        DataInfo_VWSystemNameOrEngineType_Read_sysNameOrEngType (DcmDspDataInfo): DcmDspDataFixedLength=true
        ASAMODXFileIdentifier_Read_asamOdxFileId (DcmDspData): DcmDspDataSize=208, DcmDspDataType=UINT8_N, DcmDspDataInfoRef=DataInfo_ASAMODXFileIdentifier_Read_asamOdxFileId
        DataInfo_ASAMODXFileIdentifier_Read_asamOdxFileId (DcmDspDataInfo): DcmDspDataFixedLength=false
        ASAMODXFileVersion_Read_asamOdxFileVer (DcmDspData): DcmDspDataSize=48, DcmDspDataType=UINT8_N, DcmDspDataInfoRef=DataInfo_ASAMODXFileVersion_Read_asamOdxFileVer
        DataInfo_ASAMODXFileVersion_Read_asamOdxFileVer (DcmDspDataInfo): DcmDspDataFixedLength=true
        VWECUHardwareVersionNumber_Read_ecuHwVerNo (DcmDspData): DcmDspDataSize=24, DcmDspDataType=UINT8_N, DcmDspDataInfoRef=DataInfo_VWECUHardwareVersionNumber_Read_ecuHwVerNo
        DataInfo_VWECUHardwareVersionNumber_Read_ecuHwVerNo (DcmDspDataInfo): DcmDspDataFixedLength=true
        VWLogicalBlockVersion_Read_data (DcmDspData): DcmDspDataSize=192, DcmDspDataType=UINT8_N, DcmDspDataInfoRef=DataInfo_VWLogicalBlockVersion_Read_data
        DataInfo_VWLogicalBlockVersion_Read_data (DcmDspDataInfo): DcmDspDataFixedLength=true
        TechnicalSpecificationsVersion_Read_techSpecVer (DcmDspData): DcmDspDataSize=208, DcmDspDataType=UINT8_N, DcmDspDataInfoRef=DataInfo_TechnicalSpecificationsVersion_Read_techSpecVer
        DataInfo_TechnicalSpecificationsVersion_Read_techSpecVer (DcmDspDataInfo): DcmDspDataFixedLength=true
        FDS_Project_Data_Read_Data (DcmDspData): DcmDspDataSize=312, DcmDspDataType=UINT8_N, DcmDspDataInfoRef=DataInfo_FDS_Project_Data_Read_Data
        DataInfo_FDS_Project_Data_Read_Data (DcmDspDataInfo): DcmDspDataFixedLength=true
        ECUProgrammingInformation_Read_Info (DcmDspData): DcmDspDataSize=8, DcmDspDataType=UINT8, DcmDspDataInfoRef=DataInfo_ECUProgrammingInformation_Read_Info
        DataInfo_ECUProgrammingInformation_Read_Info (DcmDspDataInfo): DcmDspDataFixedLength=true
        CddConnectionCheck_ConnectionCheck_Read_pData (DcmDspData): DcmDspDataSize=40, DcmDspDataType=UINT8_N, DcmDspDataInfoRef=DataInfo_CddConnectionCheck_ConnectionCheck_Read_pData
        DataInfo_CddConnectionCheck_ConnectionCheck_Read_pData (DcmDspDataInfo): DcmDspDataFixedLength=true
        CddNvMManager_DiagEepromWriteCounter_Read_counter (DcmDspData): DcmDspDataSize=16, DcmDspDataType=UINT16, DcmDspDataInfoRef=DataInfo_CddNvMManager_DiagEepromWriteCounter_Read_counter
        DataInfo_CddNvMManager_DiagEepromWriteCounter_Read_counter (DcmDspDataInfo): DcmDspDataFixedLength=true
        CddTouchCypressGen7_HardwareVersion_Read_hwVersion (DcmDspData): DcmDspDataSize=32, DcmDspDataType=UINT8_N, DcmDspDataInfoRef=DataInfo_CddTouchCypressGen7_HardwareVersion_Read_hwVersion
        DataInfo_CddTouchCypressGen7_HardwareVersion_Read_hwVersion (DcmDspDataInfo): DcmDspDataFixedLength=true
        CddTouchCypressGen7_SoftwareVersion_Read_swVersion (DcmDspData): DcmDspDataSize=128, DcmDspDataType=UINT8_N, DcmDspDataInfoRef=DataInfo_CddTouchCypressGen7_SoftwareVersion_Read_swVersion
        DataInfo_CddTouchCypressGen7_SoftwareVersion_Read_swVersion (DcmDspDataInfo): DcmDspDataFixedLength=true
        CddTouchCypressGen7_ManufacturerData_Read_manufacturerData (DcmDspData): DcmDspDataSize=80, DcmDspDataType=UINT8_N, DcmDspDataInfoRef=DataInfo_CddTouchCypressGen7_ManufacturerData_Read_manufacturerData
        DataInfo_CddTouchCypressGen7_ManufacturerData_Read_manufacturerData (DcmDspDataInfo): DcmDspDataFixedLength=true
        CddBooster_BacklightDutyCycle_Read_percentage (DcmDspData): DcmDspDataSize=16, DcmDspDataType=UINT16, DcmDspDataInfoRef=DataInfo_CddBooster_BacklightDutyCycle_Read_percentage
        DataInfo_CddBooster_BacklightDutyCycle_Read_percentage (DcmDspDataInfo): DcmDspDataFixedLength=true
        CddTemperatureMonitor_MaximumTemperature_Read_temperature (DcmDspData): DcmDspDataSize=8, DcmDspDataType=SINT8, DcmDspDataInfoRef=DataInfo_CddTemperatureMonitor_MaximumTemperature_Read_temperature
        DataInfo_CddTemperatureMonitor_MaximumTemperature_Read_temperature (DcmDspDataInfo): DcmDspDataFixedLength=true
        CddTemperatureMonitor_MinimumTemperature_Read_temperature (DcmDspData): DcmDspDataSize=8, DcmDspDataType=SINT8, DcmDspDataInfoRef=DataInfo_CddTemperatureMonitor_MinimumTemperature_Read_temperature
        DataInfo_CddTemperatureMonitor_MinimumTemperature_Read_temperature (DcmDspDataInfo): DcmDspDataFixedLength=true
        CddVoltageMonitor_MaxBatteryVoltage_Read_pData (DcmDspData): DcmDspDataSize=8, DcmDspDataType=UINT8, DcmDspDataInfoRef=DataInfo_CddVoltageMonitor_MaxBatteryVoltage_Read_pData
        DataInfo_CddVoltageMonitor_MaxBatteryVoltage_Read_pData (DcmDspDataInfo): DcmDspDataFixedLength=true
        CddVoltageMonitor_MinBatteryVoltage_Read_pData (DcmDspData): DcmDspDataSize=8, DcmDspDataType=UINT8, DcmDspDataInfoRef=DataInfo_CddVoltageMonitor_MinBatteryVoltage_Read_pData
        DataInfo_CddVoltageMonitor_MinBatteryVoltage_Read_pData (DcmDspDataInfo): DcmDspDataFixedLength=true
        CddSliderBackLightTiSN1903001_BacklightDutyCycle_Read_percentage (DcmDspData): DcmDspDataSize=16, DcmDspDataType=UINT16, DcmDspDataInfoRef=DataInfo_CddSliderBackLightTiSN1903001_BacklightDutyCycle_Read_percentage
        DataInfo_CddSliderBackLightTiSN1903001_BacklightDutyCycle_Read_percentage (DcmDspDataInfo): DcmDspDataFixedLength=true
        CddWakeupDetect_ResetCounters_Read_rstCntrs (DcmDspData): DcmDspDataSize=144, DcmDspDataType=UINT8_N, DcmDspDataInfoRef=DataInfo_CddWakeupDetect_ResetCounters_Read_rstCntrs
        DataInfo_CddWakeupDetect_ResetCounters_Read_rstCntrs (DcmDspDataInfo): DcmDspDataFixedLength=true
        CddCodeFlashAccess_ResetVector_Read_ResetVector (DcmDspData): DcmDspDataSize=32, DcmDspDataType=UINT32, DcmDspDataInfoRef=DataInfo_CddCodeFlashAccess_ResetVector_Read_ResetVector
        DataInfo_CddCodeFlashAccess_ResetVector_Read_ResetVector (DcmDspDataInfo): DcmDspDataFixedLength=true
        SwcDimming_DisplayDimmingOutPreOffset_Read_data (DcmDspData): DcmDspDataSize=32, DcmDspDataType=UINT8_N, DcmDspDataInfoRef=DataInfo_SwcDimming_DisplayDimmingOutPreOffset_Read_data
        DataInfo_SwcDimming_DisplayDimmingOutPreOffset_Read_data (DcmDspDataInfo): DcmDspDataFixedLength=true
        SwcDimming_DisplayDimmingOutPostOffset_Read_data (DcmDspData): DcmDspDataSize=32, DcmDspDataType=UINT8_N, DcmDspDataInfoRef=DataInfo_SwcDimming_DisplayDimmingOutPostOffset_Read_data
        DataInfo_SwcDimming_DisplayDimmingOutPostOffset_Read_data (DcmDspDataInfo): DcmDspDataFixedLength=true
        SwcDimming_DisplayDimmingOutPwm_Read_data (DcmDspData): DcmDspDataSize=32, DcmDspDataType=UINT8_N, DcmDspDataInfoRef=DataInfo_SwcDimming_DisplayDimmingOutPwm_Read_data
        DataInfo_SwcDimming_DisplayDimmingOutPwm_Read_data (DcmDspDataInfo): DcmDspDataFixedLength=true
        SwcDimming_SliderDimmingOutPwm_Read_data (DcmDspData): DcmDspDataSize=32, DcmDspDataType=UINT8_N, DcmDspDataInfoRef=DataInfo_SwcDimming_SliderDimmingOutPwm_Read_data
        DataInfo_SwcDimming_SliderDimmingOutPwm_Read_data (DcmDspDataInfo): DcmDspDataFixedLength=true
        SwcSelfDiagnostics_EcuRuntime_Read_ecuRuntime (DcmDspData): DcmDspDataSize=32, DcmDspDataType=UINT32, DcmDspDataInfoRef=DataInfo_SwcSelfDiagnostics_EcuRuntime_Read_ecuRuntime
        DataInfo_SwcSelfDiagnostics_EcuRuntime_Read_ecuRuntime (DcmDspDataInfo): DcmDspDataFixedLength=true
        SwcSelfDiagnostics_CpuLoad_Read_pData (DcmDspData): DcmDspDataSize=16, DcmDspDataType=UINT16, DcmDspDataInfoRef=DataInfo_SwcSelfDiagnostics_CpuLoad_Read_pData
        DataInfo_SwcSelfDiagnostics_CpuLoad_Read_pData (DcmDspDataInfo): DcmDspDataFixedLength=true
        SwcVerify_VerifyEnable_Read_verifyMode (DcmDspData): DcmDspDataSize=8, DcmDspDataType=UINT8, DcmDspDataInfoRef=DataInfo_SwcVerify_VerifyEnable_Read_verifyMode
        DataInfo_SwcVerify_VerifyEnable_Read_verifyMode (DcmDspDataInfo): DcmDspDataFixedLength=true
        SwcComHandlerTx_PropEepromWriteCounter_Read_counter (DcmDspData): DcmDspDataSize=16, DcmDspDataType=UINT16, DcmDspDataInfoRef=DataInfo_SwcComHandlerTx_PropEepromWriteCounter_Read_counter
        DataInfo_SwcComHandlerTx_PropEepromWriteCounter_Read_counter (DcmDspDataInfo): DcmDspDataFixedLength=true
        SwcDisplayInfo_DisplayName_Read_dispName (DcmDspData): DcmDspDataSize=512, DcmDspDataType=UINT8_N, DcmDspDataInfoRef=DataInfo_SwcDisplayInfo_DisplayName_Read_dispName
        DataInfo_SwcDisplayInfo_DisplayName_Read_dispName (DcmDspDataInfo): DcmDspDataFixedLength=true
        SwcDisplayInfo_DisplayVariant_Read_dispVariant (DcmDspData): DcmDspDataSize=512, DcmDspDataType=UINT8_N, DcmDspDataInfoRef=DataInfo_SwcDisplayInfo_DisplayVariant_Read_dispVariant
        DataInfo_SwcDisplayInfo_DisplayVariant_Read_dispVariant (DcmDspDataInfo): DcmDspDataFixedLength=true
        SwcDisplayInfo_DisplayHardwareVersion_Read_dispHwVersion (DcmDspData): DcmDspDataSize=128, DcmDspDataType=UINT8_N, DcmDspDataInfoRef=DataInfo_SwcDisplayInfo_DisplayHardwareVersion_Read_dispHwVersion
        DataInfo_SwcDisplayInfo_DisplayHardwareVersion_Read_dispHwVersion (DcmDspDataInfo): DcmDspDataFixedLength=true
        SwcDisplayInfo_ApplicationSoftwareVersion_Read_appSwVersion (DcmDspData): DcmDspDataSize=128, DcmDspDataType=UINT8_N, DcmDspDataInfoRef=DataInfo_SwcDisplayInfo_ApplicationSoftwareVersion_Read_appSwVersion
        DataInfo_SwcDisplayInfo_ApplicationSoftwareVersion_Read_appSwVersion (DcmDspDataInfo): DcmDspDataFixedLength=true
        SwcDisplayInfo_SvnUrl_Read_svnUrl (DcmDspData): DcmDspDataSize=2048, DcmDspDataType=UINT8_N, DcmDspDataInfoRef=DataInfo_SwcDisplayInfo_SvnUrl_Read_svnUrl
        DataInfo_SwcDisplayInfo_SvnUrl_Read_svnUrl (DcmDspDataInfo): DcmDspDataFixedLength=true
        SwcDisplayInfo_SvnRevision_Read_svnRevision (DcmDspData): DcmDspDataSize=512, DcmDspDataType=UINT8_N, DcmDspDataInfoRef=DataInfo_SwcDisplayInfo_SvnRevision_Read_svnRevision
        DataInfo_SwcDisplayInfo_SvnRevision_Read_svnRevision (DcmDspDataInfo): DcmDspDataFixedLength=true
        SwcDisplayInfo_HardwareIdentification_Read_hwId (DcmDspData): DcmDspDataSize=416, DcmDspDataType=UINT8_N, DcmDspDataInfoRef=DataInfo_SwcDisplayInfo_HardwareIdentification_Read_hwId
        DataInfo_SwcDisplayInfo_HardwareIdentification_Read_hwId (DcmDspDataInfo): DcmDspDataFixedLength=true
        59 x DcmDspDid:
          BasicSettingsStatus_Read: DcmDspDidIdentifier=258, DcmDspDidInfoRef=DidInfo_BasicSettingsStatus_Read
            Status (DcmDspDidSignal): DcmDspDidDataPos=0, DcmDspDidDataRef=BasicSettingsStatus_Read_Status
          VWLogicalBlockDowngradeVersions_Read: DcmDspDidIdentifier=393, DcmDspDidInfoRef=DidInfo_VWLogicalBlockDowngradeVersions_Read
            data (DcmDspDidSignal): DcmDspDidDataPos=0, DcmDspDidDataRef=VWLogicalBlockDowngradeVersions_Read_data
          Configuration_hash_Read: DcmDspDidIdentifier=581, DcmDspDidInfoRef=DidInfo_Configuration_hash_Read
            Data (DcmDspDidSignal): DcmDspDidDataPos=0, DcmDspDidDataRef=Configuration_hash_Read_Data
          Programming_hash_Read: DcmDspDidIdentifier=585, DcmDspDidInfoRef=DidInfo_Programming_hash_Read
            Data (DcmDspDidSignal): DcmDspDidDataPos=0, DcmDspDidDataRef=Programming_hash_Read_Data
          Integrity_validation_data_configuration_list_Read: DcmDspDidIdentifier=592, DcmDspDidInfoRef=DidInfo_Integrity_validation_data_configuration_list_Read
            Data (DcmDspDidSignal): DcmDspDidDataPos=0, DcmDspDidDataRef=Integrity_validation_data_configuration_list_Read_Data
          VWLogicalBlockCounterOfProgrammingAttempts_Read: DcmDspDidIdentifier=1031, DcmDspDidInfoRef=DidInfo_VWLogicalBlockCounterOfProgrammingAttempts_Read
            data (DcmDspDidSignal): DcmDspDidDataPos=0, DcmDspDidDataRef=VWLogicalBlockCounterOfProgrammingAttempts_Read_data
          VWLogicalBlockLockValue_Read: DcmDspDidIdentifier=1039, DcmDspDidInfoRef=DidInfo_VWLogicalBlockLockValue_Read
            data (DcmDspDidSignal): DcmDspDidDataPos=0, DcmDspDidDataRef=VWLogicalBlockLockValue_Read_data
          BootloaderTPBlocksize_Read: DcmDspDidIdentifier=1040, DcmDspDidInfoRef=DidInfo_BootloaderTPBlocksize_Read
            Blocksize (DcmDspDidSignal): DcmDspDidDataPos=0, DcmDspDidDataRef=BootloaderTPBlocksize_Read_Blocksize
          ProgrammingPreconditions_Read: DcmDspDidIdentifier=1096, DcmDspDidInfoRef=DidInfo_ProgrammingPreconditions_Read
            ProgrammingPreconditions (DcmDspDidSignal): DcmDspDidDataPos=0, DcmDspDidDataRef=ProgrammingPreconditions_Read_ProgrammingPreconditions
          CddTouchCypressGen7_DisplayTouchConfiguration_Read: DcmDspDidIdentifier=1320, DcmDspDidInfoRef=DidInfo_CddTouchCypressGen7_DisplayTouchConfiguration_Read
            pData (DcmDspDidSignal): DcmDspDidDataPos=0, DcmDspDidDataRef=CddTouchCypressGen7_DisplayTouchConfiguration_Read_pData
          CddTouchCypressGen7_SlideTouchConfiguration_Read: DcmDspDidIdentifier=1321, DcmDspDidInfoRef=DidInfo_CddTouchCypressGen7_SlideTouchConfiguration_Read
            pData (DcmDspDidSignal): DcmDspDidDataPos=0, DcmDspDidDataRef=CddTouchCypressGen7_SlideTouchConfiguration_Read_pData
          CddNvmManager_NvmDisplayDimLutDay_Read: DcmDspDidIdentifier=1408, DcmDspDidInfoRef=DidInfo_CddNvmManager_NvmDisplayDimLutDay_Read
            data (DcmDspDidSignal): DcmDspDidDataPos=0, DcmDspDidDataRef=CddNvmManager_NvmDisplayDimLutDay_Read_data
          CddNvmManager_NvmSliderDimLut_Read: DcmDspDidIdentifier=2885, DcmDspDidInfoRef=DidInfo_CddNvmManager_NvmSliderDimLut_Read
            data (DcmDspDidSignal): DcmDspDidDataPos=0, DcmDspDidDataRef=CddNvmManager_NvmSliderDimLut_Read_data
          CddNvmManager_NvmDisplayDimLutNight_Read: DcmDspDidIdentifier=2887, DcmDspDidInfoRef=DidInfo_CddNvmManager_NvmDisplayDimLutNight_Read
            data (DcmDspDidSignal): DcmDspDidDataPos=0, DcmDspDidDataRef=CddNvmManager_NvmDisplayDimLutNight_Read_data
          SwcTestInterface_DeveloperMode_Read: DcmDspDidIdentifier=9279, DcmDspDidInfoRef=DidInfo_SwcTestInterface_DeveloperMode_Read
            developerMode (DcmDspDidSignal): DcmDspDidDataPos=0, DcmDspDidDataRef=SwcTestInterface_DeveloperMode_Read_developerMode
          Fingerprint_Read: DcmDspDidIdentifier=61786, DcmDspDidInfoRef=DidInfo_Fingerprint_Read
            data (DcmDspDidSignal): DcmDspDidDataPos=0, DcmDspDidDataRef=Fingerprint_Read_data
          FingerprintLogicalBlock_Read: DcmDspDidIdentifier=61787, DcmDspDidInfoRef=DidInfo_FingerprintLogicalBlock_Read
            data (DcmDspDidSignal): DcmDspDidDataPos=0, DcmDspDidDataRef=FingerprintLogicalBlock_Read_data
          VWFAZITIdentificationString_Read: DcmDspDidIdentifier=61820, DcmDspDidInfoRef=DidInfo_VWFAZITIdentificationString_Read
            fazitIdString (DcmDspDidSignal): DcmDspDidDataPos=0, DcmDspDidDataRef=VWFAZITIdentificationString_Read_fazitIdString
          ActiveDiagnosticSession_Read: DcmDspDidIdentifier=61830, DcmDspDidInfoRef=DidInfo_ActiveDiagnosticSession_Read
            Session (DcmDspDidSignal): DcmDspDidDataPos=0, DcmDspDidDataRef=ActiveDiagnosticSession_Read_Session
          VWSparePartNumber_Read: DcmDspDidIdentifier=61831, DcmDspDidInfoRef=DidInfo_VWSparePartNumber_Read
            sparePartNr (DcmDspDidSignal): DcmDspDidDataPos=0, DcmDspDidDataRef=VWSparePartNumber_Read_sparePartNr
          VWApplicationSoftwareVersionNumber_Read: DcmDspDidIdentifier=61833, DcmDspDidInfoRef=DidInfo_VWApplicationSoftwareVersionNumber_Read
            appSwVersion (DcmDspDidSignal): DcmDspDidDataPos=0, DcmDspDidDataRef=VWApplicationSoftwareVersionNumber_Read_appSwVersion
          ECUSerialNumber_Read: DcmDspDidIdentifier=61836, DcmDspDidInfoRef=DidInfo_ECUSerialNumber_Read
            ecuSerNo (DcmDspDidSignal): DcmDspDidDataPos=0, DcmDspDidDataRef=ECUSerialNumber_Read_ecuSerNo
          VWECUHardwareNumber_Read: DcmDspDidIdentifier=61841, DcmDspDidInfoRef=DidInfo_VWECUHardwareNumber_Read
            ecuHwNo (DcmDspDidSignal): DcmDspDidDataPos=0, DcmDspDidDataRef=VWECUHardwareNumber_Read_ecuHwNo
          VWSystemNameOrEngineType_Read: DcmDspDidIdentifier=61847, DcmDspDidInfoRef=DidInfo_VWSystemNameOrEngineType_Read
            sysNameOrEngType (DcmDspDidSignal): DcmDspDidDataPos=0, DcmDspDidDataRef=VWSystemNameOrEngineType_Read_sysNameOrEngType
          ASAMODXFileIdentifier_Read: DcmDspDidIdentifier=61854, DcmDspDidInfoRef=DidInfo_ASAMODXFileIdentifier_Read
            asamOdxFileId (DcmDspDidSignal): DcmDspDidDataPos=0, DcmDspDidDataRef=ASAMODXFileIdentifier_Read_asamOdxFileId
          ASAMODXFileVersion_Read: DcmDspDidIdentifier=61858, DcmDspDidInfoRef=DidInfo_ASAMODXFileVersion_Read
            asamOdxFileVer (DcmDspDidSignal): DcmDspDidDataPos=0, DcmDspDidDataRef=ASAMODXFileVersion_Read_asamOdxFileVer
          VWECUHardwareVersionNumber_Read: DcmDspDidIdentifier=61859, DcmDspDidInfoRef=DidInfo_VWECUHardwareVersionNumber_Read
            ecuHwVerNo (DcmDspDidSignal): DcmDspDidDataPos=0, DcmDspDidDataRef=VWECUHardwareVersionNumber_Read_ecuHwVerNo
          VWLogicalBlockVersion_Read: DcmDspDidIdentifier=61867, DcmDspDidInfoRef=DidInfo_VWLogicalBlockVersion_Read
            data (DcmDspDidSignal): DcmDspDidDataPos=0, DcmDspDidDataRef=VWLogicalBlockVersion_Read_data
          TechnicalSpecificationsVersion_Read: DcmDspDidIdentifier=61876, DcmDspDidInfoRef=DidInfo_TechnicalSpecificationsVersion_Read
            techSpecVer (DcmDspDidSignal): DcmDspDidDataPos=0, DcmDspDidDataRef=TechnicalSpecificationsVersion_Read_techSpecVer
          FDS_Project_Data_Read: DcmDspDidIdentifier=61909, DcmDspDidInfoRef=DidInfo_FDS_Project_Data_Read
            Data (DcmDspDidSignal): DcmDspDidDataPos=0, DcmDspDidDataRef=FDS_Project_Data_Read_Data
          ECUProgrammingInformation_Read: DcmDspDidIdentifier=61919, DcmDspDidInfoRef=DidInfo_ECUProgrammingInformation_Read
            Info (DcmDspDidSignal): DcmDspDidDataPos=0, DcmDspDidDataRef=ECUProgrammingInformation_Read_Info
          CddConnectionCheck_ConnectionCheck_Read: DcmDspDidIdentifier=64768, DcmDspDidInfoRef=DidInfo_CddConnectionCheck_ConnectionCheck_Read
            pData (DcmDspDidSignal): DcmDspDidDataPos=0, DcmDspDidDataRef=CddConnectionCheck_ConnectionCheck_Read_pData
          CddNvMManager_DiagEepromWriteCounter_Read: DcmDspDidIdentifier=64776, DcmDspDidInfoRef=DidInfo_CddNvMManager_DiagEepromWriteCounter_Read
            counter (DcmDspDidSignal): DcmDspDidDataPos=0, DcmDspDidDataRef=CddNvMManager_DiagEepromWriteCounter_Read_counter
          CddTouchCypressGen7_HardwareVersion_Read: DcmDspDidIdentifier=64792, DcmDspDidInfoRef=DidInfo_CddTouchCypressGen7_HardwareVersion_Read
            hwVersion (DcmDspDidSignal): DcmDspDidDataPos=0, DcmDspDidDataRef=CddTouchCypressGen7_HardwareVersion_Read_hwVersion
          CddTouchCypressGen7_SoftwareVersion_Read: DcmDspDidIdentifier=64793, DcmDspDidInfoRef=DidInfo_CddTouchCypressGen7_SoftwareVersion_Read
            swVersion (DcmDspDidSignal): DcmDspDidDataPos=0, DcmDspDidDataRef=CddTouchCypressGen7_SoftwareVersion_Read_swVersion
          CddTouchCypressGen7_ManufacturerData_Read: DcmDspDidIdentifier=64794, DcmDspDidInfoRef=DidInfo_CddTouchCypressGen7_ManufacturerData_Read
            manufacturerData (DcmDspDidSignal): DcmDspDidDataPos=0, DcmDspDidDataRef=CddTouchCypressGen7_ManufacturerData_Read_manufacturerData
          CddBooster_BacklightDutyCycle_Read: DcmDspDidIdentifier=64801, DcmDspDidInfoRef=DidInfo_CddBooster_BacklightDutyCycle_Read
            percentage (DcmDspDidSignal): DcmDspDidDataPos=0, DcmDspDidDataRef=CddBooster_BacklightDutyCycle_Read_percentage
          CddTemperatureMonitor_MaximumTemperature_Read: DcmDspDidIdentifier=64816, DcmDspDidInfoRef=DidInfo_CddTemperatureMonitor_MaximumTemperature_Read
            temperature (DcmDspDidSignal): DcmDspDidDataPos=0, DcmDspDidDataRef=CddTemperatureMonitor_MaximumTemperature_Read_temperature
          CddTemperatureMonitor_MinimumTemperature_Read: DcmDspDidIdentifier=64817, DcmDspDidInfoRef=DidInfo_CddTemperatureMonitor_MinimumTemperature_Read
            temperature (DcmDspDidSignal): DcmDspDidDataPos=0, DcmDspDidDataRef=CddTemperatureMonitor_MinimumTemperature_Read_temperature
          CddVoltageMonitor_MaxBatteryVoltage_Read: DcmDspDidIdentifier=64824, DcmDspDidInfoRef=DidInfo_CddVoltageMonitor_MaxBatteryVoltage_Read
            pData (DcmDspDidSignal): DcmDspDidDataPos=0, DcmDspDidDataRef=CddVoltageMonitor_MaxBatteryVoltage_Read_pData
          CddVoltageMonitor_MinBatteryVoltage_Read: DcmDspDidIdentifier=64825, DcmDspDidInfoRef=DidInfo_CddVoltageMonitor_MinBatteryVoltage_Read
            pData (DcmDspDidSignal): DcmDspDidDataPos=0, DcmDspDidDataRef=CddVoltageMonitor_MinBatteryVoltage_Read_pData
          CddSliderBackLightTiSN1903001_BacklightDutyCycle_Read: DcmDspDidIdentifier=64896, DcmDspDidInfoRef=DidInfo_CddSliderBackLightTiSN1903001_BacklightDutyCycle_Read
            percentage (DcmDspDidSignal): DcmDspDidDataPos=0, DcmDspDidDataRef=CddSliderBackLightTiSN1903001_BacklightDutyCycle_Read_percentage
          CddWakeupDetect_ResetCounters_Read: DcmDspDidIdentifier=64920, DcmDspDidInfoRef=DidInfo_CddWakeupDetect_ResetCounters_Read
            rstCntrs (DcmDspDidSignal): DcmDspDidDataPos=0, DcmDspDidDataRef=CddWakeupDetect_ResetCounters_Read_rstCntrs
          CddCodeFlashAccess_ResetVector_Read: DcmDspDidIdentifier=64929, DcmDspDidInfoRef=DidInfo_CddCodeFlashAccess_ResetVector_Read
            ResetVector (DcmDspDidSignal): DcmDspDidDataPos=0, DcmDspDidDataRef=CddCodeFlashAccess_ResetVector_Read_ResetVector
          SwcDimming_DisplayDimmingOutPreOffset_Read: DcmDspDidIdentifier=65040, DcmDspDidInfoRef=DidInfo_SwcDimming_DisplayDimmingOutPreOffset_Read
            data (DcmDspDidSignal): DcmDspDidDataPos=0, DcmDspDidDataRef=SwcDimming_DisplayDimmingOutPreOffset_Read_data
          SwcDimming_DisplayDimmingOutPostOffset_Read: DcmDspDidIdentifier=65041, DcmDspDidInfoRef=DidInfo_SwcDimming_DisplayDimmingOutPostOffset_Read
            data (DcmDspDidSignal): DcmDspDidDataPos=0, DcmDspDidDataRef=SwcDimming_DisplayDimmingOutPostOffset_Read_data
          SwcDimming_DisplayDimmingOutPwm_Read: DcmDspDidIdentifier=65042, DcmDspDidInfoRef=DidInfo_SwcDimming_DisplayDimmingOutPwm_Read
            data (DcmDspDidSignal): DcmDspDidDataPos=0, DcmDspDidDataRef=SwcDimming_DisplayDimmingOutPwm_Read_data
          SwcDimming_SliderDimmingOutPwm_Read: DcmDspDidIdentifier=65043, DcmDspDidInfoRef=DidInfo_SwcDimming_SliderDimmingOutPwm_Read
            data (DcmDspDidSignal): DcmDspDidDataPos=0, DcmDspDidDataRef=SwcDimming_SliderDimmingOutPwm_Read_data
          SwcSelfDiagnostics_EcuRuntime_Read: DcmDspDidIdentifier=65096, DcmDspDidInfoRef=DidInfo_SwcSelfDiagnostics_EcuRuntime_Read
            ecuRuntime (DcmDspDidSignal): DcmDspDidDataPos=0, DcmDspDidDataRef=SwcSelfDiagnostics_EcuRuntime_Read_ecuRuntime
          SwcSelfDiagnostics_CpuLoad_Read: DcmDspDidIdentifier=65097, DcmDspDidInfoRef=DidInfo_SwcSelfDiagnostics_CpuLoad_Read
            pData (DcmDspDidSignal): DcmDspDidDataPos=0, DcmDspDidDataRef=SwcSelfDiagnostics_CpuLoad_Read_pData
          SwcVerify_VerifyEnable_Read: DcmDspDidIdentifier=65104, DcmDspDidInfoRef=DidInfo_SwcVerify_VerifyEnable_Read
            verifyMode (DcmDspDidSignal): DcmDspDidDataPos=0, DcmDspDidDataRef=SwcVerify_VerifyEnable_Read_verifyMode
          SwcComHandlerTx_PropEepromWriteCounter_Read: DcmDspDidIdentifier=65128, DcmDspDidInfoRef=DidInfo_SwcComHandlerTx_PropEepromWriteCounter_Read
            counter (DcmDspDidSignal): DcmDspDidDataPos=0, DcmDspDidDataRef=SwcComHandlerTx_PropEepromWriteCounter_Read_counter
          SwcDisplayInfo_DisplayName_Read: DcmDspDidIdentifier=65152, DcmDspDidInfoRef=DidInfo_SwcDisplayInfo_DisplayName_Read
            dispName (DcmDspDidSignal): DcmDspDidDataPos=0, DcmDspDidDataRef=SwcDisplayInfo_DisplayName_Read_dispName
          SwcDisplayInfo_DisplayVariant_Read: DcmDspDidIdentifier=65153, DcmDspDidInfoRef=DidInfo_SwcDisplayInfo_DisplayVariant_Read
            dispVariant (DcmDspDidSignal): DcmDspDidDataPos=0, DcmDspDidDataRef=SwcDisplayInfo_DisplayVariant_Read_dispVariant
          SwcDisplayInfo_DisplayHardwareVersion_Read: DcmDspDidIdentifier=65154, DcmDspDidInfoRef=DidInfo_SwcDisplayInfo_DisplayHardwareVersion_Read
            dispHwVersion (DcmDspDidSignal): DcmDspDidDataPos=0, DcmDspDidDataRef=SwcDisplayInfo_DisplayHardwareVersion_Read_dispHwVersion
          SwcDisplayInfo_ApplicationSoftwareVersion_Read: DcmDspDidIdentifier=65155, DcmDspDidInfoRef=DidInfo_SwcDisplayInfo_ApplicationSoftwareVersion_Read
            appSwVersion (DcmDspDidSignal): DcmDspDidDataPos=0, DcmDspDidDataRef=SwcDisplayInfo_ApplicationSoftwareVersion_Read_appSwVersion
          SwcDisplayInfo_SvnUrl_Read: DcmDspDidIdentifier=65156, DcmDspDidInfoRef=DidInfo_SwcDisplayInfo_SvnUrl_Read
            svnUrl (DcmDspDidSignal): DcmDspDidDataPos=0, DcmDspDidDataRef=SwcDisplayInfo_SvnUrl_Read_svnUrl
          SwcDisplayInfo_SvnRevision_Read: DcmDspDidIdentifier=65157, DcmDspDidInfoRef=DidInfo_SwcDisplayInfo_SvnRevision_Read
            svnRevision (DcmDspDidSignal): DcmDspDidDataPos=0, DcmDspDidDataRef=SwcDisplayInfo_SvnRevision_Read_svnRevision
          SwcDisplayInfo_HardwareIdentification_Read: DcmDspDidIdentifier=65158, DcmDspDidInfoRef=DidInfo_SwcDisplayInfo_HardwareIdentification_Read
            hwId (DcmDspDidSignal): DcmDspDidDataPos=0, DcmDspDidDataRef=SwcDisplayInfo_HardwareIdentification_Read_hwId
        59 x DcmDspDidInfo:
          DidInfo_BasicSettingsStatus_Read
            DcmDspDidAccess
              DcmDspDidRead:
                DcmDspDidReadSessionRef = DcmDspSession/Default
                DcmDspDidReadSessionRef = DcmDspSession/Extended
                DcmDspDidReadSessionRef = INX_End_Of_Line_Session
                DcmDspDidReadSessionRef = INX_Development_Session
          DidInfo_VWLogicalBlockDowngradeVersions_Read
            DcmDspDidAccess
              DcmDspDidRead
          DidInfo_Configuration_hash_Read
            DcmDspDidAccess
              DcmDspDidRead: DcmDspDidReadSessionRef=INX_Development_Session
          DidInfo_Programming_hash_Read
            DcmDspDidAccess
              DcmDspDidRead
          DidInfo_Integrity_validation_data_configuration_list_Read
            DcmDspDidAccess
              DcmDspDidRead
          DidInfo_VWLogicalBlockCounterOfProgrammingAttempts_Read
            DcmDspDidAccess
              DcmDspDidRead
          DidInfo_VWLogicalBlockLockValue_Read
            DcmDspDidAccess
              DcmDspDidRead
          DidInfo_BootloaderTPBlocksize_Read
            DcmDspDidAccess
              DcmDspDidRead
              DcmDspDidWrite:
                DcmDspDidWriteSessionRef = DcmDspSession/Programming
                DcmDspDidWriteSessionRef = DcmDspSession/Extended
                DcmDspDidWriteSessionRef = INX_End_Of_Line_Session
                DcmDspDidWriteSessionRef = INX_Development_Session
          DidInfo_ProgrammingPreconditions_Read
            DcmDspDidAccess
              DcmDspDidRead
          DidInfo_CddTouchCypressGen7_DisplayTouchConfiguration_Read
            DcmDspDidAccess
              DcmDspDidRead: DcmDspDidReadSessionRef=DcmDspSession/Default, DcmDspDidReadSessionRef=DcmDspSession/Programming, DcmDspDidReadSessionRef=DcmDspSession/Extended
              DcmDspDidWrite: DcmDspDidWriteSessionRef=DcmDspSession/Extended
          DidInfo_CddTouchCypressGen7_SlideTouchConfiguration_Read
            DcmDspDidAccess
              DcmDspDidRead: DcmDspDidReadSessionRef=DcmDspSession/Default, DcmDspDidReadSessionRef=DcmDspSession/Programming, DcmDspDidReadSessionRef=DcmDspSession/Extended
              DcmDspDidWrite: DcmDspDidWriteSessionRef=DcmDspSession/Extended
          DidInfo_CddNvmManager_NvmDisplayDimLutDay_Read
            DcmDspDidAccess
              DcmDspDidRead: DcmDspDidReadSessionRef=DcmDspSession/Default, DcmDspDidReadSessionRef=DcmDspSession/Programming, DcmDspDidReadSessionRef=DcmDspSession/Extended
              DcmDspDidWrite: DcmDspDidWriteSessionRef=DcmDspSession/Extended
          DidInfo_CddNvmManager_NvmSliderDimLut_Read
            DcmDspDidAccess
              DcmDspDidRead: DcmDspDidReadSessionRef=DcmDspSession/Default, DcmDspDidReadSessionRef=DcmDspSession/Programming, DcmDspDidReadSessionRef=DcmDspSession/Extended
              DcmDspDidWrite: DcmDspDidWriteSessionRef=DcmDspSession/Extended
          DidInfo_CddNvmManager_NvmDisplayDimLutNight_Read
            DcmDspDidAccess
              DcmDspDidRead: DcmDspDidReadSessionRef=DcmDspSession/Default, DcmDspDidReadSessionRef=DcmDspSession/Programming, DcmDspDidReadSessionRef=DcmDspSession/Extended
              DcmDspDidWrite: DcmDspDidWriteSessionRef=DcmDspSession/Extended
          DidInfo_SwcTestInterface_DeveloperMode_Read
            DcmDspDidAccess
              DcmDspDidRead
              DcmDspDidWrite:
                DcmDspDidWriteSessionRef = DcmDspSession/Programming
                DcmDspDidWriteSessionRef = DcmDspSession/Extended
                DcmDspDidWriteSessionRef = INX_End_Of_Line_Session
                DcmDspDidWriteSessionRef = INX_Development_Session
          DidInfo_Fingerprint_Read
            DcmDspDidAccess
              DcmDspDidRead: DcmDspDidReadSessionRef=DcmDspSession/Programming, DcmDspDidReadSecurityLevelRef=Level_17
              DcmDspDidWrite: DcmDspDidWriteSessionRef=DcmDspSession/Programming, DcmDspDidWriteSecurityLevelRef=Level_17
          DidInfo_FingerprintLogicalBlock_Read
            DcmDspDidAccess
              DcmDspDidRead
          DidInfo_VWFAZITIdentificationString_Read
            DcmDspDidAccess
              DcmDspDidRead
          DidInfo_ActiveDiagnosticSession_Read
            DcmDspDidAccess
              DcmDspDidRead
          DidInfo_VWSparePartNumber_Read
            DcmDspDidAccess
              DcmDspDidRead
          DidInfo_VWApplicationSoftwareVersionNumber_Read
            DcmDspDidAccess
              DcmDspDidRead
          DidInfo_ECUSerialNumber_Read
            DcmDspDidAccess
              DcmDspDidRead
          DidInfo_VWECUHardwareNumber_Read
            DcmDspDidAccess
              DcmDspDidRead
          DidInfo_VWSystemNameOrEngineType_Read
            DcmDspDidAccess
              DcmDspDidRead:
                DcmDspDidReadSessionRef = DcmDspSession/Default
                DcmDspDidReadSessionRef = DcmDspSession/Extended
                DcmDspDidReadSessionRef = INX_End_Of_Line_Session
                DcmDspDidReadSessionRef = INX_Development_Session
          DidInfo_ASAMODXFileIdentifier_Read
            DcmDspDidAccess
              DcmDspDidRead
          DidInfo_ASAMODXFileVersion_Read
            DcmDspDidAccess
              DcmDspDidRead
          DidInfo_VWECUHardwareVersionNumber_Read
            DcmDspDidAccess
              DcmDspDidRead
          DidInfo_VWLogicalBlockVersion_Read
            DcmDspDidAccess
              DcmDspDidRead
          DidInfo_TechnicalSpecificationsVersion_Read
            DcmDspDidAccess
              DcmDspDidRead:
                DcmDspDidReadSessionRef = DcmDspSession/Default
                DcmDspDidReadSessionRef = DcmDspSession/Extended
                DcmDspDidReadSessionRef = INX_End_Of_Line_Session
                DcmDspDidReadSessionRef = INX_Development_Session
          DidInfo_FDS_Project_Data_Read
            DcmDspDidAccess
              DcmDspDidRead
          DidInfo_ECUProgrammingInformation_Read
            DcmDspDidAccess
              DcmDspDidRead
          DidInfo_CddConnectionCheck_ConnectionCheck_Read
            DcmDspDidAccess
              DcmDspDidRead: DcmDspDidReadSessionRef=INX_End_Of_Line_Session, DcmDspDidReadSessionRef=INX_Development_Session, DcmDspDidReadSecurityLevelRef=Level_17
          DidInfo_CddNvMManager_DiagEepromWriteCounter_Read
            DcmDspDidAccess
              DcmDspDidRead: DcmDspDidReadSessionRef=INX_End_Of_Line_Session, DcmDspDidReadSessionRef=INX_Development_Session, DcmDspDidReadSecurityLevelRef=Level_17
              DcmDspDidWrite: DcmDspDidWriteSessionRef=INX_End_Of_Line_Session, DcmDspDidWriteSessionRef=INX_Development_Session, DcmDspDidWriteSecurityLevelRef=Level_17
          DidInfo_CddTouchCypressGen7_HardwareVersion_Read
            DcmDspDidAccess
              DcmDspDidRead: DcmDspDidReadSessionRef=INX_End_Of_Line_Session, DcmDspDidReadSessionRef=INX_Development_Session, DcmDspDidReadSecurityLevelRef=Level_17
          DidInfo_CddTouchCypressGen7_SoftwareVersion_Read
            DcmDspDidAccess
              DcmDspDidRead: DcmDspDidReadSessionRef=INX_End_Of_Line_Session, DcmDspDidReadSessionRef=INX_Development_Session, DcmDspDidReadSecurityLevelRef=Level_17
          DidInfo_CddTouchCypressGen7_ManufacturerData_Read
            DcmDspDidAccess
              DcmDspDidRead: DcmDspDidReadSessionRef=INX_End_Of_Line_Session, DcmDspDidReadSessionRef=INX_Development_Session, DcmDspDidReadSecurityLevelRef=Level_17
          DidInfo_CddBooster_BacklightDutyCycle_Read
            DcmDspDidAccess
              DcmDspDidRead: DcmDspDidReadSessionRef=INX_End_Of_Line_Session, DcmDspDidReadSessionRef=INX_Development_Session, DcmDspDidReadSecurityLevelRef=Level_17
          DidInfo_CddTemperatureMonitor_MaximumTemperature_Read
            DcmDspDidAccess
              DcmDspDidRead: DcmDspDidReadSessionRef=INX_End_Of_Line_Session, DcmDspDidReadSessionRef=INX_Development_Session, DcmDspDidReadSecurityLevelRef=Level_17
              DcmDspDidWrite: DcmDspDidWriteSessionRef=INX_End_Of_Line_Session, DcmDspDidWriteSessionRef=INX_Development_Session, DcmDspDidWriteSecurityLevelRef=Level_17
          DidInfo_CddTemperatureMonitor_MinimumTemperature_Read
            DcmDspDidAccess
              DcmDspDidRead: DcmDspDidReadSessionRef=INX_End_Of_Line_Session, DcmDspDidReadSessionRef=INX_Development_Session, DcmDspDidReadSecurityLevelRef=Level_17
              DcmDspDidWrite: DcmDspDidWriteSessionRef=INX_End_Of_Line_Session, DcmDspDidWriteSessionRef=INX_Development_Session, DcmDspDidWriteSecurityLevelRef=Level_17
          DidInfo_CddVoltageMonitor_MaxBatteryVoltage_Read
            DcmDspDidAccess
              DcmDspDidRead: DcmDspDidReadSessionRef=INX_End_Of_Line_Session, DcmDspDidReadSessionRef=INX_Development_Session, DcmDspDidReadSecurityLevelRef=Level_17
              DcmDspDidWrite: DcmDspDidWriteSessionRef=INX_End_Of_Line_Session, DcmDspDidWriteSessionRef=INX_Development_Session, DcmDspDidWriteSecurityLevelRef=Level_17
          DidInfo_CddVoltageMonitor_MinBatteryVoltage_Read
            DcmDspDidAccess
              DcmDspDidRead: DcmDspDidReadSessionRef=INX_End_Of_Line_Session, DcmDspDidReadSessionRef=INX_Development_Session
              DcmDspDidWrite: DcmDspDidWriteSessionRef=INX_End_Of_Line_Session, DcmDspDidWriteSessionRef=INX_Development_Session
          DidInfo_CddSliderBackLightTiSN1903001_BacklightDutyCycle_Read
            DcmDspDidAccess
              DcmDspDidRead:
                DcmDspDidReadSessionRef = DcmDspSession/Programming
                DcmDspDidReadSessionRef = DcmDspSession/Extended
                DcmDspDidReadSessionRef = INX_End_Of_Line_Session
                DcmDspDidReadSessionRef = INX_Development_Session
                DcmDspDidReadSecurityLevelRef = Level_17
          DidInfo_CddWakeupDetect_ResetCounters_Read
            DcmDspDidAccess
              DcmDspDidRead: DcmDspDidReadSessionRef=INX_End_Of_Line_Session, DcmDspDidReadSessionRef=INX_Development_Session, DcmDspDidReadSecurityLevelRef=Level_17
          DidInfo_CddCodeFlashAccess_ResetVector_Read
            DcmDspDidAccess
              DcmDspDidRead: DcmDspDidReadSessionRef=INX_End_Of_Line_Session, DcmDspDidReadSessionRef=INX_Development_Session
          DidInfo_SwcDimming_DisplayDimmingOutPreOffset_Read
            DcmDspDidAccess
              DcmDspDidRead:
                DcmDspDidReadSessionRef = DcmDspSession/Programming
                DcmDspDidReadSessionRef = DcmDspSession/Extended
                DcmDspDidReadSessionRef = INX_End_Of_Line_Session
                DcmDspDidReadSessionRef = INX_Development_Session
                DcmDspDidReadSecurityLevelRef = Level_17
          DidInfo_SwcDimming_DisplayDimmingOutPostOffset_Read
            DcmDspDidAccess
              DcmDspDidRead:
                DcmDspDidReadSessionRef = DcmDspSession/Programming
                DcmDspDidReadSessionRef = DcmDspSession/Extended
                DcmDspDidReadSessionRef = INX_End_Of_Line_Session
                DcmDspDidReadSessionRef = INX_Development_Session
                DcmDspDidReadSecurityLevelRef = Level_17
          DidInfo_SwcDimming_DisplayDimmingOutPwm_Read
            DcmDspDidAccess
              DcmDspDidRead:
                DcmDspDidReadSessionRef = DcmDspSession/Programming
                DcmDspDidReadSessionRef = DcmDspSession/Extended
                DcmDspDidReadSessionRef = INX_End_Of_Line_Session
                DcmDspDidReadSessionRef = INX_Development_Session
                DcmDspDidReadSecurityLevelRef = Level_17
          DidInfo_SwcDimming_SliderDimmingOutPwm_Read
            DcmDspDidAccess
              DcmDspDidRead:
                DcmDspDidReadSessionRef = DcmDspSession/Programming
                DcmDspDidReadSessionRef = DcmDspSession/Extended
                DcmDspDidReadSessionRef = INX_End_Of_Line_Session
                DcmDspDidReadSessionRef = INX_Development_Session
                DcmDspDidReadSecurityLevelRef = Level_17
          DidInfo_SwcSelfDiagnostics_EcuRuntime_Read
            DcmDspDidAccess
              DcmDspDidRead: DcmDspDidReadSessionRef=INX_End_Of_Line_Session, DcmDspDidReadSessionRef=INX_Development_Session, DcmDspDidReadSecurityLevelRef=Level_17
              DcmDspDidWrite: DcmDspDidWriteSessionRef=INX_End_Of_Line_Session, DcmDspDidWriteSessionRef=INX_Development_Session, DcmDspDidWriteSecurityLevelRef=Level_17
          DidInfo_SwcSelfDiagnostics_CpuLoad_Read
            DcmDspDidAccess
              DcmDspDidRead: DcmDspDidReadSessionRef=INX_End_Of_Line_Session, DcmDspDidReadSessionRef=INX_Development_Session, DcmDspDidReadSecurityLevelRef=Level_17
              DcmDspDidWrite: DcmDspDidWriteSessionRef=INX_End_Of_Line_Session, DcmDspDidWriteSessionRef=INX_Development_Session, DcmDspDidWriteSecurityLevelRef=Level_17
          DidInfo_SwcVerify_VerifyEnable_Read
            DcmDspDidAccess
              DcmDspDidRead: DcmDspDidReadSessionRef=INX_End_Of_Line_Session, DcmDspDidReadSessionRef=INX_Development_Session, DcmDspDidReadSecurityLevelRef=Level_17
              DcmDspDidWrite: DcmDspDidWriteSessionRef=INX_End_Of_Line_Session, DcmDspDidWriteSessionRef=INX_Development_Session, DcmDspDidWriteSecurityLevelRef=Level_17
          DidInfo_SwcComHandlerTx_PropEepromWriteCounter_Read
            DcmDspDidAccess
              DcmDspDidRead: DcmDspDidReadSessionRef=INX_End_Of_Line_Session, DcmDspDidReadSessionRef=INX_Development_Session, DcmDspDidReadSecurityLevelRef=Level_17
              DcmDspDidWrite: DcmDspDidWriteSessionRef=INX_End_Of_Line_Session, DcmDspDidWriteSessionRef=INX_Development_Session, DcmDspDidWriteSecurityLevelRef=Level_17
          DidInfo_SwcDisplayInfo_DisplayName_Read
            DcmDspDidAccess
              DcmDspDidRead: DcmDspDidReadSessionRef=INX_End_Of_Line_Session, DcmDspDidReadSessionRef=INX_Development_Session, DcmDspDidReadSecurityLevelRef=Level_17
          DidInfo_SwcDisplayInfo_DisplayVariant_Read
            DcmDspDidAccess
              DcmDspDidRead: DcmDspDidReadSessionRef=INX_End_Of_Line_Session, DcmDspDidReadSessionRef=INX_Development_Session, DcmDspDidReadSecurityLevelRef=Level_17
          DidInfo_SwcDisplayInfo_DisplayHardwareVersion_Read
            DcmDspDidAccess
              DcmDspDidRead: DcmDspDidReadSessionRef=INX_End_Of_Line_Session, DcmDspDidReadSessionRef=INX_Development_Session, DcmDspDidReadSecurityLevelRef=Level_17
          DidInfo_SwcDisplayInfo_ApplicationSoftwareVersion_Read
            DcmDspDidAccess
              DcmDspDidRead: DcmDspDidReadSessionRef=INX_End_Of_Line_Session, DcmDspDidReadSessionRef=INX_Development_Session, DcmDspDidReadSecurityLevelRef=Level_17
          DidInfo_SwcDisplayInfo_SvnUrl_Read
            DcmDspDidAccess
              DcmDspDidRead: DcmDspDidReadSessionRef=INX_End_Of_Line_Session, DcmDspDidReadSessionRef=INX_Development_Session, DcmDspDidReadSecurityLevelRef=Level_17
          DidInfo_SwcDisplayInfo_SvnRevision_Read
            DcmDspDidAccess
              DcmDspDidRead: DcmDspDidReadSessionRef=INX_End_Of_Line_Session, DcmDspDidReadSessionRef=INX_Development_Session, DcmDspDidReadSecurityLevelRef=Level_17
          DidInfo_SwcDisplayInfo_HardwareIdentification_Read
            DcmDspDidAccess
              DcmDspDidRead: DcmDspDidReadSessionRef=INX_End_Of_Line_Session, DcmDspDidReadSessionRef=INX_Development_Session, DcmDspDidReadSecurityLevelRef=Level_17
        79 x DcmDspRoutine:
          CheckMemory_Start: DcmDspRequestResultsRoutineSupported=false, DcmDspStopRoutineSupported=false, DcmDspRoutineIdentifier=514, DcmDspRoutineInfoRef=RoutineInfo_CheckMemory_Start
          CheckProgrammingPreconditions_Start: DcmDspRequestResultsRoutineSupported=false, DcmDspStopRoutineSupported=false, DcmDspRoutineIdentifier=515, DcmDspRoutineInfoRef=RoutineInfo_CheckProgrammingPreconditions_Start
          Verify_partial_software_checksum_Start: DcmDspRequestResultsRoutineSupported=false, DcmDspStopRoutineSupported=false, DcmDspRoutineIdentifier=1348, DcmDspRoutineInfoRef=RoutineInfo_Verify_partial_software_checksum_Start
          CddNvmManager_EepromDataRead_Start: DcmDspRequestResultsRoutineSupported=false, DcmDspStopRoutineSupported=false, DcmDspRoutineIdentifier=61448, DcmDspRoutineInfoRef=RoutineInfo_CddNvmManager_EepromDataRead_Start
          CddNvmManager_EepromDataWrite_Start: DcmDspRequestResultsRoutineSupported=false, DcmDspStopRoutineSupported=false, DcmDspRoutineIdentifier=61449, DcmDspRoutineInfoRef=RoutineInfo_CddNvmManager_EepromDataWrite_Start
          CddNvmManager_CopyNvData_Start: DcmDspRequestResultsRoutineSupported=false, DcmDspStopRoutineSupported=false, DcmDspRoutineIdentifier=61450, DcmDspRoutineInfoRef=RoutineInfo_CddNvmManager_CopyNvData_Start
          CddNvmManager_GetEepromBlockSizes_Start: DcmDspRequestResultsRoutineSupported=false, DcmDspStopRoutineSupported=false, DcmDspRoutineIdentifier=61451, DcmDspRoutineInfoRef=RoutineInfo_CddNvmManager_GetEepromBlockSizes_Start
          CddNvmManager_DataToUart_Start: DcmDspRequestResultsRoutineSupported=false, DcmDspStopRoutineSupported=false, DcmDspRoutineIdentifier=61452, DcmDspRoutineInfoRef=RoutineInfo_CddNvmManager_DataToUart_Start
          CddNvmManager_EepromStateSimulation_Start: DcmDspRequestResultsRoutineSupported=false, DcmDspStopRoutineSupported=true, DcmDspRoutineIdentifier=61453, DcmDspRoutineInfoRef=RoutineInfo_CddNvmManager_EepromStateSimulation_Start
          CddDeserializerTIDS90Ux948_Read_Start: DcmDspRequestResultsRoutineSupported=false, DcmDspStopRoutineSupported=false, DcmDspRoutineIdentifier=61456, DcmDspRoutineInfoRef=RoutineInfo_CddDeserializerTIDS90Ux948_Read_Start
          CddDeserializerTIDS90Ux948_Write_Start: DcmDspRequestResultsRoutineSupported=false, DcmDspStopRoutineSupported=false, DcmDspRoutineIdentifier=61457, DcmDspRoutineInfoRef=RoutineInfo_CddDeserializerTIDS90Ux948_Write_Start
          CddDeserializerTIDS90Ux948_LvdsLockSimulation_Start: DcmDspRequestResultsRoutineSupported=false, DcmDspStopRoutineSupported=true, DcmDspRoutineIdentifier=61458, DcmDspRoutineInfoRef=RoutineInfo_CddDeserializerTIDS90Ux948_LvdsLockSimulation_Start
          CddTouchCypressGen7_Read_Start: DcmDspRequestResultsRoutineSupported=false, DcmDspStopRoutineSupported=false, DcmDspRoutineIdentifier=61464, DcmDspRoutineInfoRef=RoutineInfo_CddTouchCypressGen7_Read_Start
          CddTouchCypressGen7_Write_Start: DcmDspRequestResultsRoutineSupported=false, DcmDspStopRoutineSupported=false, DcmDspRoutineIdentifier=61465, DcmDspRoutineInfoRef=RoutineInfo_CddTouchCypressGen7_Write_Start
          CddTouchCypressGen7_MtkMode_Start: DcmDspRequestResultsRoutineSupported=true, DcmDspStopRoutineSupported=true, DcmDspRoutineIdentifier=61466, DcmDspRoutineInfoRef=RoutineInfo_CddTouchCypressGen7_MtkMode_Start
          CddTouchCypressGen7_GetRamParameter_Start: DcmDspRequestResultsRoutineSupported=false, DcmDspStopRoutineSupported=false, DcmDspRoutineIdentifier=61468, DcmDspRoutineInfoRef=RoutineInfo_CddTouchCypressGen7_GetRamParameter_Start
          CddTouchCypressGen7_SetRamParameter_Start: DcmDspRequestResultsRoutineSupported=false, DcmDspStopRoutineSupported=false, DcmDspRoutineIdentifier=61469, DcmDspRoutineInfoRef=RoutineInfo_CddTouchCypressGen7_SetRamParameter_Start
          CddTouchCypressGen7_CalibrateTouchSensor_Start: DcmDspRequestResultsRoutineSupported=false, DcmDspStopRoutineSupported=false, DcmDspRoutineIdentifier=61470, DcmDspRoutineInfoRef=RoutineInfo_CddTouchCypressGen7_CalibrateTouchSensor_Start
          CddBoosterDriver_Read_Start: DcmDspRequestResultsRoutineSupported=false, DcmDspStopRoutineSupported=false, DcmDspRoutineIdentifier=61472, DcmDspRoutineInfoRef=RoutineInfo_CddBoosterDriver_Read_Start
          CddBoosterDriver_Write_Start: DcmDspRequestResultsRoutineSupported=false, DcmDspStopRoutineSupported=false, DcmDspRoutineIdentifier=61473, DcmDspRoutineInfoRef=RoutineInfo_CddBoosterDriver_Write_Start
          CddBoosterDriver_BacklightPercentageSimulation_Start: DcmDspRequestResultsRoutineSupported=false, DcmDspStopRoutineSupported=true, DcmDspRoutineIdentifier=61474, DcmDspRoutineInfoRef=RoutineInfo_CddBoosterDriver_BacklightPercentageSimulation_Start
          CddPanelHimaxHx8249B_Read_Start: DcmDspRequestResultsRoutineSupported=false, DcmDspStopRoutineSupported=false, DcmDspRoutineIdentifier=61480, DcmDspRoutineInfoRef=RoutineInfo_CddPanelHimaxHx8249B_Read_Start
          CddPanelHimaxHx8249B_Write_Start: DcmDspRequestResultsRoutineSupported=false, DcmDspStopRoutineSupported=false, DcmDspRoutineIdentifier=61481, DcmDspRoutineInfoRef=RoutineInfo_CddPanelHimaxHx8249B_Write_Start
          CddPanelHimaxHx8249B_GammaSimulation_Start: DcmDspRequestResultsRoutineSupported=false, DcmDspStopRoutineSupported=true, DcmDspRoutineIdentifier=61483, DcmDspRoutineInfoRef=RoutineInfo_CddPanelHimaxHx8249B_GammaSimulation_Start
          CddPanelHimaxHx8249B_VcomSimulation_Start: DcmDspRequestResultsRoutineSupported=false, DcmDspStopRoutineSupported=true, DcmDspRoutineIdentifier=61484, DcmDspRoutineInfoRef=RoutineInfo_CddPanelHimaxHx8249B_VcomSimulation_Start
          CddPanelHimaxHx8249B_GammaVoltageSetting_Start: DcmDspRequestResultsRoutineSupported=false, DcmDspStopRoutineSupported=true, DcmDspRoutineIdentifier=61486, DcmDspRoutineInfoRef=RoutineInfo_CddPanelHimaxHx8249B_GammaVoltageSetting_Start
          CddTemperatureMonitor_TemperatureControl_Start: DcmDspRequestResultsRoutineSupported=true, DcmDspStopRoutineSupported=true, DcmDspRoutineIdentifier=61488, DcmDspRoutineInfoRef=RoutineInfo_CddTemperatureMonitor_TemperatureControl_Start
          CddVoltageMonitor_VoltControl_Start: DcmDspRequestResultsRoutineSupported=true, DcmDspStopRoutineSupported=true, DcmDspRoutineIdentifier=61496, DcmDspRoutineInfoRef=RoutineInfo_CddVoltageMonitor_VoltControl_Start
          CddPerCtrl_GetAdcRawValues_Start: DcmDspRequestResultsRoutineSupported=false, DcmDspStopRoutineSupported=false, DcmDspRoutineIdentifier=61520, DcmDspRoutineInfoRef=RoutineInfo_CddPerCtrl_GetAdcRawValues_Start
          CddPerCtrl_DioControl_Start: DcmDspRequestResultsRoutineSupported=false, DcmDspStopRoutineSupported=true, DcmDspRoutineIdentifier=61521, DcmDspRoutineInfoRef=RoutineInfo_CddPerCtrl_DioControl_Start
          CddPerCtrl_TrgWdgReset_Start: DcmDspRequestResultsRoutineSupported=false, DcmDspStopRoutineSupported=false, DcmDspRoutineIdentifier=61522, DcmDspRoutineInfoRef=RoutineInfo_CddPerCtrl_TrgWdgReset_Start
          CddPerCtrl_SpiTransfer_Start: DcmDspRequestResultsRoutineSupported=false, DcmDspStopRoutineSupported=true, DcmDspRoutineIdentifier=61523, DcmDspRoutineInfoRef=RoutineInfo_CddPerCtrl_SpiTransfer_Start
          CddPerCtrl_ReadI2cDevice_Start: DcmDspRequestResultsRoutineSupported=false, DcmDspStopRoutineSupported=true, DcmDspRoutineIdentifier=61524, DcmDspRoutineInfoRef=RoutineInfo_CddPerCtrl_ReadI2cDevice_Start
          CddPerCtrl_WriteI2cDevice_Start: DcmDspRequestResultsRoutineSupported=false, DcmDspStopRoutineSupported=true, DcmDspRoutineIdentifier=61525, DcmDspRoutineInfoRef=RoutineInfo_CddPerCtrl_WriteI2cDevice_Start
          CddButton_ButtonStatusSimulation_Start: DcmDspRequestResultsRoutineSupported=false, DcmDspStopRoutineSupported=true, DcmDspRoutineIdentifier=61528, DcmDspRoutineInfoRef=RoutineInfo_CddButton_ButtonStatusSimulation_Start
          CddHeadUnitInterface_SimulateResetTrigger_Start: DcmDspRequestResultsRoutineSupported=false, DcmDspStopRoutineSupported=false, DcmDspRoutineIdentifier=61537, DcmDspRoutineInfoRef=RoutineInfo_CddHeadUnitInterface_SimulateResetTrigger_Start
          CddWatchdogInterface_WatchdogTriggering_Start: DcmDspRequestResultsRoutineSupported=false, DcmDspStopRoutineSupported=true, DcmDspRoutineIdentifier=61544, DcmDspRoutineInfoRef=RoutineInfo_CddWatchdogInterface_WatchdogTriggering_Start
          CddWatchdogInterface_SimulateWatchdogPeriod_Start: DcmDspRequestResultsRoutineSupported=false, DcmDspStopRoutineSupported=true, DcmDspRoutineIdentifier=61545, DcmDspRoutineInfoRef=RoutineInfo_CddWatchdogInterface_SimulateWatchdogPeriod_Start
          CddBist_BistMode_Start: DcmDspRequestResultsRoutineSupported=false, DcmDspStopRoutineSupported=true, DcmDspRoutineIdentifier=61560, DcmDspRoutineInfoRef=RoutineInfo_CddBist_BistMode_Start
          CddSliderBackLightTiSN1903001_Read_Start: DcmDspRequestResultsRoutineSupported=false, DcmDspStopRoutineSupported=false, DcmDspRoutineIdentifier=61568, DcmDspRoutineInfoRef=RoutineInfo_CddSliderBackLightTiSN1903001_Read_Start
          CddSliderBackLightTiSN1903001_Write_Start: DcmDspRequestResultsRoutineSupported=false, DcmDspStopRoutineSupported=false, DcmDspRoutineIdentifier=61569, DcmDspRoutineInfoRef=RoutineInfo_CddSliderBackLightTiSN1903001_Write_Start
          CddSliderBackLightTiSN1903001_BacklightPercentageSimulation_Start: DcmDspRequestResultsRoutineSupported=false, DcmDspStopRoutineSupported=true, DcmDspRoutineIdentifier=61570, DcmDspRoutineInfoRef=RoutineInfo_CddSliderBackLightTiSN1903001_BacklightPercentageSimulation_Start
          CddSliderBackLightTiSN1903001_BacklightLedCurrentSimulation_Start: DcmDspRequestResultsRoutineSupported=false, DcmDspStopRoutineSupported=true, DcmDspRoutineIdentifier=61571, DcmDspRoutineInfoRef=RoutineInfo_CddSliderBackLightTiSN1903001_BacklightLedCurrentSimulation_Start
          CddHWRNXPRT1171_RoutineRequest_Start: DcmDspRequestResultsRoutineSupported=false, DcmDspStopRoutineSupported=false, DcmDspRoutineIdentifier=61584, DcmDspRoutineInfoRef=RoutineInfo_CddHWRNXPRT1171_RoutineRequest_Start
          CddHWRNXPRT1171_ConfigPropRequest_Start: DcmDspRequestResultsRoutineSupported=false, DcmDspStopRoutineSupported=false, DcmDspRoutineIdentifier=61585, DcmDspRoutineInfoRef=RoutineInfo_CddHWRNXPRT1171_ConfigPropRequest_Start
          CddHWRNXPRT1171_SetSwUpdateReq_Start: DcmDspRequestResultsRoutineSupported=false, DcmDspStopRoutineSupported=true, DcmDspRoutineIdentifier=61586, DcmDspRoutineInfoRef=RoutineInfo_CddHWRNXPRT1171_SetSwUpdateReq_Start
          SwcDimming_SetDisplayPwmOutput_Start: DcmDspRequestResultsRoutineSupported=false, DcmDspStopRoutineSupported=true, DcmDspRoutineIdentifier=61712, DcmDspRoutineInfoRef=RoutineInfo_SwcDimming_SetDisplayPwmOutput_Start
          SwcDimming_SetSliderPwmOutput_Start: DcmDspRequestResultsRoutineSupported=false, DcmDspStopRoutineSupported=true, DcmDspRoutineIdentifier=61713, DcmDspRoutineInfoRef=RoutineInfo_SwcDimming_SetSliderPwmOutput_Start
          SwcDimming_SetDisplayLutDay_Start: DcmDspRequestResultsRoutineSupported=false, DcmDspStopRoutineSupported=false, DcmDspRoutineIdentifier=61714, DcmDspRoutineInfoRef=RoutineInfo_SwcDimming_SetDisplayLutDay_Start
          SwcDimming_SetDisplayLutNight_Start: DcmDspRequestResultsRoutineSupported=false, DcmDspStopRoutineSupported=false, DcmDspRoutineIdentifier=61715, DcmDspRoutineInfoRef=RoutineInfo_SwcDimming_SetDisplayLutNight_Start
          SwcDimming_SetSliderLut_Start: DcmDspRequestResultsRoutineSupported=false, DcmDspStopRoutineSupported=false, DcmDspRoutineIdentifier=61716, DcmDspRoutineInfoRef=RoutineInfo_SwcDimming_SetSliderLut_Start
          SwcDimming_SetDisplayPwmMin_Start: DcmDspRequestResultsRoutineSupported=false, DcmDspStopRoutineSupported=false, DcmDspRoutineIdentifier=61717, DcmDspRoutineInfoRef=RoutineInfo_SwcDimming_SetDisplayPwmMin_Start
          SwcDimming_SetSliderXsErrorDefault_Start: DcmDspRequestResultsRoutineSupported=false, DcmDspStopRoutineSupported=false, DcmDspRoutineIdentifier=61718, DcmDspRoutineInfoRef=RoutineInfo_SwcDimming_SetSliderXsErrorDefault_Start
          SwcDimming_SetSliderXtErrorDefault_Start: DcmDspRequestResultsRoutineSupported=false, DcmDspStopRoutineSupported=false, DcmDspRoutineIdentifier=61719, DcmDspRoutineInfoRef=RoutineInfo_SwcDimming_SetSliderXtErrorDefault_Start
          SwcDisplayControl_TestPattern_Start: DcmDspRequestResultsRoutineSupported=false, DcmDspStopRoutineSupported=true, DcmDspRoutineIdentifier=61720, DcmDspRoutineInfoRef=RoutineInfo_SwcDisplayControl_TestPattern_Start
          SwcError_GetErrorStatus_Start: DcmDspRequestResultsRoutineSupported=false, DcmDspStopRoutineSupported=false, DcmDspRoutineIdentifier=61728, DcmDspRoutineInfoRef=RoutineInfo_SwcError_GetErrorStatus_Start
          SwcError_ClearErrorTrace_Start: DcmDspRequestResultsRoutineSupported=false, DcmDspStopRoutineSupported=false, DcmDspRoutineIdentifier=61729, DcmDspRoutineInfoRef=RoutineInfo_SwcError_ClearErrorTrace_Start
          SwcError_ClearErrorCounters_Start: DcmDspRequestResultsRoutineSupported=false, DcmDspStopRoutineSupported=false, DcmDspRoutineIdentifier=61730, DcmDspRoutineInfoRef=RoutineInfo_SwcError_ClearErrorCounters_Start
          SwcError_UartSeverityLevelSimulation_Start: DcmDspRequestResultsRoutineSupported=false, DcmDspStopRoutineSupported=true, DcmDspRoutineIdentifier=61731, DcmDspRoutineInfoRef=RoutineInfo_SwcError_UartSeverityLevelSimulation_Start
          SwcError_ErrorCountSeverityLevelSimulation_Start: DcmDspRequestResultsRoutineSupported=false, DcmDspStopRoutineSupported=true, DcmDspRoutineIdentifier=61732, DcmDspRoutineInfoRef=RoutineInfo_SwcError_ErrorCountSeverityLevelSimulation_Start
          SwcError_TraceSeverityLevelSimulation_Start: DcmDspRequestResultsRoutineSupported=false, DcmDspStopRoutineSupported=true, DcmDspRoutineIdentifier=61733, DcmDspRoutineInfoRef=RoutineInfo_SwcError_TraceSeverityLevelSimulation_Start
          SwcError_GetErrorTrace_Start: DcmDspRequestResultsRoutineSupported=false, DcmDspStopRoutineSupported=false, DcmDspRoutineIdentifier=61734, DcmDspRoutineInfoRef=RoutineInfo_SwcError_GetErrorTrace_Start
          SwcError_GetErrorCounters_Start: DcmDspRequestResultsRoutineSupported=false, DcmDspStopRoutineSupported=false, DcmDspRoutineIdentifier=61735, DcmDspRoutineInfoRef=RoutineInfo_SwcError_GetErrorCounters_Start
          SwcDimming_SetDisplayErrorDefault_Start: DcmDspRequestResultsRoutineSupported=false, DcmDspStopRoutineSupported=false, DcmDspRoutineIdentifier=61744, DcmDspRoutineInfoRef=RoutineInfo_SwcDimming_SetDisplayErrorDefault_Start
          SwcDimming_SetDisplayOffsetMultiplier_Start: DcmDspRequestResultsRoutineSupported=false, DcmDspStopRoutineSupported=false, DcmDspRoutineIdentifier=61745, DcmDspRoutineInfoRef=RoutineInfo_SwcDimming_SetDisplayOffsetMultiplier_Start
          SwcDimming_SetTauDampUp_Start: DcmDspRequestResultsRoutineSupported=false, DcmDspStopRoutineSupported=false, DcmDspRoutineIdentifier=61746, DcmDspRoutineInfoRef=RoutineInfo_SwcDimming_SetTauDampUp_Start
          SwcDimming_SetTauDampDown_Start: DcmDspRequestResultsRoutineSupported=false, DcmDspStopRoutineSupported=false, DcmDspRoutineIdentifier=61747, DcmDspRoutineInfoRef=RoutineInfo_SwcDimming_SetTauDampDown_Start
          SwcDimming_SetTauDayToNight_Start: DcmDspRequestResultsRoutineSupported=false, DcmDspStopRoutineSupported=false, DcmDspRoutineIdentifier=61748, DcmDspRoutineInfoRef=RoutineInfo_SwcDimming_SetTauDayToNight_Start
          SwcDimming_SetTauNightToDay_Start: DcmDspRequestResultsRoutineSupported=false, DcmDspStopRoutineSupported=false, DcmDspRoutineIdentifier=61749, DcmDspRoutineInfoRef=RoutineInfo_SwcDimming_SetTauNightToDay_Start
          SwcDimming_SetDisplayDampingInterval_Start: DcmDspRequestResultsRoutineSupported=false, DcmDspStopRoutineSupported=false, DcmDspRoutineIdentifier=61750, DcmDspRoutineInfoRef=RoutineInfo_SwcDimming_SetDisplayDampingInterval_Start
          SwcSelfDiagnostics_AverageCpuLoad_Start: DcmDspRequestResultsRoutineSupported=true, DcmDspStopRoutineSupported=true, DcmDspRoutineIdentifier=61768, DcmDspRoutineInfoRef=RoutineInfo_SwcSelfDiagnostics_AverageCpuLoad_Start
          SwcSelfDiagnostics_StackUsage_Start: DcmDspRequestResultsRoutineSupported=false, DcmDspStopRoutineSupported=false, DcmDspRoutineIdentifier=61769, DcmDspRoutineInfoRef=RoutineInfo_SwcSelfDiagnostics_StackUsage_Start
          SwcVerify_ModuleVerifyDisable_Start: DcmDspRequestResultsRoutineSupported=false, DcmDspStopRoutineSupported=true, DcmDspRoutineIdentifier=61776, DcmDspRoutineInfoRef=RoutineInfo_SwcVerify_ModuleVerifyDisable_Start
          SwcVerify_VerifyRequest_Start: DcmDspRequestResultsRoutineSupported=true, DcmDspStopRoutineSupported=false, DcmDspRoutineIdentifier=61777, DcmDspRoutineInfoRef=RoutineInfo_SwcVerify_VerifyRequest_Start
          SwcVerify_RecoveryRequest_Start: DcmDspRequestResultsRoutineSupported=true, DcmDspStopRoutineSupported=false, DcmDspRoutineIdentifier=61778, DcmDspRoutineInfoRef=RoutineInfo_SwcVerify_RecoveryRequest_Start
          CddHWRNXPRT1171_SeverityLevelSimulation_Start: DcmDspRequestResultsRoutineSupported=false, DcmDspStopRoutineSupported=true, DcmDspRoutineIdentifier=61792, DcmDspRoutineInfoRef=RoutineInfo_CddHWRNXPRT1171_SeverityLevelSimulation_Start
          SwcDisplayInfo_ModuleVersionInfo_Start: DcmDspRequestResultsRoutineSupported=false, DcmDspStopRoutineSupported=false, DcmDspRoutineIdentifier=61824, DcmDspRoutineInfoRef=RoutineInfo_SwcDisplayInfo_ModuleVersionInfo_Start
          EraseMemory_Start: DcmDspRequestResultsRoutineSupported=false, DcmDspStopRoutineSupported=false, DcmDspRoutineIdentifier=65280, DcmDspRoutineInfoRef=RoutineInfo_EraseMemory_Start
          CheckProgrammingDependencies_Start: DcmDspRequestResultsRoutineSupported=false, DcmDspStopRoutineSupported=false, DcmDspRoutineIdentifier=65281, DcmDspRoutineInfoRef=RoutineInfo_CheckProgrammingDependencies_Start
        79 x DcmDspRoutineInfo:
          RoutineInfo_CheckMemory_Start
            DcmDspRoutineAuthorization: DcmDspRoutineSessionRef=DcmDspSession/Programming, DcmDspRoutineSecurityLevelRef=Level_17
            DcmDspStartRoutineIn
              In_CRC32 (DcmDspStartRoutineInSignal): DcmDspRoutineSignalLength=3104, DcmDspRoutineSignalType=UINT8, DcmDspRoutineSignalEndianness=opaque, DcmDspRoutineSignalPos=0
            DcmDspStartRoutineOut
              Out_RoutineResult (DcmDspStartRoutineOutSignal): DcmDspRoutineSignalLength=8, DcmDspRoutineSignalType=UINT8, DcmDspRoutineSignalPos=0
          RoutineInfo_CheckProgrammingPreconditions_Start
            DcmDspRoutineAuthorization:
              DcmDspRoutineSessionRef = DcmDspSession/Default
              DcmDspRoutineSessionRef = DcmDspSession/Extended
              DcmDspRoutineSessionRef = INX_End_Of_Line_Session
              DcmDspRoutineSessionRef = INX_Development_Session
            DcmDspStartRoutineOut
              Out_ProgrammingPreconditionsList (DcmDspStartRoutineOutSignal): DcmDspRoutineSignalLength=128, DcmDspRoutineSignalType=VARIABLE_LENGTH, DcmDspRoutineSignalEndianness=opaque, DcmDspRoutineSignalPos=0
          RoutineInfo_Verify_partial_software_checksum_Start
            DcmDspRoutineAuthorization
            DcmDspStartRoutineIn
              3 x DcmDspStartRoutineInSignal, all with DcmDspRoutineSignalEndianness=BIG_ENDIAN:
                In_ALFID: DcmDspRoutineSignalLength=16, DcmDspRoutineSignalType=UINT16, DcmDspRoutineSignalPos=0
                In_MemoryAddress: DcmDspRoutineSignalLength=16, DcmDspRoutineSignalType=UINT16, DcmDspRoutineSignalPos=16
                In_CRC32: DcmDspRoutineSignalLength=32, DcmDspRoutineSignalType=UINT32, DcmDspRoutineSignalPos=32
            DcmDspStartRoutineOut
              Out_RoutineResult (DcmDspStartRoutineOutSignal): DcmDspRoutineSignalLength=8, DcmDspRoutineSignalType=UINT8, DcmDspRoutineSignalPos=0
          RoutineInfo_CddNvmManager_EepromDataRead_Start
            DcmDspRoutineAuthorization: DcmDspRoutineSessionRef=INX_End_Of_Line_Session, DcmDspRoutineSessionRef=INX_Development_Session, DcmDspRoutineSecurityLevelRef=Level_17
            DcmDspStartRoutineIn
              3 x DcmDspStartRoutineInSignal, all with DcmDspRoutineSignalLength=16, DcmDspRoutineSignalType=UINT16, DcmDspRoutineSignalEndianness=BIG_ENDIAN:
                In_blockID: DcmDspRoutineSignalPos=0
                In_blockOffset: DcmDspRoutineSignalPos=16
                In_blockLength: DcmDspRoutineSignalPos=32
            DcmDspStartRoutineOut
              Out_pData (DcmDspStartRoutineOutSignal): DcmDspRoutineSignalLength=2048, DcmDspRoutineSignalType=VARIABLE_LENGTH, DcmDspRoutineSignalEndianness=opaque, DcmDspRoutineSignalPos=0
          RoutineInfo_CddNvmManager_EepromDataWrite_Start
            DcmDspRoutineAuthorization: DcmDspRoutineSessionRef=INX_End_Of_Line_Session, DcmDspRoutineSessionRef=INX_Development_Session, DcmDspRoutineSecurityLevelRef=Level_17
            DcmDspStartRoutineIn
              5 x DcmDspStartRoutineInSignal:
                In_blockID: DcmDspRoutineSignalLength=16, DcmDspRoutineSignalType=UINT16, DcmDspRoutineSignalEndianness=BIG_ENDIAN, DcmDspRoutineSignalPos=0
                In_blockOffset: DcmDspRoutineSignalLength=16, DcmDspRoutineSignalType=UINT16, DcmDspRoutineSignalEndianness=BIG_ENDIAN, DcmDspRoutineSignalPos=16
                In_blockLength: DcmDspRoutineSignalLength=16, DcmDspRoutineSignalType=UINT16, DcmDspRoutineSignalEndianness=BIG_ENDIAN, DcmDspRoutineSignalPos=32
                In_writeImmediately: DcmDspRoutineSignalLength=8, DcmDspRoutineSignalType=UINT8, DcmDspRoutineSignalPos=48
                In_data: DcmDspRoutineSignalLength=2048, DcmDspRoutineSignalType=VARIABLE_LENGTH, DcmDspRoutineSignalEndianness=opaque, DcmDspRoutineSignalPos=56
          RoutineInfo_CddNvmManager_CopyNvData_Start
            DcmDspRoutineAuthorization: DcmDspRoutineSessionRef=INX_End_Of_Line_Session, DcmDspRoutineSessionRef=INX_Development_Session, DcmDspRoutineSecurityLevelRef=Level_17
            DcmDspStartRoutineIn
              In_direction (DcmDspStartRoutineInSignal): DcmDspRoutineSignalLength=8, DcmDspRoutineSignalType=UINT8, DcmDspRoutineSignalPos=0
              In_blockId (DcmDspStartRoutineInSignal): DcmDspRoutineSignalLength=16, DcmDspRoutineSignalType=UINT16, DcmDspRoutineSignalEndianness=BIG_ENDIAN, DcmDspRoutineSignalPos=8
            DcmDspStartRoutineOut
              Out_pNrOfBlocks (DcmDspStartRoutineOutSignal): DcmDspRoutineSignalLength=16, DcmDspRoutineSignalType=UINT16, DcmDspRoutineSignalEndianness=BIG_ENDIAN, DcmDspRoutineSignalPos=0
              Out_pBlockIdList (DcmDspStartRoutineOutSignal): DcmDspRoutineSignalLength=4096, DcmDspRoutineSignalType=VARIABLE_LENGTH, DcmDspRoutineSignalEndianness=opaque, DcmDspRoutineSignalPos=16
          RoutineInfo_CddNvmManager_GetEepromBlockSizes_Start
            DcmDspRoutineAuthorization: DcmDspRoutineSessionRef=INX_End_Of_Line_Session, DcmDspRoutineSessionRef=INX_Development_Session, DcmDspRoutineSecurityLevelRef=Level_17
            DcmDspStartRoutineOut
              Out_pNrOfBlocks (DcmDspStartRoutineOutSignal): DcmDspRoutineSignalLength=16, DcmDspRoutineSignalType=UINT16, DcmDspRoutineSignalEndianness=BIG_ENDIAN, DcmDspRoutineSignalPos=0
              Out_pBlockInfoList (DcmDspStartRoutineOutSignal): DcmDspRoutineSignalLength=8192, DcmDspRoutineSignalType=VARIABLE_LENGTH, DcmDspRoutineSignalEndianness=opaque, DcmDspRoutineSignalPos=16
          RoutineInfo_CddNvmManager_DataToUart_Start
            DcmDspRoutineAuthorization: DcmDspRoutineSessionRef=INX_End_Of_Line_Session, DcmDspRoutineSessionRef=INX_Development_Session, DcmDspRoutineSecurityLevelRef=Level_17
            DcmDspStartRoutineIn
              In_source (DcmDspStartRoutineInSignal): DcmDspRoutineSignalLength=8, DcmDspRoutineSignalType=UINT8, DcmDspRoutineSignalPos=0
              In_blockId (DcmDspStartRoutineInSignal): DcmDspRoutineSignalLength=16, DcmDspRoutineSignalType=UINT16, DcmDspRoutineSignalEndianness=BIG_ENDIAN, DcmDspRoutineSignalPos=8
          RoutineInfo_CddNvmManager_EepromStateSimulation_Start
            DcmDspRoutineAuthorization: DcmDspRoutineSessionRef=INX_Development_Session, DcmDspRoutineSecurityLevelRef=Level_17
            DcmDspStartRoutineIn
              In_eepromState (DcmDspStartRoutineInSignal): DcmDspRoutineSignalLength=8, DcmDspRoutineSignalType=UINT8, DcmDspRoutineSignalPos=0
          RoutineInfo_CddDeserializerTIDS90Ux948_Read_Start
            DcmDspRoutineAuthorization: DcmDspRoutineSessionRef=INX_End_Of_Line_Session, DcmDspRoutineSessionRef=INX_Development_Session, DcmDspRoutineSecurityLevelRef=Level_17
            DcmDspStartRoutineIn
              In_address (DcmDspStartRoutineInSignal): DcmDspRoutineSignalLength=8, DcmDspRoutineSignalType=UINT8, DcmDspRoutineSignalPos=0
              In_dataLength (DcmDspStartRoutineInSignal): DcmDspRoutineSignalLength=8, DcmDspRoutineSignalType=UINT8, DcmDspRoutineSignalPos=8
            DcmDspStartRoutineOut
              Out_data (DcmDspStartRoutineOutSignal): DcmDspRoutineSignalLength=2040, DcmDspRoutineSignalType=VARIABLE_LENGTH, DcmDspRoutineSignalEndianness=opaque, DcmDspRoutineSignalPos=0
          RoutineInfo_CddDeserializerTIDS90Ux948_Write_Start
            DcmDspRoutineAuthorization: DcmDspRoutineSessionRef=INX_End_Of_Line_Session, DcmDspRoutineSessionRef=INX_Development_Session, DcmDspRoutineSecurityLevelRef=Level_17
            DcmDspStartRoutineIn
              3 x DcmDspStartRoutineInSignal:
                In_address: DcmDspRoutineSignalLength=8, DcmDspRoutineSignalType=UINT8, DcmDspRoutineSignalPos=0
                In_dataLength: DcmDspRoutineSignalLength=8, DcmDspRoutineSignalType=UINT8, DcmDspRoutineSignalPos=8
                In_data: DcmDspRoutineSignalLength=2040, DcmDspRoutineSignalType=VARIABLE_LENGTH, DcmDspRoutineSignalEndianness=opaque, DcmDspRoutineSignalPos=16
          RoutineInfo_CddDeserializerTIDS90Ux948_LvdsLockSimulation_Start
            DcmDspRoutineAuthorization: DcmDspRoutineSessionRef=INX_End_Of_Line_Session, DcmDspRoutineSessionRef=INX_Development_Session, DcmDspRoutineSecurityLevelRef=Level_17
            DcmDspStartRoutineIn
              In_lvdsLock (DcmDspStartRoutineInSignal): DcmDspRoutineSignalLength=8, DcmDspRoutineSignalType=UINT8, DcmDspRoutineSignalPos=0
          RoutineInfo_CddTouchCypressGen7_Read_Start
            DcmDspRoutineAuthorization: DcmDspRoutineSessionRef=INX_End_Of_Line_Session, DcmDspRoutineSessionRef=INX_Development_Session, DcmDspRoutineSecurityLevelRef=Level_17
            DcmDspStartRoutineIn
              In_address (DcmDspStartRoutineInSignal): DcmDspRoutineSignalLength=8, DcmDspRoutineSignalType=UINT8, DcmDspRoutineSignalPos=0
              In_length (DcmDspStartRoutineInSignal): DcmDspRoutineSignalLength=8, DcmDspRoutineSignalType=UINT8, DcmDspRoutineSignalPos=8
            DcmDspStartRoutineOut
              Out_pData (DcmDspStartRoutineOutSignal): DcmDspRoutineSignalLength=2040, DcmDspRoutineSignalType=VARIABLE_LENGTH, DcmDspRoutineSignalEndianness=opaque, DcmDspRoutineSignalPos=0
          RoutineInfo_CddTouchCypressGen7_Write_Start
            DcmDspRoutineAuthorization: DcmDspRoutineSessionRef=INX_End_Of_Line_Session, DcmDspRoutineSessionRef=INX_Development_Session, DcmDspRoutineSecurityLevelRef=Level_17
            DcmDspStartRoutineIn
              3 x DcmDspStartRoutineInSignal:
                In_address: DcmDspRoutineSignalLength=8, DcmDspRoutineSignalType=UINT8, DcmDspRoutineSignalPos=0
                In_length: DcmDspRoutineSignalLength=8, DcmDspRoutineSignalType=UINT8, DcmDspRoutineSignalPos=8
                In_pData: DcmDspRoutineSignalLength=2040, DcmDspRoutineSignalType=VARIABLE_LENGTH, DcmDspRoutineSignalEndianness=opaque, DcmDspRoutineSignalPos=16
          RoutineInfo_CddTouchCypressGen7_MtkMode_Start
            DcmDspRoutineAuthorization:
              DcmDspRoutineSessionRef = DcmDspSession/Programming
              DcmDspRoutineSessionRef = DcmDspSession/Extended
              DcmDspRoutineSessionRef = INX_End_Of_Line_Session
              DcmDspRoutineSessionRef = INX_Development_Session
              DcmDspRoutineSecurityLevelRef = Level_17
            DcmDspRoutineRequestResOut
              Out_pMtkModeState (DcmDspRoutineRequestResOutSignal): DcmDspRoutineSignalLength=8, DcmDspRoutineSignalType=UINT8, DcmDspRoutineSignalPos=0
          RoutineInfo_CddTouchCypressGen7_GetRamParameter_Start
            DcmDspRoutineAuthorization: DcmDspRoutineSessionRef=INX_End_Of_Line_Session, DcmDspRoutineSessionRef=INX_Development_Session, DcmDspRoutineSecurityLevelRef=Level_17
            DcmDspStartRoutineIn
              In_parameterId (DcmDspStartRoutineInSignal): DcmDspRoutineSignalLength=8, DcmDspRoutineSignalType=UINT8, DcmDspRoutineSignalPos=0
            DcmDspStartRoutineOut
              Out_pParameterLength (DcmDspStartRoutineOutSignal): DcmDspRoutineSignalLength=8, DcmDspRoutineSignalType=UINT8, DcmDspRoutineSignalPos=0
              Out_pParameterData (DcmDspStartRoutineOutSignal): DcmDspRoutineSignalLength=32, DcmDspRoutineSignalType=VARIABLE_LENGTH, DcmDspRoutineSignalEndianness=opaque, DcmDspRoutineSignalPos=8
          RoutineInfo_CddTouchCypressGen7_SetRamParameter_Start
            DcmDspRoutineAuthorization: DcmDspRoutineSessionRef=INX_End_Of_Line_Session, DcmDspRoutineSessionRef=INX_Development_Session, DcmDspRoutineSecurityLevelRef=Level_17
            DcmDspStartRoutineIn
              3 x DcmDspStartRoutineInSignal:
                In_parameterId: DcmDspRoutineSignalLength=8, DcmDspRoutineSignalType=UINT8, DcmDspRoutineSignalPos=0
                In_parameterLength: DcmDspRoutineSignalLength=8, DcmDspRoutineSignalType=UINT8, DcmDspRoutineSignalPos=8
                In_pParameterData: DcmDspRoutineSignalLength=32, DcmDspRoutineSignalType=VARIABLE_LENGTH, DcmDspRoutineSignalEndianness=opaque, DcmDspRoutineSignalPos=16
          RoutineInfo_CddTouchCypressGen7_CalibrateTouchSensor_Start
            DcmDspRoutineAuthorization: DcmDspRoutineSessionRef=INX_End_Of_Line_Session, DcmDspRoutineSessionRef=INX_Development_Session, DcmDspRoutineSecurityLevelRef=Level_17
            DcmDspStartRoutineIn
              In_sensorId (DcmDspStartRoutineInSignal): DcmDspRoutineSignalLength=8, DcmDspRoutineSignalType=UINT8, DcmDspRoutineSignalPos=0
            DcmDspStartRoutineOut
              Out_pCalibResult (DcmDspStartRoutineOutSignal): DcmDspRoutineSignalLength=8, DcmDspRoutineSignalType=UINT8, DcmDspRoutineSignalPos=0
          RoutineInfo_CddBoosterDriver_Read_Start
            DcmDspRoutineAuthorization: DcmDspRoutineSessionRef=INX_End_Of_Line_Session, DcmDspRoutineSessionRef=INX_Development_Session, DcmDspRoutineSecurityLevelRef=Level_17
            DcmDspStartRoutineIn
              In_address (DcmDspStartRoutineInSignal): DcmDspRoutineSignalLength=8, DcmDspRoutineSignalType=UINT8, DcmDspRoutineSignalPos=0
              In_data_length (DcmDspStartRoutineInSignal): DcmDspRoutineSignalLength=8, DcmDspRoutineSignalType=UINT8, DcmDspRoutineSignalPos=8
            DcmDspStartRoutineOut
              Out_data (DcmDspStartRoutineOutSignal): DcmDspRoutineSignalLength=2040, DcmDspRoutineSignalType=VARIABLE_LENGTH, DcmDspRoutineSignalEndianness=opaque, DcmDspRoutineSignalPos=0
          RoutineInfo_CddBoosterDriver_Write_Start
            DcmDspRoutineAuthorization: DcmDspRoutineSessionRef=INX_End_Of_Line_Session, DcmDspRoutineSessionRef=INX_Development_Session, DcmDspRoutineSecurityLevelRef=Level_17
            DcmDspStartRoutineIn
              3 x DcmDspStartRoutineInSignal:
                In_address: DcmDspRoutineSignalLength=8, DcmDspRoutineSignalType=UINT8, DcmDspRoutineSignalPos=0
                In_data_length: DcmDspRoutineSignalLength=8, DcmDspRoutineSignalType=UINT8, DcmDspRoutineSignalPos=8
                In_data: DcmDspRoutineSignalLength=2040, DcmDspRoutineSignalType=VARIABLE_LENGTH, DcmDspRoutineSignalEndianness=opaque, DcmDspRoutineSignalPos=16
          RoutineInfo_CddBoosterDriver_BacklightPercentageSimulation_Start
            DcmDspRoutineAuthorization: DcmDspRoutineSessionRef=INX_End_Of_Line_Session, DcmDspRoutineSessionRef=INX_Development_Session, DcmDspRoutineSecurityLevelRef=Level_17
            DcmDspStartRoutineIn
              In_percentage (DcmDspStartRoutineInSignal): DcmDspRoutineSignalLength=16, DcmDspRoutineSignalType=UINT16, DcmDspRoutineSignalEndianness=BIG_ENDIAN, DcmDspRoutineSignalPos=0
          RoutineInfo_CddPanelHimaxHx8249B_Read_Start
            DcmDspRoutineAuthorization: DcmDspRoutineSessionRef=INX_End_Of_Line_Session, DcmDspRoutineSessionRef=INX_Development_Session, DcmDspRoutineSecurityLevelRef=Level_17
            DcmDspStartRoutineIn
              3 x DcmDspStartRoutineInSignal, all with DcmDspRoutineSignalLength=8, DcmDspRoutineSignalType=UINT8:
                In_panelPage: DcmDspRoutineSignalPos=0
                In_address: DcmDspRoutineSignalPos=8
                In_dataLength: DcmDspRoutineSignalPos=16
            DcmDspStartRoutineOut
              Out_data (DcmDspStartRoutineOutSignal): DcmDspRoutineSignalLength=2040, DcmDspRoutineSignalType=VARIABLE_LENGTH, DcmDspRoutineSignalEndianness=opaque, DcmDspRoutineSignalPos=0
          RoutineInfo_CddPanelHimaxHx8249B_Write_Start
            DcmDspRoutineAuthorization: DcmDspRoutineSessionRef=INX_End_Of_Line_Session, DcmDspRoutineSessionRef=INX_Development_Session, DcmDspRoutineSecurityLevelRef=Level_17
            DcmDspStartRoutineIn
              4 x DcmDspStartRoutineInSignal:
                In_panelPage: DcmDspRoutineSignalLength=8, DcmDspRoutineSignalType=UINT8, DcmDspRoutineSignalPos=0
                In_address: DcmDspRoutineSignalLength=8, DcmDspRoutineSignalType=UINT8, DcmDspRoutineSignalPos=8
                In_dataLength: DcmDspRoutineSignalLength=8, DcmDspRoutineSignalType=UINT8, DcmDspRoutineSignalPos=16
                In_data: DcmDspRoutineSignalLength=2040, DcmDspRoutineSignalType=VARIABLE_LENGTH, DcmDspRoutineSignalEndianness=opaque, DcmDspRoutineSignalPos=24
          RoutineInfo_CddPanelHimaxHx8249B_GammaSimulation_Start
            DcmDspRoutineAuthorization: DcmDspRoutineSessionRef=INX_End_Of_Line_Session, DcmDspRoutineSessionRef=INX_Development_Session, DcmDspRoutineSecurityLevelRef=Level_17
            DcmDspStartRoutineIn
              In_color (DcmDspStartRoutineInSignal): DcmDspRoutineSignalLength=8, DcmDspRoutineSignalType=UINT8, DcmDspRoutineSignalPos=0
              In_gammaLut (DcmDspStartRoutineInSignal): DcmDspRoutineSignalLength=720, DcmDspRoutineSignalType=VARIABLE_LENGTH, DcmDspRoutineSignalEndianness=opaque, DcmDspRoutineSignalPos=8
          RoutineInfo_CddPanelHimaxHx8249B_VcomSimulation_Start
            DcmDspRoutineAuthorization: DcmDspRoutineSessionRef=INX_End_Of_Line_Session, DcmDspRoutineSessionRef=INX_Development_Session, DcmDspRoutineSecurityLevelRef=Level_17
            DcmDspStartRoutineIn
              4 x DcmDspStartRoutineInSignal, all with DcmDspRoutineSignalLength=8, DcmDspRoutineSignalType=UINT8:
                In_vcoms: DcmDspRoutineSignalPos=0
                In_vcomsHt: DcmDspRoutineSignalPos=8
                In_vcomsLt: DcmDspRoutineSignalPos=16
                In_tsVcomEn: DcmDspRoutineSignalPos=24
          RoutineInfo_CddPanelHimaxHx8249B_GammaVoltageSetting_Start
            DcmDspRoutineAuthorization:
              DcmDspRoutineSessionRef = DcmDspSession/Extended
              DcmDspRoutineSessionRef = INX_End_Of_Line_Session
              DcmDspRoutineSessionRef = INX_Development_Session
              DcmDspRoutineSecurityLevelRef = Level_17
            DcmDspStartRoutineIn
              3 x DcmDspStartRoutineInSignal, all with DcmDspRoutineSignalLength=8, DcmDspRoutineSignalType=UINT8:
                In_vgmphs: DcmDspRoutineSignalPos=0
                In_vgmnhs: DcmDspRoutineSignalPos=8
                In_vgmplsVgmnls: DcmDspRoutineSignalPos=16
          RoutineInfo_CddTemperatureMonitor_TemperatureControl_Start
            DcmDspRoutineAuthorization: DcmDspRoutineSessionRef=INX_End_Of_Line_Session, DcmDspRoutineSessionRef=INX_Development_Session, DcmDspRoutineSecurityLevelRef=Level_17
            DcmDspStartRoutineIn
              In_temperatureChannel (DcmDspStartRoutineInSignal): DcmDspRoutineSignalLength=8, DcmDspRoutineSignalType=UINT8, DcmDspRoutineSignalPos=0
              In_temperature (DcmDspStartRoutineInSignal): DcmDspRoutineSignalLength=16, DcmDspRoutineSignalType=UINT16, DcmDspRoutineSignalEndianness=BIG_ENDIAN, DcmDspRoutineSignalPos=8
            DcmDspRoutineStopIn
              In_temperatureChannel (DcmDspRoutineStopInSignal): DcmDspRoutineSignalLength=8, DcmDspRoutineSignalType=UINT8, DcmDspRoutineSignalPos=0
            DcmDspRoutineRequestResIn
              In_temperatureChannel (DcmDspRoutineRequestResInSignal): DcmDspRoutineSignalLength=8, DcmDspRoutineSignalType=UINT8, DcmDspRoutineSignalPos=0
            DcmDspRoutineRequestResOut
              Out_temperature (DcmDspRoutineRequestResOutSignal): DcmDspRoutineSignalLength=16, DcmDspRoutineSignalType=SINT16, DcmDspRoutineSignalEndianness=BIG_ENDIAN, DcmDspRoutineSignalPos=0
          RoutineInfo_CddVoltageMonitor_VoltControl_Start
            DcmDspRoutineAuthorization: DcmDspRoutineSessionRef=INX_End_Of_Line_Session, DcmDspRoutineSessionRef=INX_Development_Session, DcmDspRoutineSecurityLevelRef=Level_17
            DcmDspStartRoutineIn
              In_voltChannel (DcmDspStartRoutineInSignal): DcmDspRoutineSignalLength=8, DcmDspRoutineSignalType=UINT8, DcmDspRoutineSignalPos=0
              In_voltage (DcmDspStartRoutineInSignal): DcmDspRoutineSignalLength=8, DcmDspRoutineSignalType=UINT8, DcmDspRoutineSignalPos=8
            DcmDspRoutineStopIn
              In_voltChannel (DcmDspRoutineStopInSignal): DcmDspRoutineSignalLength=8, DcmDspRoutineSignalType=UINT8, DcmDspRoutineSignalPos=0
            DcmDspRoutineRequestResIn
              In_voltChannel (DcmDspRoutineRequestResInSignal): DcmDspRoutineSignalLength=8, DcmDspRoutineSignalType=UINT8, DcmDspRoutineSignalPos=0
            DcmDspRoutineRequestResOut
              Out_pVoltage (DcmDspRoutineRequestResOutSignal): DcmDspRoutineSignalLength=8, DcmDspRoutineSignalType=UINT8, DcmDspRoutineSignalPos=0
          RoutineInfo_CddPerCtrl_GetAdcRawValues_Start
            DcmDspRoutineAuthorization: DcmDspRoutineSessionRef=INX_Development_Session, DcmDspRoutineSecurityLevelRef=Level_17
            DcmDspStartRoutineOut
              Out_nrOfChannels (DcmDspStartRoutineOutSignal): DcmDspRoutineSignalLength=16, DcmDspRoutineSignalType=UINT16, DcmDspRoutineSignalEndianness=BIG_ENDIAN, DcmDspRoutineSignalPos=0
              Out_adcRawValue (DcmDspStartRoutineOutSignal): DcmDspRoutineSignalLength=2040, DcmDspRoutineSignalType=VARIABLE_LENGTH, DcmDspRoutineSignalEndianness=opaque, DcmDspRoutineSignalPos=16
          RoutineInfo_CddPerCtrl_DioControl_Start
            DcmDspRoutineAuthorization: DcmDspRoutineSessionRef=INX_End_Of_Line_Session, DcmDspRoutineSessionRef=INX_Development_Session, DcmDspRoutineSecurityLevelRef=Level_17
            DcmDspStartRoutineIn
              3 x DcmDspStartRoutineInSignal, all with DcmDspRoutineSignalLength=8, DcmDspRoutineSignalType=UINT8:
                In_actionId: DcmDspRoutineSignalPos=0
                In_channelId: DcmDspRoutineSignalPos=8
                In_value: DcmDspRoutineSignalPos=16
            DcmDspStartRoutineOut
              Out_value (DcmDspStartRoutineOutSignal): DcmDspRoutineSignalLength=8, DcmDspRoutineSignalType=UINT8, DcmDspRoutineSignalPos=0
            DcmDspRoutineStopIn
              In_channelId (DcmDspRoutineStopInSignal): DcmDspRoutineSignalLength=8, DcmDspRoutineSignalType=UINT8, DcmDspRoutineSignalPos=0
          RoutineInfo_CddPerCtrl_TrgWdgReset_Start
            DcmDspRoutineAuthorization: DcmDspRoutineSessionRef=INX_End_Of_Line_Session, DcmDspRoutineSessionRef=INX_Development_Session, DcmDspRoutineSecurityLevelRef=Level_17
          RoutineInfo_CddPerCtrl_SpiTransfer_Start
            DcmDspRoutineAuthorization:
              DcmDspRoutineSessionRef = DcmDspSession/Programming
              DcmDspRoutineSessionRef = DcmDspSession/Extended
              DcmDspRoutineSessionRef = INX_End_Of_Line_Session
              DcmDspRoutineSessionRef = INX_Development_Session
              DcmDspRoutineSecurityLevelRef = Level_17
            DcmDspStartRoutineIn
              3 x DcmDspStartRoutineInSignal:
                In_deviceId: DcmDspRoutineSignalLength=8, DcmDspRoutineSignalType=UINT8, DcmDspRoutineSignalPos=0
                In_nrOfBytes: DcmDspRoutineSignalLength=8, DcmDspRoutineSignalType=UINT8, DcmDspRoutineSignalPos=8
                In_data: DcmDspRoutineSignalLength=2040, DcmDspRoutineSignalType=VARIABLE_LENGTH, DcmDspRoutineSignalEndianness=opaque, DcmDspRoutineSignalPos=16
            DcmDspStartRoutineOut
              Out_nrOfBytes (DcmDspStartRoutineOutSignal): DcmDspRoutineSignalLength=8, DcmDspRoutineSignalType=UINT8, DcmDspRoutineSignalPos=0
              Out_data (DcmDspStartRoutineOutSignal): DcmDspRoutineSignalLength=2040, DcmDspRoutineSignalType=VARIABLE_LENGTH, DcmDspRoutineSignalEndianness=opaque, DcmDspRoutineSignalPos=8
            DcmDspRoutineStopIn
              In_deviceId (DcmDspRoutineStopInSignal): DcmDspRoutineSignalLength=8, DcmDspRoutineSignalType=UINT8, DcmDspRoutineSignalPos=0
          RoutineInfo_CddPerCtrl_ReadI2cDevice_Start
            DcmDspRoutineAuthorization:
              DcmDspRoutineSessionRef = DcmDspSession/Programming
              DcmDspRoutineSessionRef = DcmDspSession/Extended
              DcmDspRoutineSessionRef = INX_End_Of_Line_Session
              DcmDspRoutineSessionRef = INX_Development_Session
              DcmDspRoutineSecurityLevelRef = Level_17
            DcmDspStartRoutineIn
              3 x DcmDspStartRoutineInSignal:
                In_deviceId: DcmDspRoutineSignalLength=8, DcmDspRoutineSignalType=UINT8, DcmDspRoutineSignalPos=0
                In_startAddress: DcmDspRoutineSignalLength=16, DcmDspRoutineSignalType=UINT16, DcmDspRoutineSignalEndianness=BIG_ENDIAN, DcmDspRoutineSignalPos=8
                In_nrOfBytes: DcmDspRoutineSignalLength=8, DcmDspRoutineSignalType=UINT8, DcmDspRoutineSignalPos=24
            DcmDspStartRoutineOut
              Out_nrOfBytes (DcmDspStartRoutineOutSignal): DcmDspRoutineSignalLength=8, DcmDspRoutineSignalType=UINT8, DcmDspRoutineSignalPos=0
              Out_data (DcmDspStartRoutineOutSignal): DcmDspRoutineSignalLength=2040, DcmDspRoutineSignalType=VARIABLE_LENGTH, DcmDspRoutineSignalEndianness=opaque, DcmDspRoutineSignalPos=8
            DcmDspRoutineStopIn
              In_deviceId (DcmDspRoutineStopInSignal): DcmDspRoutineSignalLength=8, DcmDspRoutineSignalType=UINT8, DcmDspRoutineSignalPos=0
          RoutineInfo_CddPerCtrl_WriteI2cDevice_Start
            DcmDspRoutineAuthorization:
              DcmDspRoutineSessionRef = DcmDspSession/Programming
              DcmDspRoutineSessionRef = DcmDspSession/Extended
              DcmDspRoutineSessionRef = INX_End_Of_Line_Session
              DcmDspRoutineSessionRef = INX_Development_Session
              DcmDspRoutineSecurityLevelRef = Level_17
            DcmDspStartRoutineIn
              4 x DcmDspStartRoutineInSignal:
                In_deviceId: DcmDspRoutineSignalLength=8, DcmDspRoutineSignalType=UINT8, DcmDspRoutineSignalPos=0
                In_startAddress: DcmDspRoutineSignalLength=16, DcmDspRoutineSignalType=UINT16, DcmDspRoutineSignalEndianness=BIG_ENDIAN, DcmDspRoutineSignalPos=8
                In_nrOfBytes: DcmDspRoutineSignalLength=8, DcmDspRoutineSignalType=UINT8, DcmDspRoutineSignalPos=24
                In_data: DcmDspRoutineSignalLength=2040, DcmDspRoutineSignalType=VARIABLE_LENGTH, DcmDspRoutineSignalEndianness=opaque, DcmDspRoutineSignalPos=32
            DcmDspRoutineStopIn
              In_deviceId (DcmDspRoutineStopInSignal): DcmDspRoutineSignalLength=8, DcmDspRoutineSignalType=UINT8, DcmDspRoutineSignalPos=0
          RoutineInfo_CddButton_ButtonStatusSimulation_Start
            DcmDspRoutineAuthorization:
              DcmDspRoutineSessionRef = DcmDspSession/Programming
              DcmDspRoutineSessionRef = DcmDspSession/Extended
              DcmDspRoutineSessionRef = INX_End_Of_Line_Session
              DcmDspRoutineSessionRef = INX_Development_Session
              DcmDspRoutineSecurityLevelRef = Level_17
            DcmDspStartRoutineIn
              In_buttonStatus (DcmDspStartRoutineInSignal): DcmDspRoutineSignalLength=8, DcmDspRoutineSignalType=UINT8, DcmDspRoutineSignalPos=0
          RoutineInfo_CddHeadUnitInterface_SimulateResetTrigger_Start
            DcmDspRoutineAuthorization: DcmDspRoutineSessionRef=INX_End_Of_Line_Session, DcmDspRoutineSessionRef=INX_Development_Session, DcmDspRoutineSecurityLevelRef=Level_17
          RoutineInfo_CddWatchdogInterface_WatchdogTriggering_Start
            DcmDspRoutineAuthorization: DcmDspRoutineSessionRef=INX_End_Of_Line_Session, DcmDspRoutineSessionRef=INX_Development_Session, DcmDspRoutineSecurityLevelRef=Level_17
            DcmDspStartRoutineIn
              In_watchdog (DcmDspStartRoutineInSignal): DcmDspRoutineSignalLength=8, DcmDspRoutineSignalType=UINT8, DcmDspRoutineSignalPos=0
            DcmDspRoutineStopIn
              In_watchdog (DcmDspRoutineStopInSignal): DcmDspRoutineSignalLength=8, DcmDspRoutineSignalType=UINT8, DcmDspRoutineSignalPos=0
          RoutineInfo_CddWatchdogInterface_SimulateWatchdogPeriod_Start
            DcmDspRoutineAuthorization: DcmDspRoutineSessionRef=INX_End_Of_Line_Session, DcmDspRoutineSessionRef=INX_Development_Session, DcmDspRoutineSecurityLevelRef=Level_17
            DcmDspStartRoutineIn
              In_watchdog (DcmDspStartRoutineInSignal): DcmDspRoutineSignalLength=8, DcmDspRoutineSignalType=UINT8, DcmDspRoutineSignalPos=0
              In_timeoutPeriod (DcmDspStartRoutineInSignal): DcmDspRoutineSignalLength=16, DcmDspRoutineSignalType=UINT16, DcmDspRoutineSignalEndianness=BIG_ENDIAN, DcmDspRoutineSignalPos=8
            DcmDspRoutineStopIn
              In_watchdog (DcmDspRoutineStopInSignal): DcmDspRoutineSignalLength=8, DcmDspRoutineSignalType=UINT8, DcmDspRoutineSignalPos=0
          RoutineInfo_CddBist_BistMode_Start
            DcmDspRoutineAuthorization: DcmDspRoutineSessionRef=INX_End_Of_Line_Session, DcmDspRoutineSessionRef=INX_Development_Session, DcmDspRoutineSecurityLevelRef=Level_17
            DcmDspStartRoutineIn
              In_bistMode (DcmDspStartRoutineInSignal): DcmDspRoutineSignalLength=8, DcmDspRoutineSignalType=UINT8, DcmDspRoutineSignalPos=0
          RoutineInfo_CddSliderBackLightTiSN1903001_Read_Start
            DcmDspRoutineAuthorization:
              DcmDspRoutineSessionRef = DcmDspSession/Programming
              DcmDspRoutineSessionRef = DcmDspSession/Extended
              DcmDspRoutineSessionRef = INX_End_Of_Line_Session
              DcmDspRoutineSessionRef = INX_Development_Session
              DcmDspRoutineSecurityLevelRef = Level_17
            DcmDspStartRoutineIn
              In_address (DcmDspStartRoutineInSignal): DcmDspRoutineSignalLength=16, DcmDspRoutineSignalType=UINT16, DcmDspRoutineSignalEndianness=BIG_ENDIAN, DcmDspRoutineSignalPos=0
            DcmDspStartRoutineOut
              Out_data (DcmDspStartRoutineOutSignal): DcmDspRoutineSignalLength=2040, DcmDspRoutineSignalType=VARIABLE_LENGTH, DcmDspRoutineSignalEndianness=opaque, DcmDspRoutineSignalPos=0
          RoutineInfo_CddSliderBackLightTiSN1903001_Write_Start
            DcmDspRoutineAuthorization:
              DcmDspRoutineSessionRef = DcmDspSession/Programming
              DcmDspRoutineSessionRef = DcmDspSession/Extended
              DcmDspRoutineSessionRef = INX_End_Of_Line_Session
              DcmDspRoutineSessionRef = INX_Development_Session
              DcmDspRoutineSecurityLevelRef = Level_17
            DcmDspStartRoutineIn
              In_address (DcmDspStartRoutineInSignal): DcmDspRoutineSignalLength=16, DcmDspRoutineSignalType=UINT16, DcmDspRoutineSignalEndianness=BIG_ENDIAN, DcmDspRoutineSignalPos=0
              In_data (DcmDspStartRoutineInSignal): DcmDspRoutineSignalLength=16, DcmDspRoutineSignalType=UINT16, DcmDspRoutineSignalEndianness=BIG_ENDIAN, DcmDspRoutineSignalPos=16
          RoutineInfo_CddSliderBackLightTiSN1903001_BacklightPercentageSimulation_Start
            DcmDspRoutineAuthorization:
              DcmDspRoutineSessionRef = DcmDspSession/Programming
              DcmDspRoutineSessionRef = DcmDspSession/Extended
              DcmDspRoutineSessionRef = INX_End_Of_Line_Session
              DcmDspRoutineSessionRef = INX_Development_Session
              DcmDspRoutineSecurityLevelRef = Level_17
            DcmDspStartRoutineIn
              In_percentage (DcmDspStartRoutineInSignal): DcmDspRoutineSignalLength=16, DcmDspRoutineSignalType=UINT16, DcmDspRoutineSignalEndianness=BIG_ENDIAN, DcmDspRoutineSignalPos=0
          RoutineInfo_CddSliderBackLightTiSN1903001_BacklightLedCurrentSimulation_Start
            DcmDspRoutineAuthorization: DcmDspRoutineSessionRef=INX_End_Of_Line_Session, DcmDspRoutineSessionRef=INX_Development_Session, DcmDspRoutineSecurityLevelRef=Level_17
            DcmDspStartRoutineIn
              In_ledStringMask (DcmDspStartRoutineInSignal): DcmDspRoutineSignalLength=8, DcmDspRoutineSignalType=UINT8, DcmDspRoutineSignalPos=0
              In_ledCurrents (DcmDspStartRoutineInSignal): DcmDspRoutineSignalLength=64, DcmDspRoutineSignalType=VARIABLE_LENGTH, DcmDspRoutineSignalEndianness=opaque, DcmDspRoutineSignalPos=8
          RoutineInfo_CddHWRNXPRT1171_RoutineRequest_Start
            DcmDspRoutineAuthorization: DcmDspRoutineSessionRef=INX_End_Of_Line_Session, DcmDspRoutineSessionRef=INX_Development_Session, DcmDspRoutineSecurityLevelRef=Level_17
            DcmDspStartRoutineIn
              In_nrOfBytes (DcmDspStartRoutineInSignal): DcmDspRoutineSignalLength=8, DcmDspRoutineSignalType=UINT8, DcmDspRoutineSignalPos=0
              In_data (DcmDspStartRoutineInSignal): DcmDspRoutineSignalLength=128, DcmDspRoutineSignalType=VARIABLE_LENGTH, DcmDspRoutineSignalEndianness=opaque, DcmDspRoutineSignalPos=8
            DcmDspStartRoutineOut
              Out_nrOfBytes (DcmDspStartRoutineOutSignal): DcmDspRoutineSignalLength=8, DcmDspRoutineSignalType=UINT8, DcmDspRoutineSignalPos=0
              Out_data (DcmDspStartRoutineOutSignal): DcmDspRoutineSignalLength=2040, DcmDspRoutineSignalType=VARIABLE_LENGTH, DcmDspRoutineSignalEndianness=opaque, DcmDspRoutineSignalPos=8
          RoutineInfo_CddHWRNXPRT1171_ConfigPropRequest_Start
            DcmDspRoutineAuthorization: DcmDspRoutineSessionRef=INX_End_Of_Line_Session, DcmDspRoutineSessionRef=INX_Development_Session, DcmDspRoutineSecurityLevelRef=Level_17
            DcmDspStartRoutineIn
              In_nrOfBytes (DcmDspStartRoutineInSignal): DcmDspRoutineSignalLength=8, DcmDspRoutineSignalType=UINT8, DcmDspRoutineSignalPos=0
              In_data (DcmDspStartRoutineInSignal): DcmDspRoutineSignalLength=128, DcmDspRoutineSignalType=VARIABLE_LENGTH, DcmDspRoutineSignalEndianness=opaque, DcmDspRoutineSignalPos=8
            DcmDspStartRoutineOut
              Out_nrOfBytes (DcmDspStartRoutineOutSignal): DcmDspRoutineSignalLength=8, DcmDspRoutineSignalType=UINT8, DcmDspRoutineSignalPos=0
              Out_data (DcmDspStartRoutineOutSignal): DcmDspRoutineSignalLength=2040, DcmDspRoutineSignalType=VARIABLE_LENGTH, DcmDspRoutineSignalEndianness=opaque, DcmDspRoutineSignalPos=8
          RoutineInfo_CddHWRNXPRT1171_SetSwUpdateReq_Start
            DcmDspRoutineAuthorization: DcmDspRoutineSessionRef=INX_End_Of_Line_Session, DcmDspRoutineSessionRef=INX_Development_Session, DcmDspRoutineSecurityLevelRef=Level_17
          RoutineInfo_SwcDimming_SetDisplayPwmOutput_Start
            DcmDspRoutineAuthorization:
              DcmDspRoutineSessionRef = DcmDspSession/Programming
              DcmDspRoutineSessionRef = DcmDspSession/Extended
              DcmDspRoutineSessionRef = INX_End_Of_Line_Session
              DcmDspRoutineSessionRef = INX_Development_Session
              DcmDspRoutineSecurityLevelRef = Level_17
            DcmDspStartRoutineIn
              In_value (DcmDspStartRoutineInSignal): DcmDspRoutineSignalLength=16, DcmDspRoutineSignalType=UINT16, DcmDspRoutineSignalEndianness=BIG_ENDIAN, DcmDspRoutineSignalPos=0
          RoutineInfo_SwcDimming_SetSliderPwmOutput_Start
            DcmDspRoutineAuthorization:
              DcmDspRoutineSessionRef = DcmDspSession/Programming
              DcmDspRoutineSessionRef = DcmDspSession/Extended
              DcmDspRoutineSessionRef = INX_End_Of_Line_Session
              DcmDspRoutineSessionRef = INX_Development_Session
              DcmDspRoutineSecurityLevelRef = Level_17
            DcmDspStartRoutineIn
              In_value (DcmDspStartRoutineInSignal): DcmDspRoutineSignalLength=16, DcmDspRoutineSignalType=UINT16, DcmDspRoutineSignalEndianness=BIG_ENDIAN, DcmDspRoutineSignalPos=0
          RoutineInfo_SwcDimming_SetDisplayLutDay_Start
            DcmDspRoutineAuthorization:
              DcmDspRoutineSessionRef = DcmDspSession/Programming
              DcmDspRoutineSessionRef = DcmDspSession/Extended
              DcmDspRoutineSessionRef = INX_End_Of_Line_Session
              DcmDspRoutineSessionRef = INX_Development_Session
              DcmDspRoutineSecurityLevelRef = Level_17
            DcmDspStartRoutineIn
              In_data (DcmDspStartRoutineInSignal): DcmDspRoutineSignalLength=256, DcmDspRoutineSignalType=VARIABLE_LENGTH, DcmDspRoutineSignalEndianness=opaque, DcmDspRoutineSignalPos=0
          RoutineInfo_SwcDimming_SetDisplayLutNight_Start
            DcmDspRoutineAuthorization:
              DcmDspRoutineSessionRef = DcmDspSession/Programming
              DcmDspRoutineSessionRef = DcmDspSession/Extended
              DcmDspRoutineSessionRef = INX_End_Of_Line_Session
              DcmDspRoutineSessionRef = INX_Development_Session
              DcmDspRoutineSecurityLevelRef = Level_17
            DcmDspStartRoutineIn
              In_data (DcmDspStartRoutineInSignal): DcmDspRoutineSignalLength=256, DcmDspRoutineSignalType=VARIABLE_LENGTH, DcmDspRoutineSignalEndianness=opaque, DcmDspRoutineSignalPos=0
          RoutineInfo_SwcDimming_SetSliderLut_Start
            DcmDspRoutineAuthorization:
              DcmDspRoutineSessionRef = DcmDspSession/Programming
              DcmDspRoutineSessionRef = DcmDspSession/Extended
              DcmDspRoutineSessionRef = INX_End_Of_Line_Session
              DcmDspRoutineSessionRef = INX_Development_Session
              DcmDspRoutineSecurityLevelRef = Level_17
            DcmDspStartRoutineIn
              In_data (DcmDspStartRoutineInSignal): DcmDspRoutineSignalLength=128, DcmDspRoutineSignalType=VARIABLE_LENGTH, DcmDspRoutineSignalEndianness=opaque, DcmDspRoutineSignalPos=0
          RoutineInfo_SwcDimming_SetDisplayPwmMin_Start
            DcmDspRoutineAuthorization:
              DcmDspRoutineSessionRef = DcmDspSession/Programming
              DcmDspRoutineSessionRef = DcmDspSession/Extended
              DcmDspRoutineSessionRef = INX_End_Of_Line_Session
              DcmDspRoutineSessionRef = INX_Development_Session
              DcmDspRoutineSecurityLevelRef = Level_17
            DcmDspStartRoutineIn
              In_value (DcmDspStartRoutineInSignal): DcmDspRoutineSignalLength=8, DcmDspRoutineSignalType=UINT8, DcmDspRoutineSignalPos=0
          RoutineInfo_SwcDimming_SetSliderXsErrorDefault_Start
            DcmDspRoutineAuthorization:
              DcmDspRoutineSessionRef = DcmDspSession/Programming
              DcmDspRoutineSessionRef = DcmDspSession/Extended
              DcmDspRoutineSessionRef = INX_End_Of_Line_Session
              DcmDspRoutineSessionRef = INX_Development_Session
              DcmDspRoutineSecurityLevelRef = Level_17
            DcmDspStartRoutineIn
              In_value (DcmDspStartRoutineInSignal): DcmDspRoutineSignalLength=8, DcmDspRoutineSignalType=UINT8, DcmDspRoutineSignalPos=0
          RoutineInfo_SwcDimming_SetSliderXtErrorDefault_Start
            DcmDspRoutineAuthorization:
              DcmDspRoutineSessionRef = DcmDspSession/Programming
              DcmDspRoutineSessionRef = DcmDspSession/Extended
              DcmDspRoutineSessionRef = INX_End_Of_Line_Session
              DcmDspRoutineSessionRef = INX_Development_Session
              DcmDspRoutineSecurityLevelRef = Level_17
            DcmDspStartRoutineIn
              In_value (DcmDspStartRoutineInSignal): DcmDspRoutineSignalLength=8, DcmDspRoutineSignalType=UINT8, DcmDspRoutineSignalPos=0
          RoutineInfo_SwcDisplayControl_TestPattern_Start
            DcmDspRoutineAuthorization: DcmDspRoutineSessionRef=INX_End_Of_Line_Session, DcmDspRoutineSessionRef=INX_Development_Session, DcmDspRoutineSecurityLevelRef=Level_17
            DcmDspStartRoutineIn
              In_testPattern (DcmDspStartRoutineInSignal): DcmDspRoutineSignalLength=8, DcmDspRoutineSignalType=UINT8, DcmDspRoutineSignalPos=0
          RoutineInfo_SwcError_GetErrorStatus_Start
            DcmDspRoutineAuthorization: DcmDspRoutineSessionRef=INX_End_Of_Line_Session, DcmDspRoutineSessionRef=INX_Development_Session, DcmDspRoutineSecurityLevelRef=Level_17
            DcmDspStartRoutineIn
              4 x DcmDspStartRoutineInSignal:
                In_moduleId: DcmDspRoutineSignalLength=16, DcmDspRoutineSignalType=UINT16, DcmDspRoutineSignalEndianness=BIG_ENDIAN, DcmDspRoutineSignalPos=0
                In_errorId: DcmDspRoutineSignalLength=8, DcmDspRoutineSignalType=UINT8, DcmDspRoutineSignalPos=16
                In_status: DcmDspRoutineSignalLength=8, DcmDspRoutineSignalType=UINT8, DcmDspRoutineSignalPos=24
                In_filter_Filters_STRUCTURE: DcmDspRoutineSignalLength=8, DcmDspRoutineSignalType=UINT8, DcmDspRoutineSignalPos=32
            DcmDspStartRoutineOut
              Out_nrOfErrorEntries (DcmDspStartRoutineOutSignal): DcmDspRoutineSignalLength=16, DcmDspRoutineSignalType=UINT16, DcmDspRoutineSignalEndianness=BIG_ENDIAN, DcmDspRoutineSignalPos=0
              Out_errorEntryLog (DcmDspStartRoutineOutSignal): DcmDspRoutineSignalLength=8192, DcmDspRoutineSignalType=VARIABLE_LENGTH, DcmDspRoutineSignalEndianness=opaque, DcmDspRoutineSignalPos=16
          RoutineInfo_SwcError_ClearErrorTrace_Start
            DcmDspRoutineAuthorization:
              DcmDspRoutineSessionRef = DcmDspSession/Programming
              DcmDspRoutineSessionRef = DcmDspSession/Extended
              DcmDspRoutineSessionRef = INX_End_Of_Line_Session
              DcmDspRoutineSessionRef = INX_Development_Session
              DcmDspRoutineSecurityLevelRef = Level_17
          RoutineInfo_SwcError_ClearErrorCounters_Start
            DcmDspRoutineAuthorization: DcmDspRoutineSessionRef=INX_End_Of_Line_Session, DcmDspRoutineSessionRef=INX_Development_Session, DcmDspRoutineSecurityLevelRef=Level_17
          RoutineInfo_SwcError_UartSeverityLevelSimulation_Start
            DcmDspRoutineAuthorization: DcmDspRoutineSessionRef=INX_End_Of_Line_Session, DcmDspRoutineSessionRef=INX_Development_Session, DcmDspRoutineSecurityLevelRef=Level_17
            DcmDspStartRoutineIn
              In_errorSeverityLevel (DcmDspStartRoutineInSignal): DcmDspRoutineSignalLength=8, DcmDspRoutineSignalType=UINT8, DcmDspRoutineSignalPos=0
          RoutineInfo_SwcError_ErrorCountSeverityLevelSimulation_Start
            DcmDspRoutineAuthorization:
              DcmDspRoutineSessionRef = DcmDspSession/Programming
              DcmDspRoutineSessionRef = DcmDspSession/Extended
              DcmDspRoutineSessionRef = INX_End_Of_Line_Session
              DcmDspRoutineSessionRef = INX_Development_Session
              DcmDspRoutineSecurityLevelRef = Level_17
            DcmDspStartRoutineIn
              In_errorSeverityLevel (DcmDspStartRoutineInSignal): DcmDspRoutineSignalLength=8, DcmDspRoutineSignalType=UINT8, DcmDspRoutineSignalPos=0
          RoutineInfo_SwcError_TraceSeverityLevelSimulation_Start
            DcmDspRoutineAuthorization:
              DcmDspRoutineSessionRef = DcmDspSession/Programming
              DcmDspRoutineSessionRef = DcmDspSession/Extended
              DcmDspRoutineSessionRef = INX_End_Of_Line_Session
              DcmDspRoutineSessionRef = INX_Development_Session
              DcmDspRoutineSecurityLevelRef = Level_17
            DcmDspStartRoutineIn
              In_errorSeverityLevel (DcmDspStartRoutineInSignal): DcmDspRoutineSignalLength=8, DcmDspRoutineSignalType=UINT8, DcmDspRoutineSignalPos=0
          RoutineInfo_SwcError_GetErrorTrace_Start
            DcmDspRoutineAuthorization: DcmDspRoutineSessionRef=INX_End_Of_Line_Session, DcmDspRoutineSessionRef=INX_Development_Session, DcmDspRoutineSecurityLevelRef=Level_17
            DcmDspStartRoutineOut
              Out_traceWriteIndex (DcmDspStartRoutineOutSignal): DcmDspRoutineSignalLength=8, DcmDspRoutineSignalType=UINT8, DcmDspRoutineSignalPos=0
              Out_errorTrace (DcmDspStartRoutineOutSignal): DcmDspRoutineSignalLength=1920, DcmDspRoutineSignalType=UINT8, DcmDspRoutineSignalEndianness=opaque, DcmDspRoutineSignalPos=8
          RoutineInfo_SwcError_GetErrorCounters_Start
            DcmDspRoutineAuthorization: DcmDspRoutineSessionRef=INX_End_Of_Line_Session, DcmDspRoutineSessionRef=INX_Development_Session, DcmDspRoutineSecurityLevelRef=Level_17
            DcmDspStartRoutineOut
              Out_nbrOfEntries (DcmDspStartRoutineOutSignal): DcmDspRoutineSignalLength=8, DcmDspRoutineSignalType=UINT8, DcmDspRoutineSignalPos=0
              Out_data (DcmDspStartRoutineOutSignal): DcmDspRoutineSignalLength=6400, DcmDspRoutineSignalType=UINT8, DcmDspRoutineSignalEndianness=opaque, DcmDspRoutineSignalPos=8
          RoutineInfo_SwcDimming_SetDisplayErrorDefault_Start
            DcmDspRoutineAuthorization:
              DcmDspRoutineSessionRef = DcmDspSession/Programming
              DcmDspRoutineSessionRef = DcmDspSession/Extended
              DcmDspRoutineSessionRef = INX_End_Of_Line_Session
              DcmDspRoutineSessionRef = INX_Development_Session
              DcmDspRoutineSecurityLevelRef = Level_17
            DcmDspStartRoutineIn
              In_value (DcmDspStartRoutineInSignal): DcmDspRoutineSignalLength=8, DcmDspRoutineSignalType=UINT8, DcmDspRoutineSignalPos=0
          RoutineInfo_SwcDimming_SetDisplayOffsetMultiplier_Start
            DcmDspRoutineAuthorization:
              DcmDspRoutineSessionRef = DcmDspSession/Programming
              DcmDspRoutineSessionRef = DcmDspSession/Extended
              DcmDspRoutineSessionRef = INX_End_Of_Line_Session
              DcmDspRoutineSessionRef = INX_Development_Session
              DcmDspRoutineSecurityLevelRef = Level_17
            DcmDspStartRoutineIn
              In_value (DcmDspStartRoutineInSignal): DcmDspRoutineSignalLength=8, DcmDspRoutineSignalType=UINT8, DcmDspRoutineSignalPos=0
          RoutineInfo_SwcDimming_SetTauDampUp_Start
            DcmDspRoutineAuthorization:
              DcmDspRoutineSessionRef = DcmDspSession/Programming
              DcmDspRoutineSessionRef = DcmDspSession/Extended
              DcmDspRoutineSessionRef = INX_End_Of_Line_Session
              DcmDspRoutineSessionRef = INX_Development_Session
              DcmDspRoutineSecurityLevelRef = Level_17
            DcmDspStartRoutineIn
              In_value (DcmDspStartRoutineInSignal): DcmDspRoutineSignalLength=8, DcmDspRoutineSignalType=UINT8, DcmDspRoutineSignalPos=0
          RoutineInfo_SwcDimming_SetTauDampDown_Start
            DcmDspRoutineAuthorization:
              DcmDspRoutineSessionRef = DcmDspSession/Programming
              DcmDspRoutineSessionRef = DcmDspSession/Extended
              DcmDspRoutineSessionRef = INX_End_Of_Line_Session
              DcmDspRoutineSessionRef = INX_Development_Session
              DcmDspRoutineSecurityLevelRef = Level_17
            DcmDspStartRoutineIn
              In_value (DcmDspStartRoutineInSignal): DcmDspRoutineSignalLength=8, DcmDspRoutineSignalType=UINT8, DcmDspRoutineSignalPos=0
          RoutineInfo_SwcDimming_SetTauDayToNight_Start
            DcmDspRoutineAuthorization:
              DcmDspRoutineSessionRef = DcmDspSession/Programming
              DcmDspRoutineSessionRef = DcmDspSession/Extended
              DcmDspRoutineSessionRef = INX_End_Of_Line_Session
              DcmDspRoutineSessionRef = INX_Development_Session
              DcmDspRoutineSecurityLevelRef = Level_17
            DcmDspStartRoutineIn
              In_value (DcmDspStartRoutineInSignal): DcmDspRoutineSignalLength=8, DcmDspRoutineSignalType=UINT8, DcmDspRoutineSignalPos=0
          RoutineInfo_SwcDimming_SetTauNightToDay_Start
            DcmDspRoutineAuthorization:
              DcmDspRoutineSessionRef = DcmDspSession/Programming
              DcmDspRoutineSessionRef = DcmDspSession/Extended
              DcmDspRoutineSessionRef = INX_End_Of_Line_Session
              DcmDspRoutineSessionRef = INX_Development_Session
              DcmDspRoutineSecurityLevelRef = Level_17
            DcmDspStartRoutineIn
              In_value (DcmDspStartRoutineInSignal): DcmDspRoutineSignalLength=8, DcmDspRoutineSignalType=UINT8, DcmDspRoutineSignalPos=0
          RoutineInfo_SwcDimming_SetDisplayDampingInterval_Start
            DcmDspRoutineAuthorization:
              DcmDspRoutineSessionRef = DcmDspSession/Programming
              DcmDspRoutineSessionRef = DcmDspSession/Extended
              DcmDspRoutineSessionRef = INX_End_Of_Line_Session
              DcmDspRoutineSessionRef = INX_Development_Session
              DcmDspRoutineSecurityLevelRef = Level_17
            DcmDspStartRoutineIn
              In_value (DcmDspStartRoutineInSignal): DcmDspRoutineSignalLength=8, DcmDspRoutineSignalType=UINT8, DcmDspRoutineSignalPos=0
          RoutineInfo_SwcSelfDiagnostics_AverageCpuLoad_Start
            DcmDspRoutineAuthorization: DcmDspRoutineSessionRef=INX_End_Of_Line_Session, DcmDspRoutineSessionRef=INX_Development_Session, DcmDspRoutineSecurityLevelRef=Level_17
            DcmDspRoutineRequestResOut
              Out_cpuLoad (DcmDspRoutineRequestResOutSignal): DcmDspRoutineSignalLength=8, DcmDspRoutineSignalType=UINT8, DcmDspRoutineSignalPos=0
          RoutineInfo_SwcSelfDiagnostics_StackUsage_Start
            DcmDspRoutineAuthorization:
              DcmDspRoutineSessionRef = DcmDspSession/Programming
              DcmDspRoutineSessionRef = DcmDspSession/Extended
              DcmDspRoutineSessionRef = INX_End_Of_Line_Session
              DcmDspRoutineSessionRef = INX_Development_Session
              DcmDspRoutineSecurityLevelRef = Level_17
            DcmDspStartRoutineIn
              In_taskId (DcmDspStartRoutineInSignal): DcmDspRoutineSignalLength=8, DcmDspRoutineSignalType=UINT8, DcmDspRoutineSignalPos=0
            DcmDspStartRoutineOut
              Out_pTask (DcmDspStartRoutineOutSignal): DcmDspRoutineSignalLength=8, DcmDspRoutineSignalType=UINT8, DcmDspRoutineSignalPos=0
              Out_pStackUsage (DcmDspStartRoutineOutSignal): DcmDspRoutineSignalLength=2040, DcmDspRoutineSignalType=VARIABLE_LENGTH, DcmDspRoutineSignalEndianness=opaque, DcmDspRoutineSignalPos=8
          RoutineInfo_SwcVerify_ModuleVerifyDisable_Start
            DcmDspRoutineAuthorization: DcmDspRoutineSessionRef=INX_End_Of_Line_Session, DcmDspRoutineSessionRef=INX_Development_Session, DcmDspRoutineSecurityLevelRef=Level_17
            DcmDspStartRoutineIn
              In_moduleId (DcmDspStartRoutineInSignal): DcmDspRoutineSignalLength=16, DcmDspRoutineSignalType=UINT16, DcmDspRoutineSignalEndianness=BIG_ENDIAN, DcmDspRoutineSignalPos=0
            DcmDspRoutineStopIn
              In_moduleId (DcmDspRoutineStopInSignal): DcmDspRoutineSignalLength=16, DcmDspRoutineSignalType=UINT16, DcmDspRoutineSignalEndianness=BIG_ENDIAN, DcmDspRoutineSignalPos=0
          RoutineInfo_SwcVerify_VerifyRequest_Start
            DcmDspRoutineAuthorization: DcmDspRoutineSessionRef=INX_End_Of_Line_Session, DcmDspRoutineSessionRef=INX_Development_Session, DcmDspRoutineSecurityLevelRef=Level_17
            DcmDspStartRoutineIn
              In_moduleId (DcmDspStartRoutineInSignal): DcmDspRoutineSignalLength=16, DcmDspRoutineSignalType=UINT16, DcmDspRoutineSignalEndianness=BIG_ENDIAN, DcmDspRoutineSignalPos=0
              In_verifyId (DcmDspStartRoutineInSignal): DcmDspRoutineSignalLength=8, DcmDspRoutineSignalType=UINT8, DcmDspRoutineSignalPos=16
            DcmDspRoutineRequestResIn
              In_moduleId (DcmDspRoutineRequestResInSignal): DcmDspRoutineSignalLength=16, DcmDspRoutineSignalType=UINT16, DcmDspRoutineSignalEndianness=BIG_ENDIAN, DcmDspRoutineSignalPos=0
              In_verifyId (DcmDspRoutineRequestResInSignal): DcmDspRoutineSignalLength=8, DcmDspRoutineSignalType=UINT8, DcmDspRoutineSignalPos=16
            DcmDspRoutineRequestResOut
              Out_pVerifyState (DcmDspRoutineRequestResOutSignal): DcmDspRoutineSignalLength=8, DcmDspRoutineSignalType=UINT8, DcmDspRoutineSignalPos=0
          RoutineInfo_SwcVerify_RecoveryRequest_Start
            DcmDspRoutineAuthorization: DcmDspRoutineSessionRef=INX_End_Of_Line_Session, DcmDspRoutineSessionRef=INX_Development_Session, DcmDspRoutineSecurityLevelRef=Level_17
            DcmDspStartRoutineIn
              In_moduleId (DcmDspStartRoutineInSignal): DcmDspRoutineSignalLength=16, DcmDspRoutineSignalType=UINT16, DcmDspRoutineSignalEndianness=BIG_ENDIAN, DcmDspRoutineSignalPos=0
              In_recoveryId (DcmDspStartRoutineInSignal): DcmDspRoutineSignalLength=8, DcmDspRoutineSignalType=UINT8, DcmDspRoutineSignalPos=16
            DcmDspRoutineRequestResIn
              In_moduleId (DcmDspRoutineRequestResInSignal): DcmDspRoutineSignalLength=16, DcmDspRoutineSignalType=UINT16, DcmDspRoutineSignalEndianness=BIG_ENDIAN, DcmDspRoutineSignalPos=0
              In_recoveryId (DcmDspRoutineRequestResInSignal): DcmDspRoutineSignalLength=8, DcmDspRoutineSignalType=UINT8, DcmDspRoutineSignalPos=16
            DcmDspRoutineRequestResOut
              Out_pRecoveryState (DcmDspRoutineRequestResOutSignal): DcmDspRoutineSignalLength=8, DcmDspRoutineSignalType=UINT8, DcmDspRoutineSignalPos=0
          RoutineInfo_CddHWRNXPRT1171_SeverityLevelSimulation_Start
            DcmDspRoutineAuthorization: DcmDspRoutineSessionRef=INX_End_Of_Line_Session, DcmDspRoutineSessionRef=INX_Development_Session, DcmDspRoutineSecurityLevelRef=Level_17
            DcmDspStartRoutineIn
              In_errorSeverityLevel (DcmDspStartRoutineInSignal): DcmDspRoutineSignalLength=8, DcmDspRoutineSignalType=UINT8, DcmDspRoutineSignalPos=0
          RoutineInfo_SwcDisplayInfo_ModuleVersionInfo_Start
            DcmDspRoutineAuthorization:
              DcmDspRoutineSessionRef = DcmDspSession/Programming
              DcmDspRoutineSessionRef = DcmDspSession/Extended
              DcmDspRoutineSessionRef = INX_End_Of_Line_Session
              DcmDspRoutineSessionRef = INX_Development_Session
              DcmDspRoutineSecurityLevelRef = Level_17
            DcmDspStartRoutineOut
              Out_moduleVersionCount (DcmDspStartRoutineOutSignal): DcmDspRoutineSignalLength=8, DcmDspRoutineSignalType=UINT8, DcmDspRoutineSignalPos=0
              Out_moduleVersionList (DcmDspStartRoutineOutSignal): DcmDspRoutineSignalLength=4000, DcmDspRoutineSignalType=VARIABLE_LENGTH, DcmDspRoutineSignalEndianness=opaque, DcmDspRoutineSignalPos=8
          RoutineInfo_EraseMemory_Start
            DcmDspRoutineAuthorization: DcmDspRoutineSessionRef=DcmDspSession/Programming, DcmDspRoutineSecurityLevelRef=Level_17
            DcmDspStartRoutineIn
              In_ALFID (DcmDspStartRoutineInSignal): DcmDspRoutineSignalLength=8, DcmDspRoutineSignalType=UINT8, DcmDspRoutineSignalPos=0
              In_MemoryAddress (DcmDspStartRoutineInSignal): DcmDspRoutineSignalLength=8, DcmDspRoutineSignalType=UINT8, DcmDspRoutineSignalPos=8
            DcmDspStartRoutineOut
              Out_RoutineResult (DcmDspStartRoutineOutSignal): DcmDspRoutineSignalLength=8, DcmDspRoutineSignalType=UINT8, DcmDspRoutineSignalPos=0
          RoutineInfo_CheckProgrammingDependencies_Start
            DcmDspRoutineAuthorization: DcmDspRoutineSessionRef=DcmDspSession/Programming, DcmDspRoutineSecurityLevelRef=Level_17
            DcmDspStartRoutineOut
              Out_RoutineResult (DcmDspStartRoutineOutSignal): DcmDspRoutineSignalLength=8, DcmDspRoutineSignalType=UINT8, DcmDspRoutineSignalPos=0
        DcmDspSecurity
          Level_17 (DcmDspSecurityRow): DcmDspSecurityKeySize=4, DcmDspSecurityLevel=9, DcmDspSecuritySeedSize=4
        DcmDspSession
          5 x DcmDspSessionRow, all with DcmDspSessionP2ServerMax=0.05, DcmDspSessionP2StarServerMax=5:
            Default: DcmDspSessionLevel=1, DcmDspSessionForBoot=DCM_NO_BOOT
            Programming: DcmDspSessionLevel=2
            Extended: DcmDspSessionLevel=3, DcmDspSessionForBoot=DCM_NO_BOOT
            INX_End_Of_Line_Session: DcmDspSessionLevel=96
            INX_Development_Session: DcmDspSessionLevel=97
        ComControl (DcmDspComControl)
          DspComContolAllChannel (DcmDspComControlAllChannel)
  module config Dem: module-description=Dem_Impl
    DemConfigSet
      DTCClass_DTC_0x901001 (DemDTCClass): DemDTCSeverity=DEM_DTC_SEV_NO_SEVERITY, DemUdsDTC=9441281
      DTC_0x901001 (DemEventParameter): DemEventKind=DEM_EVENT_KIND_SWC, DemDTCClassRef=DTCClass_DTC_0x901001, DemExtendedDataClassRef=ExtendedDataClass_83dcefb7
        DemEventClass:
          DemAgingAllowed = false
          DemAgingCycleCounterThreshold = 0
          DemEventDestination = DEM_DTC_ORIGIN_PRIMARY_MEMORY
          DemEventPriority = 2
          DemEventSignificance = DEM_EVENT_SIGNIFICANCE_FAULT
          DemEventFailureCycleCounterThreshold = 0
          DemAgingCycleRef = PowerCycle
          DemOperationCycleRef = PowerCycle
          DemDebounceAlgorithmClass
            DemDebounceCounterBased:
              DemDebounceCounterDecrementStepSize = 1
              DemDebounceCounterIncrementStepSize = 1
              DemDebounceCounterJumpDown = true
              DemDebounceCounterJumpDownValue = 0
              DemDebounceCounterJumpUp = true
              DemDebounceCounterJumpUpValue = 0
      DTCClass_DTC_0x901101 (DemDTCClass): DemDTCSeverity=DEM_DTC_SEV_NO_SEVERITY, DemUdsDTC=9441537
      DTC_0x901101 (DemEventParameter): DemEventKind=DEM_EVENT_KIND_SWC, DemDTCClassRef=DTCClass_DTC_0x901101, DemExtendedDataClassRef=ExtendedDataClass_83dcefb7
        DemEventClass:
          DemAgingAllowed = false
          DemAgingCycleCounterThreshold = 0
          DemEventDestination = DEM_DTC_ORIGIN_PRIMARY_MEMORY
          DemEventPriority = 2
          DemEventSignificance = DEM_EVENT_SIGNIFICANCE_FAULT
          DemEventFailureCycleCounterThreshold = 0
          DemAgingCycleRef = PowerCycle
          DemOperationCycleRef = PowerCycle
          DemDebounceAlgorithmClass
            DemDebounceCounterBased:
              DemDebounceCounterDecrementStepSize = 1
              DemDebounceCounterIncrementStepSize = 1
              DemDebounceCounterJumpDown = true
              DemDebounceCounterJumpDownValue = 0
              DemDebounceCounterJumpUp = true
              DemDebounceCounterJumpUpValue = 0
      DTCClass_DTC_0x901201 (DemDTCClass): DemDTCSeverity=DEM_DTC_SEV_NO_SEVERITY, DemUdsDTC=9441793
      DTC_0x901201 (DemEventParameter): DemEventKind=DEM_EVENT_KIND_SWC, DemDTCClassRef=DTCClass_DTC_0x901201, DemExtendedDataClassRef=ExtendedDataClass_83dcefb7
        DemEventClass:
          DemAgingAllowed = false
          DemAgingCycleCounterThreshold = 0
          DemEventDestination = DEM_DTC_ORIGIN_PRIMARY_MEMORY
          DemEventPriority = 2
          DemEventSignificance = DEM_EVENT_SIGNIFICANCE_FAULT
          DemEventFailureCycleCounterThreshold = 0
          DemAgingCycleRef = PowerCycle
          DemOperationCycleRef = PowerCycle
          DemDebounceAlgorithmClass
            DemDebounceCounterBased:
              DemDebounceCounterDecrementStepSize = 1
              DemDebounceCounterIncrementStepSize = 1
              DemDebounceCounterJumpDown = true
              DemDebounceCounterJumpDownValue = 0
              DemDebounceCounterJumpUp = true
              DemDebounceCounterJumpUpValue = 0
      DTCClass_DTC_0x901301 (DemDTCClass): DemDTCSeverity=DEM_DTC_SEV_NO_SEVERITY, DemUdsDTC=9442049
      DTC_0x901301 (DemEventParameter): DemEventKind=DEM_EVENT_KIND_SWC, DemDTCClassRef=DTCClass_DTC_0x901301, DemExtendedDataClassRef=ExtendedDataClass_83dcefb7
        DemEventClass:
          DemAgingAllowed = false
          DemAgingCycleCounterThreshold = 0
          DemEventDestination = DEM_DTC_ORIGIN_PRIMARY_MEMORY
          DemEventPriority = 2
          DemEventSignificance = DEM_EVENT_SIGNIFICANCE_FAULT
          DemEventFailureCycleCounterThreshold = 0
          DemAgingCycleRef = PowerCycle
          DemOperationCycleRef = PowerCycle
          DemDebounceAlgorithmClass
            DemDebounceCounterBased:
              DemDebounceCounterDecrementStepSize = 1
              DemDebounceCounterIncrementStepSize = 1
              DemDebounceCounterJumpDown = true
              DemDebounceCounterJumpDownValue = 0
              DemDebounceCounterJumpUp = true
              DemDebounceCounterJumpUpValue = 0
      DTCClass_DTC_0x901401 (DemDTCClass): DemDTCSeverity=DEM_DTC_SEV_NO_SEVERITY, DemUdsDTC=9442305
      DTC_0x901401 (DemEventParameter): DemEventKind=DEM_EVENT_KIND_SWC, DemDTCClassRef=DTCClass_DTC_0x901401, DemExtendedDataClassRef=ExtendedDataClass_83dcefb7
        DemEventClass:
          DemAgingAllowed = false
          DemAgingCycleCounterThreshold = 0
          DemEventDestination = DEM_DTC_ORIGIN_PRIMARY_MEMORY
          DemEventPriority = 2
          DemEventSignificance = DEM_EVENT_SIGNIFICANCE_FAULT
          DemEventFailureCycleCounterThreshold = 0
          DemAgingCycleRef = PowerCycle
          DemOperationCycleRef = PowerCycle
          DemDebounceAlgorithmClass
            DemDebounceCounterBased:
              DemDebounceCounterDecrementStepSize = 1
              DemDebounceCounterIncrementStepSize = 1
              DemDebounceCounterJumpDown = true
              DemDebounceCounterJumpDownValue = 0
              DemDebounceCounterJumpUp = true
              DemDebounceCounterJumpUpValue = 0
      DTCClass_DTC_0x901501 (DemDTCClass): DemDTCSeverity=DEM_DTC_SEV_NO_SEVERITY, DemUdsDTC=9442561
      DTC_0x901501 (DemEventParameter): DemEventKind=DEM_EVENT_KIND_SWC, DemDTCClassRef=DTCClass_DTC_0x901501, DemExtendedDataClassRef=ExtendedDataClass_83dcefb7
        DemEventClass:
          DemAgingAllowed = false
          DemAgingCycleCounterThreshold = 0
          DemEventDestination = DEM_DTC_ORIGIN_PRIMARY_MEMORY
          DemEventPriority = 2
          DemEventSignificance = DEM_EVENT_SIGNIFICANCE_FAULT
          DemEventFailureCycleCounterThreshold = 0
          DemAgingCycleRef = PowerCycle
          DemOperationCycleRef = PowerCycle
          DemDebounceAlgorithmClass
            DemDebounceCounterBased:
              DemDebounceCounterDecrementStepSize = 1
              DemDebounceCounterIncrementStepSize = 1
              DemDebounceCounterJumpDown = true
              DemDebounceCounterJumpDownValue = 0
              DemDebounceCounterJumpUp = true
              DemDebounceCounterJumpUpValue = 0
      DTCClass_DTC_0x901601 (DemDTCClass): DemDTCSeverity=DEM_DTC_SEV_NO_SEVERITY, DemUdsDTC=9442817
      DTC_0x901601 (DemEventParameter): DemEventKind=DEM_EVENT_KIND_SWC, DemDTCClassRef=DTCClass_DTC_0x901601, DemExtendedDataClassRef=ExtendedDataClass_83dcefb7
        DemEventClass:
          DemAgingAllowed = false
          DemAgingCycleCounterThreshold = 0
          DemEventDestination = DEM_DTC_ORIGIN_PRIMARY_MEMORY
          DemEventPriority = 2
          DemEventSignificance = DEM_EVENT_SIGNIFICANCE_FAULT
          DemEventFailureCycleCounterThreshold = 0
          DemAgingCycleRef = PowerCycle
          DemOperationCycleRef = PowerCycle
          DemDebounceAlgorithmClass
            DemDebounceCounterBased:
              DemDebounceCounterDecrementStepSize = 1
              DemDebounceCounterIncrementStepSize = 1
              DemDebounceCounterJumpDown = true
              DemDebounceCounterJumpDownValue = 0
              DemDebounceCounterJumpUp = true
              DemDebounceCounterJumpUpValue = 0
      DTCClass_DTC_0x901701 (DemDTCClass): DemDTCSeverity=DEM_DTC_SEV_NO_SEVERITY, DemUdsDTC=9443073
      DTC_0x901701 (DemEventParameter): DemEventKind=DEM_EVENT_KIND_SWC, DemDTCClassRef=DTCClass_DTC_0x901701, DemExtendedDataClassRef=ExtendedDataClass_83dcefb7
        DemEventClass:
          DemAgingAllowed = false
          DemAgingCycleCounterThreshold = 0
          DemEventDestination = DEM_DTC_ORIGIN_PRIMARY_MEMORY
          DemEventPriority = 2
          DemEventSignificance = DEM_EVENT_SIGNIFICANCE_FAULT
          DemEventFailureCycleCounterThreshold = 0
          DemAgingCycleRef = PowerCycle
          DemOperationCycleRef = PowerCycle
          DemDebounceAlgorithmClass
            DemDebounceCounterBased:
              DemDebounceCounterDecrementStepSize = 1
              DemDebounceCounterIncrementStepSize = 1
              DemDebounceCounterJumpDown = true
              DemDebounceCounterJumpDownValue = 0
              DemDebounceCounterJumpUp = true
              DemDebounceCounterJumpUpValue = 0
      DTCClass_DTC_0x901801 (DemDTCClass): DemDTCSeverity=DEM_DTC_SEV_NO_SEVERITY, DemUdsDTC=9443329
      DTC_0x901801 (DemEventParameter): DemEventKind=DEM_EVENT_KIND_SWC, DemDTCClassRef=DTCClass_DTC_0x901801, DemExtendedDataClassRef=ExtendedDataClass_83dcefb7
        DemEventClass:
          DemAgingAllowed = false
          DemAgingCycleCounterThreshold = 0
          DemEventDestination = DEM_DTC_ORIGIN_PRIMARY_MEMORY
          DemEventPriority = 2
          DemEventSignificance = DEM_EVENT_SIGNIFICANCE_FAULT
          DemEventFailureCycleCounterThreshold = 0
          DemAgingCycleRef = PowerCycle
          DemOperationCycleRef = PowerCycle
          DemDebounceAlgorithmClass
            DemDebounceCounterBased:
              DemDebounceCounterDecrementStepSize = 1
              DemDebounceCounterIncrementStepSize = 1
              DemDebounceCounterJumpDown = true
              DemDebounceCounterJumpDownValue = 0
              DemDebounceCounterJumpUp = true
              DemDebounceCounterJumpUpValue = 0
      DTCClass_DTC_0x901901 (DemDTCClass): DemDTCSeverity=DEM_DTC_SEV_NO_SEVERITY, DemUdsDTC=9443585
      DTC_0x901901 (DemEventParameter): DemEventKind=DEM_EVENT_KIND_SWC, DemDTCClassRef=DTCClass_DTC_0x901901, DemExtendedDataClassRef=ExtendedDataClass_83dcefb7
        DemEventClass:
          DemAgingAllowed = false
          DemAgingCycleCounterThreshold = 0
          DemEventDestination = DEM_DTC_ORIGIN_PRIMARY_MEMORY
          DemEventPriority = 2
          DemEventSignificance = DEM_EVENT_SIGNIFICANCE_FAULT
          DemEventFailureCycleCounterThreshold = 0
          DemAgingCycleRef = PowerCycle
          DemOperationCycleRef = PowerCycle
          DemDebounceAlgorithmClass
            DemDebounceCounterBased:
              DemDebounceCounterDecrementStepSize = 1
              DemDebounceCounterIncrementStepSize = 1
              DemDebounceCounterJumpDown = true
              DemDebounceCounterJumpDownValue = 0
              DemDebounceCounterJumpUp = true
              DemDebounceCounterJumpUpValue = 0
      DTCClass_DTC_0x901a01 (DemDTCClass): DemDTCSeverity=DEM_DTC_SEV_NO_SEVERITY, DemUdsDTC=9443841
      DTC_0x901a01 (DemEventParameter): DemEventKind=DEM_EVENT_KIND_SWC, DemDTCClassRef=DTCClass_DTC_0x901a01, DemExtendedDataClassRef=ExtendedDataClass_83dcefb7
        DemEventClass:
          DemAgingAllowed = false
          DemAgingCycleCounterThreshold = 0
          DemEventDestination = DEM_DTC_ORIGIN_PRIMARY_MEMORY
          DemEventPriority = 2
          DemEventSignificance = DEM_EVENT_SIGNIFICANCE_FAULT
          DemEventFailureCycleCounterThreshold = 0
          DemAgingCycleRef = PowerCycle
          DemOperationCycleRef = PowerCycle
          DemDebounceAlgorithmClass
            DemDebounceCounterBased:
              DemDebounceCounterDecrementStepSize = 1
              DemDebounceCounterIncrementStepSize = 1
              DemDebounceCounterJumpDown = true
              DemDebounceCounterJumpDownValue = 0
              DemDebounceCounterJumpUp = true
              DemDebounceCounterJumpUpValue = 0
      DTCClass_DTC_0x901b01 (DemDTCClass): DemDTCSeverity=DEM_DTC_SEV_NO_SEVERITY, DemUdsDTC=9444097
      DTC_0x901b01 (DemEventParameter): DemEventKind=DEM_EVENT_KIND_SWC, DemDTCClassRef=DTCClass_DTC_0x901b01, DemExtendedDataClassRef=ExtendedDataClass_83dcefb7
        DemEventClass:
          DemAgingAllowed = false
          DemAgingCycleCounterThreshold = 0
          DemEventDestination = DEM_DTC_ORIGIN_PRIMARY_MEMORY
          DemEventPriority = 2
          DemEventSignificance = DEM_EVENT_SIGNIFICANCE_FAULT
          DemEventFailureCycleCounterThreshold = 0
          DemAgingCycleRef = PowerCycle
          DemOperationCycleRef = PowerCycle
          DemDebounceAlgorithmClass
            DemDebounceCounterBased:
              DemDebounceCounterDecrementStepSize = 1
              DemDebounceCounterIncrementStepSize = 1
              DemDebounceCounterJumpDown = true
              DemDebounceCounterJumpDownValue = 0
              DemDebounceCounterJumpUp = true
              DemDebounceCounterJumpUpValue = 0
      DTCClass_DTC_0x901c01 (DemDTCClass): DemDTCSeverity=DEM_DTC_SEV_NO_SEVERITY, DemUdsDTC=9444353
      DTC_0x901c01 (DemEventParameter): DemEventKind=DEM_EVENT_KIND_SWC, DemDTCClassRef=DTCClass_DTC_0x901c01, DemExtendedDataClassRef=ExtendedDataClass_83dcefb7
        DemEventClass:
          DemAgingAllowed = false
          DemAgingCycleCounterThreshold = 0
          DemEventDestination = DEM_DTC_ORIGIN_PRIMARY_MEMORY
          DemEventPriority = 2
          DemEventSignificance = DEM_EVENT_SIGNIFICANCE_FAULT
          DemEventFailureCycleCounterThreshold = 0
          DemAgingCycleRef = PowerCycle
          DemOperationCycleRef = PowerCycle
          DemDebounceAlgorithmClass
            DemDebounceCounterBased:
              DemDebounceCounterDecrementStepSize = 1
              DemDebounceCounterIncrementStepSize = 1
              DemDebounceCounterJumpDown = true
              DemDebounceCounterJumpDownValue = 0
              DemDebounceCounterJumpUp = true
              DemDebounceCounterJumpUpValue = 0
      DTCClass_DTC_0x901d01 (DemDTCClass): DemDTCSeverity=DEM_DTC_SEV_NO_SEVERITY, DemUdsDTC=9444609
      DTC_0x901d01 (DemEventParameter): DemEventKind=DEM_EVENT_KIND_SWC, DemDTCClassRef=DTCClass_DTC_0x901d01, DemExtendedDataClassRef=ExtendedDataClass_83dcefb7
        DemEventClass:
          DemAgingAllowed = false
          DemAgingCycleCounterThreshold = 0
          DemEventDestination = DEM_DTC_ORIGIN_PRIMARY_MEMORY
          DemEventPriority = 2
          DemEventSignificance = DEM_EVENT_SIGNIFICANCE_FAULT
          DemEventFailureCycleCounterThreshold = 0
          DemAgingCycleRef = PowerCycle
          DemOperationCycleRef = PowerCycle
          DemDebounceAlgorithmClass
            DemDebounceCounterBased:
              DemDebounceCounterDecrementStepSize = 1
              DemDebounceCounterIncrementStepSize = 1
              DemDebounceCounterJumpDown = true
              DemDebounceCounterJumpDownValue = 0
              DemDebounceCounterJumpUp = true
              DemDebounceCounterJumpUpValue = 0
      DTCClass_DTC_0x901e01 (DemDTCClass): DemDTCSeverity=DEM_DTC_SEV_NO_SEVERITY, DemUdsDTC=9444865
      DTC_0x901e01 (DemEventParameter): DemEventKind=DEM_EVENT_KIND_SWC, DemDTCClassRef=DTCClass_DTC_0x901e01, DemExtendedDataClassRef=ExtendedDataClass_83dcefb7
        DemEventClass:
          DemAgingAllowed = false
          DemAgingCycleCounterThreshold = 0
          DemEventDestination = DEM_DTC_ORIGIN_PRIMARY_MEMORY
          DemEventPriority = 2
          DemEventSignificance = DEM_EVENT_SIGNIFICANCE_FAULT
          DemEventFailureCycleCounterThreshold = 0
          DemAgingCycleRef = PowerCycle
          DemOperationCycleRef = PowerCycle
          DemDebounceAlgorithmClass
            DemDebounceCounterBased:
              DemDebounceCounterDecrementStepSize = 1
              DemDebounceCounterIncrementStepSize = 1
              DemDebounceCounterJumpDown = true
              DemDebounceCounterJumpDownValue = 0
              DemDebounceCounterJumpUp = true
              DemDebounceCounterJumpUpValue = 0
      DTCClass_DTC_0x901f01 (DemDTCClass): DemDTCSeverity=DEM_DTC_SEV_NO_SEVERITY, DemUdsDTC=9445121
      DTC_0x901f01 (DemEventParameter): DemEventKind=DEM_EVENT_KIND_SWC, DemDTCClassRef=DTCClass_DTC_0x901f01, DemExtendedDataClassRef=ExtendedDataClass_83dcefb7
        DemEventClass:
          DemAgingAllowed = false
          DemAgingCycleCounterThreshold = 0
          DemEventDestination = DEM_DTC_ORIGIN_PRIMARY_MEMORY
          DemEventPriority = 2
          DemEventSignificance = DEM_EVENT_SIGNIFICANCE_FAULT
          DemEventFailureCycleCounterThreshold = 0
          DemAgingCycleRef = PowerCycle
          DemOperationCycleRef = PowerCycle
          DemDebounceAlgorithmClass
            DemDebounceCounterBased:
              DemDebounceCounterDecrementStepSize = 1
              DemDebounceCounterIncrementStepSize = 1
              DemDebounceCounterJumpDown = true
              DemDebounceCounterJumpDownValue = 0
              DemDebounceCounterJumpUp = true
              DemDebounceCounterJumpUpValue = 0
      DTCClass_DTC_0x902001 (DemDTCClass): DemDTCSeverity=DEM_DTC_SEV_NO_SEVERITY, DemUdsDTC=9445377
      DTC_0x902001 (DemEventParameter): DemEventKind=DEM_EVENT_KIND_SWC, DemDTCClassRef=DTCClass_DTC_0x902001, DemExtendedDataClassRef=ExtendedDataClass_83dcefb7
        DemEventClass:
          DemAgingAllowed = false
          DemAgingCycleCounterThreshold = 0
          DemEventDestination = DEM_DTC_ORIGIN_PRIMARY_MEMORY
          DemEventPriority = 2
          DemEventSignificance = DEM_EVENT_SIGNIFICANCE_FAULT
          DemEventFailureCycleCounterThreshold = 0
          DemAgingCycleRef = PowerCycle
          DemOperationCycleRef = PowerCycle
          DemDebounceAlgorithmClass
            DemDebounceCounterBased:
              DemDebounceCounterDecrementStepSize = 1
              DemDebounceCounterIncrementStepSize = 1
              DemDebounceCounterJumpDown = true
              DemDebounceCounterJumpDownValue = 0
              DemDebounceCounterJumpUp = true
              DemDebounceCounterJumpUpValue = 0
      DTCClass_DTC_0x902101 (DemDTCClass): DemDTCSeverity=DEM_DTC_SEV_NO_SEVERITY, DemUdsDTC=9445633
      DTC_0x902101 (DemEventParameter): DemEventKind=DEM_EVENT_KIND_SWC, DemDTCClassRef=DTCClass_DTC_0x902101, DemExtendedDataClassRef=ExtendedDataClass_83dcefb7
        DemEventClass:
          DemAgingAllowed = false
          DemAgingCycleCounterThreshold = 0
          DemEventDestination = DEM_DTC_ORIGIN_PRIMARY_MEMORY
          DemEventPriority = 2
          DemEventSignificance = DEM_EVENT_SIGNIFICANCE_FAULT
          DemEventFailureCycleCounterThreshold = 0
          DemAgingCycleRef = PowerCycle
          DemOperationCycleRef = PowerCycle
          DemDebounceAlgorithmClass
            DemDebounceCounterBased:
              DemDebounceCounterDecrementStepSize = 1
              DemDebounceCounterIncrementStepSize = 1
              DemDebounceCounterJumpDown = true
              DemDebounceCounterJumpDownValue = 0
              DemDebounceCounterJumpUp = true
              DemDebounceCounterJumpUpValue = 0
    DemGeneral:
      DemAgingCycleCounterProcessing = DEM_PROCESS_AGINGCTR_INTERN
      DemDebounceCounterBasedSupport = true
      DemPTOSupport = false
      DemDtcStatusAvailabilityMask = 0
      DemTypeOfFreezeFrameRecordNumeration = DEM_FF_RECNUM_CALCULATED
      ExtendedDataClass_83dcefb7 (DemExtendedDataClass): DemExtendedDataRecordClassRef=ExtendedDataRecord0x01
      ExtendedDataRecord0x01 (DemExtendedDataRecordClass):
        DemExtendedDataRecordNumber = 1
        DemExtendedDataRecordUpdate = DEM_UPDATE_RECORD_NO
        DemDataClassRef = ExtendedDataRecord0x01_ExtendedDataRecord
        DemDataClassRef = ExtendedDataRecord0x01_ExtendedDataRecord_1
      PowerCycle (DemOperationCycle): DemOperationCycleType=DEM_OPCYC_POWER
      ExtendedDataRecord0x01_ExtendedDataRecord_1 (DemDataClass): DemDataElementDataSize=1, DemDataElementInternalData=DEM_OCCCTR, DemDataElementUsePort=USE_DATA_INTERNAL
      ExtendedDataRecord0x01_ExtendedDataRecord (DemDataClass): DemDataElementDataSize=1, DemDataElementInternalData=DEM_PRIORITY, DemDataElementUsePort=USE_DATA_INTERNAL
