AUTOSAR XML (schema 00048)
package /ActiveEcuC
  ecuc value collection ActiveEcuC: ecu-extract=SYSTEM
    ecuc-values:
      vBRS
      vBaseEnv
      Os
      EcuC
      vSet
      EcuM
      Rte
      Mcu
      Det
      Dem
      NvM
      MemIf
      Ea
      Eep
      BswM
      Port
      Spi
      Crc
      Dio
      Icu
      Adc
      Com
      CanNm
      PduR
      CanSM
      Dcm
      CanTp
      Nm
      Can
      CanIf
      ComM
      CanTrcv
      Pwm
      Wdg
      WdgIf
      Gpt
      CddComIf
      CddComTp
      vLinkGen
      I2c
      Fls
      CddUart
