[part 2 of 3: package /ActiveEcuC]
AUTOSAR XML (schema 00048)
package /ActiveEcuC  (continued)
  module config Rte: implementation-config-variant=VARIANT-POST-BUILD-SELECTABLE, module-description=Rte_Impl  (continued)
    DemSatellite_0_EcuSwComposition (RteSwComponentInstance): RteSoftwareComponentInstanceRef=DemSatellite_0  (continued)
      969 x RteEventToTaskMapping, all with RteImmediateRestart=false:  (continued)
        OpEventGetEventFreezeFrameDataEx_GetEventFreezeFrameDataEx_Event_DTC_0x901c01: RteEventRef=OpEventGetEventFreezeFrameDataEx_GetEventFreezeFrameDataEx_Event_DTC_0x901c01
        OpEventResetEventDebounceStatus_ResetEventDebounceStatus_Event_DTC_0x902001: RteEventRef=OpEventResetEventDebounceStatus_ResetEventDebounceStatus_Event_DTC_0x902001
        OpEventSetEventStatus_SetEventStatus_Event_DTC_0x901901: RteEventRef=OpEventSetEventStatus_SetEventStatus_Event_DTC_0x901901
        OpEventGetEventStatus_GetEventStatus_EvtInfo_DTC_0x901301: RteEventRef=OpEventGetEventStatus_GetEventStatus_EvtInfo_DTC_0x901301
        OpEventGetEventFreezeFrameDataEx_GetEventFreezeFrameDataEx_Event_DTC_0x901401: RteEventRef=OpEventGetEventFreezeFrameDataEx_GetEventFreezeFrameDataEx_Event_DTC_0x901401
        OpEventGetDTCOfEvent_GetDTCOfEvent_EvtInfo_DTC_0x901e01: RteEventRef=OpEventGetDTCOfEvent_GetDTCOfEvent_EvtInfo_DTC_0x901e01
        OpEventGetFaultDetectionCounter_GetFaultDetectionCounter_Event_DTC_0x902001: RteEventRef=OpEventGetFaultDetectionCounter_GetFaultDetectionCounter_Event_DTC_0x902001
        OpEventGetEventFailed_GetEventFailed_Event_DTC_0x901d01: RteEventRef=OpEventGetEventFailed_GetEventFailed_Event_DTC_0x901d01
        OpEventGetEventFailed_GetEventFailed_EvtInfo_DTC_0x901d01: RteEventRef=OpEventGetEventFailed_GetEventFailed_EvtInfo_DTC_0x901d01
        OpEventGetEventTested_GetEventTested_Event_DTC_0x901501: RteEventRef=OpEventGetEventTested_GetEventTested_Event_DTC_0x901501
        OpEventResetEventDebounceStatus_ResetEventDebounceStatus_Event_DTC_0x901e01: RteEventRef=OpEventResetEventDebounceStatus_ResetEventDebounceStatus_Event_DTC_0x901e01
        OpEventGetEventExtendedDataRecordEx_GetEventExtendedDataRecordEx_Event_DTC_0x901c01: RteEventRef=OpEventGetEventExtendedDataRecordEx_GetEventExtendedDataRecordEx_Event_DTC_0x901c01
        OpEventGetEventEnableCondition_GetEventEnableCondition_EvtInfo_DTC_0x902001: RteEventRef=OpEventGetEventEnableCondition_GetEventEnableCondition_EvtInfo_DTC_0x902001
        OpEventGetEventEnableCondition_GetEventEnableCondition_EvtInfo_DTC_0x901c01: RteEventRef=OpEventGetEventEnableCondition_GetEventEnableCondition_EvtInfo_DTC_0x901c01
        OpEventGetFaultDetectionCounter_GetFaultDetectionCounter_Event_DTC_0x901901: RteEventRef=OpEventGetFaultDetectionCounter_GetFaultDetectionCounter_Event_DTC_0x901901
        OpEventGetDTCOfEvent_GetDTCOfEvent_EvtInfo_DTC_0x901701: RteEventRef=OpEventGetDTCOfEvent_GetDTCOfEvent_EvtInfo_DTC_0x901701
        OpEventGetEventStatus_GetEventStatus_Event_DTC_0x902101: RteEventRef=OpEventGetEventStatus_GetEventStatus_Event_DTC_0x902101
        OpEventGetEventFreezeFrameDataEx_GetEventFreezeFrameDataEx_EvtInfo_DTC_0x901f01: RteEventRef=OpEventGetEventFreezeFrameDataEx_GetEventFreezeFrameDataEx_EvtInfo_DTC_0x901f01
        OpEventResetEventStatus_ResetEventStatus_Event_DTC_0x901b01: RteEventRef=OpEventResetEventStatus_ResetEventStatus_Event_DTC_0x901b01
        OpEventGetEventUdsStatus_GetEventUdsStatus_EvtInfo_DTC_0x902001: RteEventRef=OpEventGetEventUdsStatus_GetEventUdsStatus_EvtInfo_DTC_0x902001
        OpEventGetDTCOfEvent_GetDTCOfEvent_EvtInfo_DTC_0x901101: RteEventRef=OpEventGetDTCOfEvent_GetDTCOfEvent_EvtInfo_DTC_0x901101
        OpEventGetEventFreezeFrameDataEx_GetEventFreezeFrameDataEx_Event_DTC_0x901801: RteEventRef=OpEventGetEventFreezeFrameDataEx_GetEventFreezeFrameDataEx_Event_DTC_0x901801
        OpEventSetEventStatus_SetEventStatus_Event_DTC_0x901b01: RteEventRef=OpEventSetEventStatus_SetEventStatus_Event_DTC_0x901b01
        OpEventGetMonitorStatus_GetMonitorStatus_EvtInfo_DTC_0x902001: RteEventRef=OpEventGetMonitorStatus_GetMonitorStatus_EvtInfo_DTC_0x902001
        OpEventGetEventStatus_GetEventStatus_Event_DTC_0x901f01: RteEventRef=OpEventGetEventStatus_GetEventStatus_Event_DTC_0x901f01
        OpEventResetEventStatus_ResetEventStatus_Event_DTC_0x901801: RteEventRef=OpEventResetEventStatus_ResetEventStatus_Event_DTC_0x901801
        OpEventGetEventFailed_GetEventFailed_EvtInfo_DTC_0x901901: RteEventRef=OpEventGetEventFailed_GetEventFailed_EvtInfo_DTC_0x901901
        OpEventGetFaultDetectionCounter_GetFaultDetectionCounter_Event_DTC_0x901801: RteEventRef=OpEventGetFaultDetectionCounter_GetFaultDetectionCounter_Event_DTC_0x901801
        OpEventGetDebouncingOfEvent_GetDebouncingOfEvent_EvtInfo_DTC_0x901101: RteEventRef=OpEventGetDebouncingOfEvent_GetDebouncingOfEvent_EvtInfo_DTC_0x901101
        OpEventGetEventStatus_GetEventStatus_Event_DTC_0x902001: RteEventRef=OpEventGetEventStatus_GetEventStatus_Event_DTC_0x902001
        OpEventGetEventStatus_GetEventStatus_EvtInfo_DTC_0x901401: RteEventRef=OpEventGetEventStatus_GetEventStatus_EvtInfo_DTC_0x901401
        OpEventGetEventUdsStatus_GetEventUdsStatus_Event_DTC_0x901c01: RteEventRef=OpEventGetEventUdsStatus_GetEventUdsStatus_Event_DTC_0x901c01
        OpEventGetEventFreezeFrameDataEx_GetEventFreezeFrameDataEx_Event_DTC_0x901101: RteEventRef=OpEventGetEventFreezeFrameDataEx_GetEventFreezeFrameDataEx_Event_DTC_0x901101
        OpEventGetMonitorStatus_GetMonitorStatus_EvtInfo_DTC_0x901201: RteEventRef=OpEventGetMonitorStatus_GetMonitorStatus_EvtInfo_DTC_0x901201
        OpEventGetEventStatus_GetEventStatus_Event_DTC_0x901c01: RteEventRef=OpEventGetEventStatus_GetEventStatus_Event_DTC_0x901c01
        OpEventGetEventExtendedDataRecordEx_GetEventExtendedDataRecordEx_EvtInfo_DTC_0x902001: RteEventRef=OpEventGetEventExtendedDataRecordEx_GetEventExtendedDataRecordEx_EvtInfo_DTC_0x902001
        OpEventGetFaultDetectionCounter_GetFaultDetectionCounter_EvtInfo_DTC_0x902001: RteEventRef=OpEventGetFaultDetectionCounter_GetFaultDetectionCounter_EvtInfo_DTC_0x902001
        OpEventGetEventUdsStatus_GetEventUdsStatus_Event_DTC_0x901b01: RteEventRef=OpEventGetEventUdsStatus_GetEventUdsStatus_Event_DTC_0x901b01
        OpEventResetEventDebounceStatus_ResetEventDebounceStatus_Event_DTC_0x901101: RteEventRef=OpEventResetEventDebounceStatus_ResetEventDebounceStatus_Event_DTC_0x901101
        OpEventGetFaultDetectionCounter_GetFaultDetectionCounter_EvtInfo_DTC_0x901601: RteEventRef=OpEventGetFaultDetectionCounter_GetFaultDetectionCounter_EvtInfo_DTC_0x901601
        OpEventGetEventExtendedDataRecordEx_GetEventExtendedDataRecordEx_EvtInfo_DTC_0x901a01: RteEventRef=OpEventGetEventExtendedDataRecordEx_GetEventExtendedDataRecordEx_EvtInfo_DTC_0x901a01
        OpEventGetFaultDetectionCounter_GetFaultDetectionCounter_EvtInfo_DTC_0x901301: RteEventRef=OpEventGetFaultDetectionCounter_GetFaultDetectionCounter_EvtInfo_DTC_0x901301
        OpEventGetEventFreezeFrameDataEx_GetEventFreezeFrameDataEx_EvtInfo_DTC_0x901201: RteEventRef=OpEventGetEventFreezeFrameDataEx_GetEventFreezeFrameDataEx_EvtInfo_DTC_0x901201
        OpEventGetMonitorStatus_GetMonitorStatus_EvtInfo_DTC_0x902101: RteEventRef=OpEventGetMonitorStatus_GetMonitorStatus_EvtInfo_DTC_0x902101
        OpEventGetEventUdsStatus_GetEventUdsStatus_EvtInfo_DTC_0x901301: RteEventRef=OpEventGetEventUdsStatus_GetEventUdsStatus_EvtInfo_DTC_0x901301
        OpEventGetEventFreezeFrameDataEx_GetEventFreezeFrameDataEx_EvtInfo_DTC_0x901101: RteEventRef=OpEventGetEventFreezeFrameDataEx_GetEventFreezeFrameDataEx_EvtInfo_DTC_0x901101
        OpEventGetDTCOfEvent_GetDTCOfEvent_EvtInfo_DTC_0x901f01: RteEventRef=OpEventGetDTCOfEvent_GetDTCOfEvent_EvtInfo_DTC_0x901f01
        OpEventSetEventStatus_SetEventStatus_Event_DTC_0x901201: RteEventRef=OpEventSetEventStatus_SetEventStatus_Event_DTC_0x901201
        OpEventGetDebouncingOfEvent_GetDebouncingOfEvent_EvtInfo_DTC_0x901f01: RteEventRef=OpEventGetDebouncingOfEvent_GetDebouncingOfEvent_EvtInfo_DTC_0x901f01
        OpEventGetEventExtendedDataRecordEx_GetEventExtendedDataRecordEx_Event_DTC_0x901701: RteEventRef=OpEventGetEventExtendedDataRecordEx_GetEventExtendedDataRecordEx_Event_DTC_0x901701
        OpEventGetEventUdsStatus_GetEventUdsStatus_EvtInfo_DTC_0x901a01: RteEventRef=OpEventGetEventUdsStatus_GetEventUdsStatus_EvtInfo_DTC_0x901a01
        OpEventSetEventStatus_SetEventStatus_Event_DTC_0x901f01: RteEventRef=OpEventSetEventStatus_SetEventStatus_Event_DTC_0x901f01
        OpEventGetEventStatus_GetEventStatus_Event_DTC_0x901e01: RteEventRef=OpEventGetEventStatus_GetEventStatus_Event_DTC_0x901e01
        OpEventGetEventFailed_GetEventFailed_EvtInfo_DTC_0x901501: RteEventRef=OpEventGetEventFailed_GetEventFailed_EvtInfo_DTC_0x901501
        OpEventGetFaultDetectionCounter_GetFaultDetectionCounter_Event_DTC_0x901301: RteEventRef=OpEventGetFaultDetectionCounter_GetFaultDetectionCounter_Event_DTC_0x901301
        OpEventGetEventStatus_GetEventStatus_EvtInfo_DTC_0x902001: RteEventRef=OpEventGetEventStatus_GetEventStatus_EvtInfo_DTC_0x902001
        OpEventGetEventExtendedDataRecordEx_GetEventExtendedDataRecordEx_Event_DTC_0x901d01: RteEventRef=OpEventGetEventExtendedDataRecordEx_GetEventExtendedDataRecordEx_Event_DTC_0x901d01
        OpEventGetDebouncingOfEvent_GetDebouncingOfEvent_EvtInfo_DTC_0x901001: RteEventRef=OpEventGetDebouncingOfEvent_GetDebouncingOfEvent_EvtInfo_DTC_0x901001
        OpEventGetDTCOfEvent_GetDTCOfEvent_EvtInfo_DTC_0x901301: RteEventRef=OpEventGetDTCOfEvent_GetDTCOfEvent_EvtInfo_DTC_0x901301
        OpEventSetEventStatus_SetEventStatus_Event_DTC_0x902101: RteEventRef=OpEventSetEventStatus_SetEventStatus_Event_DTC_0x902101
        OpEventGetEventUdsStatus_GetEventUdsStatus_EvtInfo_DTC_0x901601: RteEventRef=OpEventGetEventUdsStatus_GetEventUdsStatus_EvtInfo_DTC_0x901601
        OpEventGetDebouncingOfEvent_GetDebouncingOfEvent_EvtInfo_DTC_0x901b01: RteEventRef=OpEventGetDebouncingOfEvent_GetDebouncingOfEvent_EvtInfo_DTC_0x901b01
        OpEventResetEventDebounceStatus_ResetEventDebounceStatus_Event_DTC_0x901f01: RteEventRef=OpEventResetEventDebounceStatus_ResetEventDebounceStatus_Event_DTC_0x901f01
        OpEventGetEventFreezeFrameDataEx_GetEventFreezeFrameDataEx_EvtInfo_DTC_0x901d01: RteEventRef=OpEventGetEventFreezeFrameDataEx_GetEventFreezeFrameDataEx_EvtInfo_DTC_0x901d01
        OpEventGetEventTested_GetEventTested_Event_DTC_0x901401: RteEventRef=OpEventGetEventTested_GetEventTested_Event_DTC_0x901401
        OpEventGetFaultDetectionCounter_GetFaultDetectionCounter_EvtInfo_DTC_0x901801: RteEventRef=OpEventGetFaultDetectionCounter_GetFaultDetectionCounter_EvtInfo_DTC_0x901801
        OpEventSetEventStatus_SetEventStatus_Event_DTC_0x901801: RteEventRef=OpEventSetEventStatus_SetEventStatus_Event_DTC_0x901801
        OpEventGetEventEnableCondition_GetEventEnableCondition_EvtInfo_DTC_0x901101: RteEventRef=OpEventGetEventEnableCondition_GetEventEnableCondition_EvtInfo_DTC_0x901101
        OpEventGetDebouncingOfEvent_GetDebouncingOfEvent_EvtInfo_DTC_0x901e01: RteEventRef=OpEventGetDebouncingOfEvent_GetDebouncingOfEvent_EvtInfo_DTC_0x901e01
        OpEventGetEventTested_GetEventTested_EvtInfo_DTC_0x901601: RteEventRef=OpEventGetEventTested_GetEventTested_EvtInfo_DTC_0x901601
        OpEventGetEventFreezeFrameDataEx_GetEventFreezeFrameDataEx_EvtInfo_DTC_0x901a01: RteEventRef=OpEventGetEventFreezeFrameDataEx_GetEventFreezeFrameDataEx_EvtInfo_DTC_0x901a01
        OpEventGetEventEnableCondition_GetEventEnableCondition_EvtInfo_DTC_0x901401: RteEventRef=OpEventGetEventEnableCondition_GetEventEnableCondition_EvtInfo_DTC_0x901401
        OpEventGetMonitorStatus_GetMonitorStatus_EvtInfo_DTC_0x901f01: RteEventRef=OpEventGetMonitorStatus_GetMonitorStatus_EvtInfo_DTC_0x901f01
        OpEventGetDebouncingOfEvent_GetDebouncingOfEvent_EvtInfo_DTC_0x902101: RteEventRef=OpEventGetDebouncingOfEvent_GetDebouncingOfEvent_EvtInfo_DTC_0x902101
        OpEventGetEventFreezeFrameDataEx_GetEventFreezeFrameDataEx_Event_DTC_0x901601: RteEventRef=OpEventGetEventFreezeFrameDataEx_GetEventFreezeFrameDataEx_Event_DTC_0x901601
        OpEventGetEventFailed_GetEventFailed_Event_DTC_0x901201: RteEventRef=OpEventGetEventFailed_GetEventFailed_Event_DTC_0x901201
        OpEventGetEventStatus_GetEventStatus_EvtInfo_DTC_0x901501: RteEventRef=OpEventGetEventStatus_GetEventStatus_EvtInfo_DTC_0x901501
        OpEventGetMonitorStatus_GetMonitorStatus_EvtInfo_DTC_0x901b01: RteEventRef=OpEventGetMonitorStatus_GetMonitorStatus_EvtInfo_DTC_0x901b01
        OpEventGetEventTested_GetEventTested_Event_DTC_0x901101: RteEventRef=OpEventGetEventTested_GetEventTested_Event_DTC_0x901101
        OpEventGetEventTested_GetEventTested_EvtInfo_DTC_0x901301: RteEventRef=OpEventGetEventTested_GetEventTested_EvtInfo_DTC_0x901301
        OpEventGetEventFreezeFrameDataEx_GetEventFreezeFrameDataEx_Event_DTC_0x901901: RteEventRef=OpEventGetEventFreezeFrameDataEx_GetEventFreezeFrameDataEx_Event_DTC_0x901901
        OpEventGetEventExtendedDataRecordEx_GetEventExtendedDataRecordEx_Event_DTC_0x901f01: RteEventRef=OpEventGetEventExtendedDataRecordEx_GetEventExtendedDataRecordEx_Event_DTC_0x901f01
        OpEventGetEventFailed_GetEventFailed_Event_DTC_0x901b01: RteEventRef=OpEventGetEventFailed_GetEventFailed_Event_DTC_0x901b01
        OpEventGetEventFreezeFrameDataEx_GetEventFreezeFrameDataEx_Event_DTC_0x901001: RteEventRef=OpEventGetEventFreezeFrameDataEx_GetEventFreezeFrameDataEx_Event_DTC_0x901001
        OpEventGetEventStatus_GetEventStatus_Event_DTC_0x901801: RteEventRef=OpEventGetEventStatus_GetEventStatus_Event_DTC_0x901801
        OpEventGetDTCOfEvent_GetDTCOfEvent_Event_DTC_0x901101: RteEventRef=OpEventGetDTCOfEvent_GetDTCOfEvent_Event_DTC_0x901101
        OpEventGetFaultDetectionCounter_GetFaultDetectionCounter_EvtInfo_DTC_0x901201: RteEventRef=OpEventGetFaultDetectionCounter_GetFaultDetectionCounter_EvtInfo_DTC_0x901201
        OpEventGetEventStatus_GetEventStatus_Event_DTC_0x901a01: RteEventRef=OpEventGetEventStatus_GetEventStatus_Event_DTC_0x901a01
        OpEventGetFaultDetectionCounter_GetFaultDetectionCounter_EvtInfo_DTC_0x901401: RteEventRef=OpEventGetFaultDetectionCounter_GetFaultDetectionCounter_EvtInfo_DTC_0x901401
        OpEventGetEventEnableCondition_GetEventEnableCondition_EvtInfo_DTC_0x902101: RteEventRef=OpEventGetEventEnableCondition_GetEventEnableCondition_EvtInfo_DTC_0x902101
        OpEventGetEventExtendedDataRecordEx_GetEventExtendedDataRecordEx_EvtInfo_DTC_0x902101: RteEventRef=OpEventGetEventExtendedDataRecordEx_GetEventExtendedDataRecordEx_EvtInfo_DTC_0x902101
        OpEventGetEventUdsStatus_GetEventUdsStatus_EvtInfo_DTC_0x901801: RteEventRef=OpEventGetEventUdsStatus_GetEventUdsStatus_EvtInfo_DTC_0x901801
        OpEventGetDTCOfEvent_GetDTCOfEvent_Event_DTC_0x901501: RteEventRef=OpEventGetDTCOfEvent_GetDTCOfEvent_Event_DTC_0x901501
        OpEventGetEventFailed_GetEventFailed_Event_DTC_0x901c01: RteEventRef=OpEventGetEventFailed_GetEventFailed_Event_DTC_0x901c01
        OpEventResetEventDebounceStatus_ResetEventDebounceStatus_Event_DTC_0x901701: RteEventRef=OpEventResetEventDebounceStatus_ResetEventDebounceStatus_Event_DTC_0x901701
        OpEventSetEventStatus_SetEventStatus_Event_DTC_0x901401: RteEventRef=OpEventSetEventStatus_SetEventStatus_Event_DTC_0x901401
        OpEventGetEventFreezeFrameDataEx_GetEventFreezeFrameDataEx_EvtInfo_DTC_0x901901: RteEventRef=OpEventGetEventFreezeFrameDataEx_GetEventFreezeFrameDataEx_EvtInfo_DTC_0x901901
        OpEventGetEventStatus_GetEventStatus_EvtInfo_DTC_0x901f01: RteEventRef=OpEventGetEventStatus_GetEventStatus_EvtInfo_DTC_0x901f01
        OpEventGetDTCOfEvent_GetDTCOfEvent_Event_DTC_0x901001: RteEventRef=OpEventGetDTCOfEvent_GetDTCOfEvent_Event_DTC_0x901001
        OpEventGetEventFailed_GetEventFailed_EvtInfo_DTC_0x901701: RteEventRef=OpEventGetEventFailed_GetEventFailed_EvtInfo_DTC_0x901701
        OpEventGetDTCOfEvent_GetDTCOfEvent_Event_DTC_0x901b01: RteEventRef=OpEventGetDTCOfEvent_GetDTCOfEvent_Event_DTC_0x901b01
        OpEventGetEventFreezeFrameDataEx_GetEventFreezeFrameDataEx_EvtInfo_DTC_0x901601: RteEventRef=OpEventGetEventFreezeFrameDataEx_GetEventFreezeFrameDataEx_EvtInfo_DTC_0x901601
        OpEventGetEventStatus_GetEventStatus_Event_DTC_0x901101: RteEventRef=OpEventGetEventStatus_GetEventStatus_Event_DTC_0x901101
        OpEventResetEventStatus_ResetEventStatus_Event_DTC_0x901201: RteEventRef=OpEventResetEventStatus_ResetEventStatus_Event_DTC_0x901201
        OpEventGetMonitorStatus_GetMonitorStatus_EvtInfo_DTC_0x901601: RteEventRef=OpEventGetMonitorStatus_GetMonitorStatus_EvtInfo_DTC_0x901601
        OpEventGetEventExtendedDataRecordEx_GetEventExtendedDataRecordEx_Event_DTC_0x902001: RteEventRef=OpEventGetEventExtendedDataRecordEx_GetEventExtendedDataRecordEx_Event_DTC_0x902001
        OpEventGetEventUdsStatus_GetEventUdsStatus_Event_DTC_0x901701: RteEventRef=OpEventGetEventUdsStatus_GetEventUdsStatus_Event_DTC_0x901701
        OpEventGetFaultDetectionCounter_GetFaultDetectionCounter_EvtInfo_DTC_0x901a01: RteEventRef=OpEventGetFaultDetectionCounter_GetFaultDetectionCounter_EvtInfo_DTC_0x901a01
        OpEventGetEventExtendedDataRecordEx_GetEventExtendedDataRecordEx_EvtInfo_DTC_0x901801: RteEventRef=OpEventGetEventExtendedDataRecordEx_GetEventExtendedDataRecordEx_EvtInfo_DTC_0x901801
        OpEventGetEventFailed_GetEventFailed_EvtInfo_DTC_0x901301: RteEventRef=OpEventGetEventFailed_GetEventFailed_EvtInfo_DTC_0x901301
        OpEventGetEventTested_GetEventTested_EvtInfo_DTC_0x901701: RteEventRef=OpEventGetEventTested_GetEventTested_EvtInfo_DTC_0x901701
        OpEventGetEventFailed_GetEventFailed_Event_DTC_0x901101: RteEventRef=OpEventGetEventFailed_GetEventFailed_Event_DTC_0x901101
        OpEventGetEventTested_GetEventTested_Event_DTC_0x901a01: RteEventRef=OpEventGetEventTested_GetEventTested_Event_DTC_0x901a01
        OpEventGetFaultDetectionCounter_GetFaultDetectionCounter_EvtInfo_DTC_0x901b01: RteEventRef=OpEventGetFaultDetectionCounter_GetFaultDetectionCounter_EvtInfo_DTC_0x901b01
        OpEventGetEventStatus_GetEventStatus_EvtInfo_DTC_0x901901: RteEventRef=OpEventGetEventStatus_GetEventStatus_EvtInfo_DTC_0x901901
        OpEventGetEventFreezeFrameDataEx_GetEventFreezeFrameDataEx_Event_DTC_0x901d01: RteEventRef=OpEventGetEventFreezeFrameDataEx_GetEventFreezeFrameDataEx_Event_DTC_0x901d01
        OpEventGetEventUdsStatus_GetEventUdsStatus_EvtInfo_DTC_0x901401: RteEventRef=OpEventGetEventUdsStatus_GetEventUdsStatus_EvtInfo_DTC_0x901401
        OpEventGetEventFailed_GetEventFailed_EvtInfo_DTC_0x901801: RteEventRef=OpEventGetEventFailed_GetEventFailed_EvtInfo_DTC_0x901801
        OpEventGetDebouncingOfEvent_GetDebouncingOfEvent_EvtInfo_DTC_0x902001: RteEventRef=OpEventGetDebouncingOfEvent_GetDebouncingOfEvent_EvtInfo_DTC_0x902001
        OpEventGetEventStatus_GetEventStatus_EvtInfo_DTC_0x901201: RteEventRef=OpEventGetEventStatus_GetEventStatus_EvtInfo_DTC_0x901201
        OpEventGetEventTested_GetEventTested_EvtInfo_DTC_0x901d01: RteEventRef=OpEventGetEventTested_GetEventTested_EvtInfo_DTC_0x901d01
        OpEventGetFaultDetectionCounter_GetFaultDetectionCounter_Event_DTC_0x901401: RteEventRef=OpEventGetFaultDetectionCounter_GetFaultDetectionCounter_Event_DTC_0x901401
        OpEventGetEventFreezeFrameDataEx_GetEventFreezeFrameDataEx_Event_DTC_0x901701: RteEventRef=OpEventGetEventFreezeFrameDataEx_GetEventFreezeFrameDataEx_Event_DTC_0x901701
        OpEventGetEventStatus_GetEventStatus_Event_DTC_0x901201: RteEventRef=OpEventGetEventStatus_GetEventStatus_Event_DTC_0x901201
        OpEventGetDebouncingOfEvent_GetDebouncingOfEvent_EvtInfo_DTC_0x901601: RteEventRef=OpEventGetDebouncingOfEvent_GetDebouncingOfEvent_EvtInfo_DTC_0x901601
        OpEventGetDTCOfEvent_GetDTCOfEvent_EvtInfo_DTC_0x901801: RteEventRef=OpEventGetDTCOfEvent_GetDTCOfEvent_EvtInfo_DTC_0x901801
        OpEventGetEventFreezeFrameDataEx_GetEventFreezeFrameDataEx_Event_DTC_0x901201: RteEventRef=OpEventGetEventFreezeFrameDataEx_GetEventFreezeFrameDataEx_Event_DTC_0x901201
        OpEventGetEventUdsStatus_GetEventUdsStatus_Event_DTC_0x901901: RteEventRef=OpEventGetEventUdsStatus_GetEventUdsStatus_Event_DTC_0x901901
        OpEventGetDTCOfEvent_GetDTCOfEvent_EvtInfo_DTC_0x902001: RteEventRef=OpEventGetDTCOfEvent_GetDTCOfEvent_EvtInfo_DTC_0x902001
        OpEventGetDebouncingOfEvent_GetDebouncingOfEvent_EvtInfo_DTC_0x901901: RteEventRef=OpEventGetDebouncingOfEvent_GetDebouncingOfEvent_EvtInfo_DTC_0x901901
        OpEventGetEventExtendedDataRecordEx_GetEventExtendedDataRecordEx_EvtInfo_DTC_0x901c01: RteEventRef=OpEventGetEventExtendedDataRecordEx_GetEventExtendedDataRecordEx_EvtInfo_DTC_0x901c01
        OpEventGetEventFailed_GetEventFailed_EvtInfo_DTC_0x901601: RteEventRef=OpEventGetEventFailed_GetEventFailed_EvtInfo_DTC_0x901601
        OpEventGetEventFreezeFrameDataEx_GetEventFreezeFrameDataEx_EvtInfo_DTC_0x901c01: RteEventRef=OpEventGetEventFreezeFrameDataEx_GetEventFreezeFrameDataEx_EvtInfo_DTC_0x901c01
        OpEventGetEventExtendedDataRecordEx_GetEventExtendedDataRecordEx_EvtInfo_DTC_0x901601: RteEventRef=OpEventGetEventExtendedDataRecordEx_GetEventExtendedDataRecordEx_EvtInfo_DTC_0x901601
        OpEventGetEventStatus_GetEventStatus_Event_DTC_0x901601: RteEventRef=OpEventGetEventStatus_GetEventStatus_Event_DTC_0x901601
        OpEventGetEventExtendedDataRecordEx_GetEventExtendedDataRecordEx_Event_DTC_0x902101: RteEventRef=OpEventGetEventExtendedDataRecordEx_GetEventExtendedDataRecordEx_Event_DTC_0x902101
        OpEventGetEventStatus_GetEventStatus_EvtInfo_DTC_0x901601: RteEventRef=OpEventGetEventStatus_GetEventStatus_EvtInfo_DTC_0x901601
        OpEventGetEventFreezeFrameDataEx_GetEventFreezeFrameDataEx_Event_DTC_0x901a01: RteEventRef=OpEventGetEventFreezeFrameDataEx_GetEventFreezeFrameDataEx_Event_DTC_0x901a01
        OpEventGetEventUdsStatus_GetEventUdsStatus_EvtInfo_DTC_0x901901: RteEventRef=OpEventGetEventUdsStatus_GetEventUdsStatus_EvtInfo_DTC_0x901901
        OpEventGetEventFreezeFrameDataEx_GetEventFreezeFrameDataEx_EvtInfo_DTC_0x902101: RteEventRef=OpEventGetEventFreezeFrameDataEx_GetEventFreezeFrameDataEx_EvtInfo_DTC_0x902101
        OpEventGetEventEnableCondition_GetEventEnableCondition_EvtInfo_DTC_0x901d01: RteEventRef=OpEventGetEventEnableCondition_GetEventEnableCondition_EvtInfo_DTC_0x901d01
        OpEventResetEventDebounceStatus_ResetEventDebounceStatus_Event_DTC_0x901301: RteEventRef=OpEventResetEventDebounceStatus_ResetEventDebounceStatus_Event_DTC_0x901301
        OpEventGetDebouncingOfEvent_GetDebouncingOfEvent_EvtInfo_DTC_0x901501: RteEventRef=OpEventGetDebouncingOfEvent_GetDebouncingOfEvent_EvtInfo_DTC_0x901501
        OpEventGetDebouncingOfEvent_GetDebouncingOfEvent_EvtInfo_DTC_0x901401: RteEventRef=OpEventGetDebouncingOfEvent_GetDebouncingOfEvent_EvtInfo_DTC_0x901401
        OpEventGetEventTested_GetEventTested_EvtInfo_DTC_0x901e01: RteEventRef=OpEventGetEventTested_GetEventTested_EvtInfo_DTC_0x901e01
        OpEventGetEventUdsStatus_GetEventUdsStatus_Event_DTC_0x901501: RteEventRef=OpEventGetEventUdsStatus_GetEventUdsStatus_Event_DTC_0x901501
        OpEventGetEventFailed_GetEventFailed_Event_DTC_0x901a01: RteEventRef=OpEventGetEventFailed_GetEventFailed_Event_DTC_0x901a01
        OpEventGetEventFailed_GetEventFailed_EvtInfo_DTC_0x901e01: RteEventRef=OpEventGetEventFailed_GetEventFailed_EvtInfo_DTC_0x901e01
        OpEventResetEventDebounceStatus_ResetEventDebounceStatus_Event_DTC_0x901b01: RteEventRef=OpEventResetEventDebounceStatus_ResetEventDebounceStatus_Event_DTC_0x901b01
        OpEventGetDebouncingOfEvent_GetDebouncingOfEvent_EvtInfo_DTC_0x901301: RteEventRef=OpEventGetDebouncingOfEvent_GetDebouncingOfEvent_EvtInfo_DTC_0x901301
        OpEventGetEventEnableCondition_GetEventEnableCondition_EvtInfo_DTC_0x901f01: RteEventRef=OpEventGetEventEnableCondition_GetEventEnableCondition_EvtInfo_DTC_0x901f01
        OpEventGetEventFailed_GetEventFailed_Event_DTC_0x901e01: RteEventRef=OpEventGetEventFailed_GetEventFailed_Event_DTC_0x901e01
        OpEventGetFaultDetectionCounter_GetFaultDetectionCounter_Event_DTC_0x902101: RteEventRef=OpEventGetFaultDetectionCounter_GetFaultDetectionCounter_Event_DTC_0x902101
        OpEventGetEventExtendedDataRecordEx_GetEventExtendedDataRecordEx_Event_DTC_0x901601: RteEventRef=OpEventGetEventExtendedDataRecordEx_GetEventExtendedDataRecordEx_Event_DTC_0x901601
        OpEventResetEventStatus_ResetEventStatus_Event_DTC_0x901701: RteEventRef=OpEventResetEventStatus_ResetEventStatus_Event_DTC_0x901701
        OpEventGetEventUdsStatus_GetEventUdsStatus_Event_DTC_0x902101: RteEventRef=OpEventGetEventUdsStatus_GetEventUdsStatus_Event_DTC_0x902101
        OpEventGetEventStatus_GetEventStatus_Event_DTC_0x901d01: RteEventRef=OpEventGetEventStatus_GetEventStatus_Event_DTC_0x901d01
        OpEventGetEventStatus_GetEventStatus_EvtInfo_DTC_0x901a01: RteEventRef=OpEventGetEventStatus_GetEventStatus_EvtInfo_DTC_0x901a01
        OpEventGetDTCOfEvent_GetDTCOfEvent_EvtInfo_DTC_0x901401: RteEventRef=OpEventGetDTCOfEvent_GetDTCOfEvent_EvtInfo_DTC_0x901401
        OpEventGetDTCOfEvent_GetDTCOfEvent_EvtInfo_DTC_0x901d01: RteEventRef=OpEventGetDTCOfEvent_GetDTCOfEvent_EvtInfo_DTC_0x901d01
        OpEventGetFaultDetectionCounter_GetFaultDetectionCounter_Event_DTC_0x901501: RteEventRef=OpEventGetFaultDetectionCounter_GetFaultDetectionCounter_Event_DTC_0x901501
        OpEventGetEventExtendedDataRecordEx_GetEventExtendedDataRecordEx_Event_DTC_0x901b01: RteEventRef=OpEventGetEventExtendedDataRecordEx_GetEventExtendedDataRecordEx_Event_DTC_0x901b01
        OpEventGetEventFreezeFrameDataEx_GetEventFreezeFrameDataEx_EvtInfo_DTC_0x902001: RteEventRef=OpEventGetEventFreezeFrameDataEx_GetEventFreezeFrameDataEx_EvtInfo_DTC_0x902001
        OpEventResetEventDebounceStatus_ResetEventDebounceStatus_Event_DTC_0x901601: RteEventRef=OpEventResetEventDebounceStatus_ResetEventDebounceStatus_Event_DTC_0x901601
        OpEventGetDTCOfEvent_GetDTCOfEvent_EvtInfo_DTC_0x901a01: RteEventRef=OpEventGetDTCOfEvent_GetDTCOfEvent_EvtInfo_DTC_0x901a01
        OpEventGetEventTested_GetEventTested_Event_DTC_0x901001: RteEventRef=OpEventGetEventTested_GetEventTested_Event_DTC_0x901001
        OpEventGetDTCOfEvent_GetDTCOfEvent_Event_DTC_0x901801: RteEventRef=OpEventGetDTCOfEvent_GetDTCOfEvent_Event_DTC_0x901801
        OpEventGetMonitorStatus_GetMonitorStatus_EvtInfo_DTC_0x901301: RteEventRef=OpEventGetMonitorStatus_GetMonitorStatus_EvtInfo_DTC_0x901301
        OpEventGetEventFreezeFrameDataEx_GetEventFreezeFrameDataEx_Event_DTC_0x902001: RteEventRef=OpEventGetEventFreezeFrameDataEx_GetEventFreezeFrameDataEx_Event_DTC_0x902001
        OpEventGetEventExtendedDataRecordEx_GetEventExtendedDataRecordEx_Event_DTC_0x901201: RteEventRef=OpEventGetEventExtendedDataRecordEx_GetEventExtendedDataRecordEx_Event_DTC_0x901201
        OpEventGetEventUdsStatus_GetEventUdsStatus_EvtInfo_DTC_0x901001: RteEventRef=OpEventGetEventUdsStatus_GetEventUdsStatus_EvtInfo_DTC_0x901001
        OpEventResetEventDebounceStatus_ResetEventDebounceStatus_Event_DTC_0x901401: RteEventRef=OpEventResetEventDebounceStatus_ResetEventDebounceStatus_Event_DTC_0x901401
        OpEventResetEventStatus_ResetEventStatus_Event_DTC_0x901901: RteEventRef=OpEventResetEventStatus_ResetEventStatus_Event_DTC_0x901901
        OpEventGetEventFailed_GetEventFailed_Event_DTC_0x901601: RteEventRef=OpEventGetEventFailed_GetEventFailed_Event_DTC_0x901601
        OpEventGetDTCOfEvent_GetDTCOfEvent_EvtInfo_DTC_0x901c01: RteEventRef=OpEventGetDTCOfEvent_GetDTCOfEvent_EvtInfo_DTC_0x901c01
        OpEventSetEventStatus_SetEventStatus_Event_DTC_0x901d01: RteEventRef=OpEventSetEventStatus_SetEventStatus_Event_DTC_0x901d01
        OpEventSetEventStatus_SetEventStatus_Event_DTC_0x901a01: RteEventRef=OpEventSetEventStatus_SetEventStatus_Event_DTC_0x901a01
        OpEventGetDTCOfEvent_GetDTCOfEvent_Event_DTC_0x901f01: RteEventRef=OpEventGetDTCOfEvent_GetDTCOfEvent_Event_DTC_0x901f01
        OpEventGetEventFreezeFrameDataEx_GetEventFreezeFrameDataEx_EvtInfo_DTC_0x901401: RteEventRef=OpEventGetEventFreezeFrameDataEx_GetEventFreezeFrameDataEx_EvtInfo_DTC_0x901401
        OpEventResetEventDebounceStatus_ResetEventDebounceStatus_Event_DTC_0x901801: RteEventRef=OpEventResetEventDebounceStatus_ResetEventDebounceStatus_Event_DTC_0x901801
        OpEventGetEventFailed_GetEventFailed_Event_DTC_0x901001: RteEventRef=OpEventGetEventFailed_GetEventFailed_Event_DTC_0x901001
        OpEventSetEventStatus_SetEventStatus_Event_DTC_0x901601: RteEventRef=OpEventSetEventStatus_SetEventStatus_Event_DTC_0x901601
        OpEventGetEventStatus_GetEventStatus_Event_DTC_0x901001: RteEventRef=OpEventGetEventStatus_GetEventStatus_Event_DTC_0x901001
        OpEventGetEventEnableCondition_GetEventEnableCondition_EvtInfo_DTC_0x901501: RteEventRef=OpEventGetEventEnableCondition_GetEventEnableCondition_EvtInfo_DTC_0x901501
        OpEventGetEventUdsStatus_GetEventUdsStatus_Event_DTC_0x901a01: RteEventRef=OpEventGetEventUdsStatus_GetEventUdsStatus_Event_DTC_0x901a01
        OpEventGetFaultDetectionCounter_GetFaultDetectionCounter_Event_DTC_0x901001: RteEventRef=OpEventGetFaultDetectionCounter_GetFaultDetectionCounter_Event_DTC_0x901001
        OpEventSetEventStatus_SetEventStatus_Event_DTC_0x902001: RteEventRef=OpEventSetEventStatus_SetEventStatus_Event_DTC_0x902001
        OpEventGetEventStatus_GetEventStatus_EvtInfo_DTC_0x901d01: RteEventRef=OpEventGetEventStatus_GetEventStatus_EvtInfo_DTC_0x901d01
        OpEventGetEventTested_GetEventTested_EvtInfo_DTC_0x901101: RteEventRef=OpEventGetEventTested_GetEventTested_EvtInfo_DTC_0x901101
        OpEventGetEventFailed_GetEventFailed_Event_DTC_0x901f01: RteEventRef=OpEventGetEventFailed_GetEventFailed_Event_DTC_0x901f01
        OpEventGetEventTested_GetEventTested_Event_DTC_0x902101: RteEventRef=OpEventGetEventTested_GetEventTested_Event_DTC_0x902101
        OpEventGetFaultDetectionCounter_GetFaultDetectionCounter_EvtInfo_DTC_0x901701: RteEventRef=OpEventGetFaultDetectionCounter_GetFaultDetectionCounter_EvtInfo_DTC_0x901701
        OpEventGetMonitorStatus_GetMonitorStatus_EvtInfo_DTC_0x901001: RteEventRef=OpEventGetMonitorStatus_GetMonitorStatus_EvtInfo_DTC_0x901001
        OpEventGetEventUdsStatus_GetEventUdsStatus_Event_DTC_0x901401: RteEventRef=OpEventGetEventUdsStatus_GetEventUdsStatus_Event_DTC_0x901401
        OpEventGetEventUdsStatus_GetEventUdsStatus_Event_DTC_0x901601: RteEventRef=OpEventGetEventUdsStatus_GetEventUdsStatus_Event_DTC_0x901601
        OpEventGetDTCOfEvent_GetDTCOfEvent_EvtInfo_DTC_0x901501: RteEventRef=OpEventGetDTCOfEvent_GetDTCOfEvent_EvtInfo_DTC_0x901501
        OpEventGetEventUdsStatus_GetEventUdsStatus_Event_DTC_0x901001: RteEventRef=OpEventGetEventUdsStatus_GetEventUdsStatus_Event_DTC_0x901001
        OpEventGetEventTested_GetEventTested_EvtInfo_DTC_0x901201: RteEventRef=OpEventGetEventTested_GetEventTested_EvtInfo_DTC_0x901201
        OpEventGetEventFreezeFrameDataEx_GetEventFreezeFrameDataEx_Event_DTC_0x901b01: RteEventRef=OpEventGetEventFreezeFrameDataEx_GetEventFreezeFrameDataEx_Event_DTC_0x901b01
        OpEventResetEventDebounceStatus_ResetEventDebounceStatus_Event_DTC_0x901c01: RteEventRef=OpEventResetEventDebounceStatus_ResetEventDebounceStatus_Event_DTC_0x901c01
        OpEventGetFaultDetectionCounter_GetFaultDetectionCounter_Event_DTC_0x901b01: RteEventRef=OpEventGetFaultDetectionCounter_GetFaultDetectionCounter_Event_DTC_0x901b01
        OpEventGetEventUdsStatus_GetEventUdsStatus_EvtInfo_DTC_0x901d01: RteEventRef=OpEventGetEventUdsStatus_GetEventUdsStatus_EvtInfo_DTC_0x901d01
        OpEventGetEventExtendedDataRecordEx_GetEventExtendedDataRecordEx_Event_DTC_0x901801: RteEventRef=OpEventGetEventExtendedDataRecordEx_GetEventExtendedDataRecordEx_Event_DTC_0x901801
        OpEventGetDTCOfEvent_GetDTCOfEvent_EvtInfo_DTC_0x901601: RteEventRef=OpEventGetDTCOfEvent_GetDTCOfEvent_EvtInfo_DTC_0x901601
        OpEventGetEventTested_GetEventTested_Event_DTC_0x901701: RteEventRef=OpEventGetEventTested_GetEventTested_Event_DTC_0x901701
        OpEventGetEventTested_GetEventTested_Event_DTC_0x901f01: RteEventRef=OpEventGetEventTested_GetEventTested_Event_DTC_0x901f01
        OpEventGetDTCOfEvent_GetDTCOfEvent_Event_DTC_0x901301: RteEventRef=OpEventGetDTCOfEvent_GetDTCOfEvent_Event_DTC_0x901301
        OpEventGetEventFailed_GetEventFailed_Event_DTC_0x901501: RteEventRef=OpEventGetEventFailed_GetEventFailed_Event_DTC_0x901501
        OpEventGetEventExtendedDataRecordEx_GetEventExtendedDataRecordEx_Event_DTC_0x901401: RteEventRef=OpEventGetEventExtendedDataRecordEx_GetEventExtendedDataRecordEx_Event_DTC_0x901401
        OpEventGetEventFreezeFrameDataEx_GetEventFreezeFrameDataEx_EvtInfo_DTC_0x901e01: RteEventRef=OpEventGetEventFreezeFrameDataEx_GetEventFreezeFrameDataEx_EvtInfo_DTC_0x901e01
        OpEventGetEventUdsStatus_GetEventUdsStatus_EvtInfo_DTC_0x901501: RteEventRef=OpEventGetEventUdsStatus_GetEventUdsStatus_EvtInfo_DTC_0x901501
        OpEventGetDTCOfEvent_GetDTCOfEvent_EvtInfo_DTC_0x901901: RteEventRef=OpEventGetDTCOfEvent_GetDTCOfEvent_EvtInfo_DTC_0x901901
        OpEventGetDebouncingOfEvent_GetDebouncingOfEvent_EvtInfo_DTC_0x901701: RteEventRef=OpEventGetDebouncingOfEvent_GetDebouncingOfEvent_EvtInfo_DTC_0x901701
        OpEventResetEventStatus_ResetEventStatus_Event_DTC_0x901001: RteEventRef=OpEventResetEventStatus_ResetEventStatus_Event_DTC_0x901001
        OpEventGetDTCOfEvent_GetDTCOfEvent_EvtInfo_DTC_0x901b01: RteEventRef=OpEventGetDTCOfEvent_GetDTCOfEvent_EvtInfo_DTC_0x901b01
        OpEventGetFaultDetectionCounter_GetFaultDetectionCounter_Event_DTC_0x901d01: RteEventRef=OpEventGetFaultDetectionCounter_GetFaultDetectionCounter_Event_DTC_0x901d01
        OpEventGetDTCOfEvent_GetDTCOfEvent_Event_DTC_0x902101: RteEventRef=OpEventGetDTCOfEvent_GetDTCOfEvent_Event_DTC_0x902101
        OpEventGetEventExtendedDataRecordEx_GetEventExtendedDataRecordEx_EvtInfo_DTC_0x901401: RteEventRef=OpEventGetEventExtendedDataRecordEx_GetEventExtendedDataRecordEx_EvtInfo_DTC_0x901401
        OpEventResetEventStatus_ResetEventStatus_Event_DTC_0x901401: RteEventRef=OpEventResetEventStatus_ResetEventStatus_Event_DTC_0x901401
        OpEventGetEventFreezeFrameDataEx_GetEventFreezeFrameDataEx_EvtInfo_AutoCreatedDemEvent_SpiDriver_SPI_E_HARDWARE_ERROR_1: RteEventRef=OpEventGetEventFreezeFrameDataEx_GetEventFreezeFrameDataEx_EvtInfo_AutoCreatedDemEvent_SpiDriver_SPI_E_HARDWARE_ERROR_1
        OpEventGetEventEnableCondition_GetEventEnableCondition_EvtInfo_AutoCreatedDemEvent_SpiDriver_SPI_E_HARDWARE_ERROR_1: RteEventRef=OpEventGetEventEnableCondition_GetEventEnableCondition_EvtInfo_AutoCreatedDemEvent_SpiDriver_SPI_E_HARDWARE_ERROR_1
        OpEventGetEventTested_GetEventTested_EvtInfo_AutoCreatedDemEvent_SpiDriver_SPI_E_HARDWARE_ERROR_1: RteEventRef=OpEventGetEventTested_GetEventTested_EvtInfo_AutoCreatedDemEvent_SpiDriver_SPI_E_HARDWARE_ERROR_1
        OpEventGetMonitorStatus_GetMonitorStatus_EvtInfo_AutoCreatedDemEvent_SpiDriver_SPI_E_HARDWARE_ERROR_1: RteEventRef=OpEventGetMonitorStatus_GetMonitorStatus_EvtInfo_AutoCreatedDemEvent_SpiDriver_SPI_E_HARDWARE_ERROR_1
        OpEventGetDebouncingOfEvent_GetDebouncingOfEvent_EvtInfo_AutoCreatedDemEvent_SpiDriver_SPI_E_HARDWARE_ERROR_1: RteEventRef=OpEventGetDebouncingOfEvent_GetDebouncingOfEvent_EvtInfo_AutoCreatedDemEvent_SpiDriver_SPI_E_HARDWARE_ERROR_1
        OpEventGetEventExtendedDataRecordEx_GetEventExtendedDataRecordEx_EvtInfo_AutoCreatedDemEvent_SpiDriver_SPI_E_HARDWARE_ERROR_1: RteEventRef=OpEventGetEventExtendedDataRecordEx_GetEventExtendedDataRecordEx_EvtInfo_AutoCreatedDemEvent_SpiDriver_SPI_E_HARDWARE_ERROR_1
        OpEventGetEventFailed_GetEventFailed_EvtInfo_AutoCreatedDemEvent_SpiDriver_SPI_E_HARDWARE_ERROR_1: RteEventRef=OpEventGetEventFailed_GetEventFailed_EvtInfo_AutoCreatedDemEvent_SpiDriver_SPI_E_HARDWARE_ERROR_1
        OpEventGetEventStatus_GetEventStatus_EvtInfo_AutoCreatedDemEvent_SpiDriver_SPI_E_HARDWARE_ERROR_1: RteEventRef=OpEventGetEventStatus_GetEventStatus_EvtInfo_AutoCreatedDemEvent_SpiDriver_SPI_E_HARDWARE_ERROR_1
        OpEventGetDTCOfEvent_GetDTCOfEvent_EvtInfo_AutoCreatedDemEvent_SpiDriver_SPI_E_HARDWARE_ERROR_1: RteEventRef=OpEventGetDTCOfEvent_GetDTCOfEvent_EvtInfo_AutoCreatedDemEvent_SpiDriver_SPI_E_HARDWARE_ERROR_1
        OpEventGetFaultDetectionCounter_GetFaultDetectionCounter_EvtInfo_AutoCreatedDemEvent_SpiDriver_SPI_E_HARDWARE_ERROR_1: RteEventRef=OpEventGetFaultDetectionCounter_GetFaultDetectionCounter_EvtInfo_AutoCreatedDemEvent_SpiDriver_SPI_E_HARDWARE_ERROR_1
        OpEventGetEventUdsStatus_GetEventUdsStatus_EvtInfo_AutoCreatedDemEvent_SpiDriver_SPI_E_HARDWARE_ERROR_1: RteEventRef=OpEventGetEventUdsStatus_GetEventUdsStatus_EvtInfo_AutoCreatedDemEvent_SpiDriver_SPI_E_HARDWARE_ERROR_1
        OpEventGetEventUdsStatus_GetEventUdsStatus_EvtInfo_AutoCreatedDemEvent_PwmDemEventParameterRefs_PWM_E_REG_WRITE_VERIFY: RteEventRef=OpEventGetEventUdsStatus_GetEventUdsStatus_EvtInfo_AutoCreatedDemEvent_PwmDemEventParameterRefs_PWM_E_REG_WRITE_VERIFY
        OpEventGetEventTested_GetEventTested_EvtInfo_AutoCreatedDemEvent_PwmDemEventParameterRefs_PWM_E_TIMER_FAILURE: RteEventRef=OpEventGetEventTested_GetEventTested_EvtInfo_AutoCreatedDemEvent_PwmDemEventParameterRefs_PWM_E_TIMER_FAILURE
        OpEventGetEventExtendedDataRecordEx_GetEventExtendedDataRecordEx_EvtInfo_AutoCreatedDemEvent_PwmDemEventParameterRefs_P_9b96668a: RteEventRef=OpEventGetEventExtendedDataRecordEx_GetEventExtendedDataRecordEx_EvtInfo_AutoCreatedDemEvent_PwmDemEventParameterRefs_P_9b96668a
        OpEventGetEventExtendedDataRecordEx_GetEventExtendedDataRecordEx_EvtInfo_AutoCreatedDemEvent_PwmDemEventParameterRefs_P_649473d6: RteEventRef=OpEventGetEventExtendedDataRecordEx_GetEventExtendedDataRecordEx_EvtInfo_AutoCreatedDemEvent_PwmDemEventParameterRefs_P_649473d6
        OpEventGetFaultDetectionCounter_GetFaultDetectionCounter_EvtInfo_AutoCreatedDemEvent_PwmDemEventParameterRefs_PWM_E_TIM_7291643b: RteEventRef=OpEventGetFaultDetectionCounter_GetFaultDetectionCounter_EvtInfo_AutoCreatedDemEvent_PwmDemEventParameterRefs_PWM_E_TIM_7291643b
        OpEventGetDTCOfEvent_GetDTCOfEvent_EvtInfo_AutoCreatedDemEvent_PwmDemEventParameterRefs_PWM_E_DIAG_FAILURE: RteEventRef=OpEventGetDTCOfEvent_GetDTCOfEvent_EvtInfo_AutoCreatedDemEvent_PwmDemEventParameterRefs_PWM_E_DIAG_FAILURE
        OpEventGetMonitorStatus_GetMonitorStatus_EvtInfo_AutoCreatedDemEvent_PwmDemEventParameterRefs_PWM_E_REG_WRITE_VERIFY: RteEventRef=OpEventGetMonitorStatus_GetMonitorStatus_EvtInfo_AutoCreatedDemEvent_PwmDemEventParameterRefs_PWM_E_REG_WRITE_VERIFY
        OpEventGetEventTested_GetEventTested_EvtInfo_AutoCreatedDemEvent_PwmDemEventParameterRefs_PWM_E_REG_WRITE_VERIFY: RteEventRef=OpEventGetEventTested_GetEventTested_EvtInfo_AutoCreatedDemEvent_PwmDemEventParameterRefs_PWM_E_REG_WRITE_VERIFY
        OpEventGetEventStatus_GetEventStatus_EvtInfo_AutoCreatedDemEvent_PwmDemEventParameterRefs_PWM_E_REG_WRITE_VERIFY: RteEventRef=OpEventGetEventStatus_GetEventStatus_EvtInfo_AutoCreatedDemEvent_PwmDemEventParameterRefs_PWM_E_REG_WRITE_VERIFY
        OpEventGetEventTested_GetEventTested_EvtInfo_AutoCreatedDemEvent_PwmDemEventParameterRefs_PWM_E_DIAG_FAILURE: RteEventRef=OpEventGetEventTested_GetEventTested_EvtInfo_AutoCreatedDemEvent_PwmDemEventParameterRefs_PWM_E_DIAG_FAILURE
        OpEventGetFaultDetectionCounter_GetFaultDetectionCounter_EvtInfo_AutoCreatedDemEvent_PwmDemEventParameterRefs_PWM_E_REG_0c5a1039: RteEventRef=OpEventGetFaultDetectionCounter_GetFaultDetectionCounter_EvtInfo_AutoCreatedDemEvent_PwmDemEventParameterRefs_PWM_E_REG_0c5a1039
        OpEventGetEventEnableCondition_GetEventEnableCondition_EvtInfo_AutoCreatedDemEvent_PwmDemEventParameterRefs_PWM_E_TIMER_FAILURE: RteEventRef=OpEventGetEventEnableCondition_GetEventEnableCondition_EvtInfo_AutoCreatedDemEvent_PwmDemEventParameterRefs_PWM_E_TIMER_FAILURE
        OpEventGetDTCOfEvent_GetDTCOfEvent_EvtInfo_AutoCreatedDemEvent_PwmDemEventParameterRefs_PWM_E_REG_WRITE_VERIFY: RteEventRef=OpEventGetDTCOfEvent_GetDTCOfEvent_EvtInfo_AutoCreatedDemEvent_PwmDemEventParameterRefs_PWM_E_REG_WRITE_VERIFY
        OpEventGetMonitorStatus_GetMonitorStatus_EvtInfo_AutoCreatedDemEvent_PwmDemEventParameterRefs_PWM_E_TIMER_FAILURE: RteEventRef=OpEventGetMonitorStatus_GetMonitorStatus_EvtInfo_AutoCreatedDemEvent_PwmDemEventParameterRefs_PWM_E_TIMER_FAILURE
        OpEventGetMonitorStatus_GetMonitorStatus_EvtInfo_AutoCreatedDemEvent_PwmDemEventParameterRefs_PWM_E_DIAG_FAILURE: RteEventRef=OpEventGetMonitorStatus_GetMonitorStatus_EvtInfo_AutoCreatedDemEvent_PwmDemEventParameterRefs_PWM_E_DIAG_FAILURE
        OpEventGetDebouncingOfEvent_GetDebouncingOfEvent_EvtInfo_AutoCreatedDemEvent_PwmDemEventParameterRefs_PWM_E_DIAG_FAILURE: RteEventRef=OpEventGetDebouncingOfEvent_GetDebouncingOfEvent_EvtInfo_AutoCreatedDemEvent_PwmDemEventParameterRefs_PWM_E_DIAG_FAILURE
        OpEventGetEventUdsStatus_GetEventUdsStatus_EvtInfo_AutoCreatedDemEvent_PwmDemEventParameterRefs_PWM_E_DIAG_FAILURE: RteEventRef=OpEventGetEventUdsStatus_GetEventUdsStatus_EvtInfo_AutoCreatedDemEvent_PwmDemEventParameterRefs_PWM_E_DIAG_FAILURE
        OpEventGetEventStatus_GetEventStatus_EvtInfo_AutoCreatedDemEvent_PwmDemEventParameterRefs_PWM_E_DIAG_FAILURE: RteEventRef=OpEventGetEventStatus_GetEventStatus_EvtInfo_AutoCreatedDemEvent_PwmDemEventParameterRefs_PWM_E_DIAG_FAILURE
        OpEventGetEventFailed_GetEventFailed_EvtInfo_AutoCreatedDemEvent_PwmDemEventParameterRefs_PWM_E_REG_WRITE_VERIFY: RteEventRef=OpEventGetEventFailed_GetEventFailed_EvtInfo_AutoCreatedDemEvent_PwmDemEventParameterRefs_PWM_E_REG_WRITE_VERIFY
        OpEventGetEventUdsStatus_GetEventUdsStatus_EvtInfo_AutoCreatedDemEvent_PwmDemEventParameterRefs_PWM_E_TIMER_FAILURE: RteEventRef=OpEventGetEventUdsStatus_GetEventUdsStatus_EvtInfo_AutoCreatedDemEvent_PwmDemEventParameterRefs_PWM_E_TIMER_FAILURE
        OpEventGetEventFailed_GetEventFailed_EvtInfo_AutoCreatedDemEvent_PwmDemEventParameterRefs_PWM_E_DIAG_FAILURE: RteEventRef=OpEventGetEventFailed_GetEventFailed_EvtInfo_AutoCreatedDemEvent_PwmDemEventParameterRefs_PWM_E_DIAG_FAILURE
        OpEventGetEventFreezeFrameDataEx_GetEventFreezeFrameDataEx_EvtInfo_AutoCreatedDemEvent_PwmDemEventParameterRefs_PWM_E_D_2877fa84: RteEventRef=OpEventGetEventFreezeFrameDataEx_GetEventFreezeFrameDataEx_EvtInfo_AutoCreatedDemEvent_PwmDemEventParameterRefs_PWM_E_D_2877fa84
        OpEventGetDebouncingOfEvent_GetDebouncingOfEvent_EvtInfo_AutoCreatedDemEvent_PwmDemEventParameterRefs_PWM_E_REG_WRITE_VERIFY: RteEventRef=OpEventGetDebouncingOfEvent_GetDebouncingOfEvent_EvtInfo_AutoCreatedDemEvent_PwmDemEventParameterRefs_PWM_E_REG_WRITE_VERIFY
        OpEventGetEventFreezeFrameDataEx_GetEventFreezeFrameDataEx_EvtInfo_AutoCreatedDemEvent_PwmDemEventParameterRefs_PWM_E_R_946cdd81: RteEventRef=OpEventGetEventFreezeFrameDataEx_GetEventFreezeFrameDataEx_EvtInfo_AutoCreatedDemEvent_PwmDemEventParameterRefs_PWM_E_R_946cdd81
        OpEventGetEventFreezeFrameDataEx_GetEventFreezeFrameDataEx_EvtInfo_AutoCreatedDemEvent_PwmDemEventParameterRefs_PWM_E_T_dad3fab3: RteEventRef=OpEventGetEventFreezeFrameDataEx_GetEventFreezeFrameDataEx_EvtInfo_AutoCreatedDemEvent_PwmDemEventParameterRefs_PWM_E_T_dad3fab3
        OpEventGetDebouncingOfEvent_GetDebouncingOfEvent_EvtInfo_AutoCreatedDemEvent_PwmDemEventParameterRefs_PWM_E_TIMER_FAILURE: RteEventRef=OpEventGetDebouncingOfEvent_GetDebouncingOfEvent_EvtInfo_AutoCreatedDemEvent_PwmDemEventParameterRefs_PWM_E_TIMER_FAILURE
        OpEventGetEventStatus_GetEventStatus_EvtInfo_AutoCreatedDemEvent_PwmDemEventParameterRefs_PWM_E_TIMER_FAILURE: RteEventRef=OpEventGetEventStatus_GetEventStatus_EvtInfo_AutoCreatedDemEvent_PwmDemEventParameterRefs_PWM_E_TIMER_FAILURE
        OpEventGetEventEnableCondition_GetEventEnableCondition_EvtInfo_AutoCreatedDemEvent_PwmDemEventParameterRefs_PWM_E_REG_W_6365d83d: RteEventRef=OpEventGetEventEnableCondition_GetEventEnableCondition_EvtInfo_AutoCreatedDemEvent_PwmDemEventParameterRefs_PWM_E_REG_W_6365d83d
        OpEventGetEventExtendedDataRecordEx_GetEventExtendedDataRecordEx_EvtInfo_AutoCreatedDemEvent_PwmDemEventParameterRefs_P_6991a32f: RteEventRef=OpEventGetEventExtendedDataRecordEx_GetEventExtendedDataRecordEx_EvtInfo_AutoCreatedDemEvent_PwmDemEventParameterRefs_P_6991a32f
        OpEventGetEventFailed_GetEventFailed_EvtInfo_AutoCreatedDemEvent_PwmDemEventParameterRefs_PWM_E_TIMER_FAILURE: RteEventRef=OpEventGetEventFailed_GetEventFailed_EvtInfo_AutoCreatedDemEvent_PwmDemEventParameterRefs_PWM_E_TIMER_FAILURE
        OpEventGetFaultDetectionCounter_GetFaultDetectionCounter_EvtInfo_AutoCreatedDemEvent_PwmDemEventParameterRefs_PWM_E_DIAG_FAILURE: RteEventRef=OpEventGetFaultDetectionCounter_GetFaultDetectionCounter_EvtInfo_AutoCreatedDemEvent_PwmDemEventParameterRefs_PWM_E_DIAG_FAILURE
        OpEventGetEventEnableCondition_GetEventEnableCondition_EvtInfo_AutoCreatedDemEvent_PwmDemEventParameterRefs_PWM_E_DIAG_FAILURE: RteEventRef=OpEventGetEventEnableCondition_GetEventEnableCondition_EvtInfo_AutoCreatedDemEvent_PwmDemEventParameterRefs_PWM_E_DIAG_FAILURE
        OpEventGetDTCOfEvent_GetDTCOfEvent_EvtInfo_AutoCreatedDemEvent_PwmDemEventParameterRefs_PWM_E_TIMER_FAILURE: RteEventRef=OpEventGetDTCOfEvent_GetDTCOfEvent_EvtInfo_AutoCreatedDemEvent_PwmDemEventParameterRefs_PWM_E_TIMER_FAILURE
        OpEventGetEventStatus_GetEventStatus_EvtInfo_AutoCreatedDemEvent_WDG_E_TRIGGER_TIMEOUT: RteEventRef=OpEventGetEventStatus_GetEventStatus_EvtInfo_AutoCreatedDemEvent_WDG_E_TRIGGER_TIMEOUT
        OpEventGetEventStatus_GetEventStatus_EvtInfo_AutoCreatedDemEvent_WDG_E_REG_WRITE_VERIFY: RteEventRef=OpEventGetEventStatus_GetEventStatus_EvtInfo_AutoCreatedDemEvent_WDG_E_REG_WRITE_VERIFY
        OpEventGetEventTested_GetEventTested_EvtInfo_AutoCreatedDemEvent_WDG_E_MODE_FAILED: RteEventRef=OpEventGetEventTested_GetEventTested_EvtInfo_AutoCreatedDemEvent_WDG_E_MODE_FAILED
        OpEventGetEventTested_GetEventTested_EvtInfo_AutoCreatedDemEvent_WDG_E_DISABLE_REJECTED: RteEventRef=OpEventGetEventTested_GetEventTested_EvtInfo_AutoCreatedDemEvent_WDG_E_DISABLE_REJECTED
        OpEventGetEventUdsStatus_GetEventUdsStatus_EvtInfo_AutoCreatedDemEvent_WDG_E_TRIGGER_TIMEOUT: RteEventRef=OpEventGetEventUdsStatus_GetEventUdsStatus_EvtInfo_AutoCreatedDemEvent_WDG_E_TRIGGER_TIMEOUT
        OpEventGetEventStatus_GetEventStatus_EvtInfo_AutoCreatedDemEvent_WDG_E_DISABLE_REJECTED: RteEventRef=OpEventGetEventStatus_GetEventStatus_EvtInfo_AutoCreatedDemEvent_WDG_E_DISABLE_REJECTED
        OpEventGetDebouncingOfEvent_GetDebouncingOfEvent_EvtInfo_AutoCreatedDemEvent_WDG_E_MODE_FAILED: RteEventRef=OpEventGetDebouncingOfEvent_GetDebouncingOfEvent_EvtInfo_AutoCreatedDemEvent_WDG_E_MODE_FAILED
        OpEventGetDebouncingOfEvent_GetDebouncingOfEvent_EvtInfo_AutoCreatedDemEvent_WDG_E_DISABLE_REJECTED: RteEventRef=OpEventGetDebouncingOfEvent_GetDebouncingOfEvent_EvtInfo_AutoCreatedDemEvent_WDG_E_DISABLE_REJECTED
        OpEventGetFaultDetectionCounter_GetFaultDetectionCounter_EvtInfo_AutoCreatedDemEvent_WDG_E_MODE_FAILED: RteEventRef=OpEventGetFaultDetectionCounter_GetFaultDetectionCounter_EvtInfo_AutoCreatedDemEvent_WDG_E_MODE_FAILED
        OpEventGetDTCOfEvent_GetDTCOfEvent_EvtInfo_AutoCreatedDemEvent_WDG_E_REG_WRITE_VERIFY: RteEventRef=OpEventGetDTCOfEvent_GetDTCOfEvent_EvtInfo_AutoCreatedDemEvent_WDG_E_REG_WRITE_VERIFY
        OpEventGetEventEnableCondition_GetEventEnableCondition_EvtInfo_AutoCreatedDemEvent_WDG_E_TRIGGER_TIMEOUT: RteEventRef=OpEventGetEventEnableCondition_GetEventEnableCondition_EvtInfo_AutoCreatedDemEvent_WDG_E_TRIGGER_TIMEOUT
        OpEventGetEventTested_GetEventTested_EvtInfo_AutoCreatedDemEvent_WDG_E_REG_WRITE_VERIFY: RteEventRef=OpEventGetEventTested_GetEventTested_EvtInfo_AutoCreatedDemEvent_WDG_E_REG_WRITE_VERIFY
        OpEventGetMonitorStatus_GetMonitorStatus_EvtInfo_AutoCreatedDemEvent_WDG_E_TRIGGER_TIMEOUT: RteEventRef=OpEventGetMonitorStatus_GetMonitorStatus_EvtInfo_AutoCreatedDemEvent_WDG_E_TRIGGER_TIMEOUT
        OpEventGetFaultDetectionCounter_GetFaultDetectionCounter_EvtInfo_AutoCreatedDemEvent_WDG_E_REG_WRITE_VERIFY: RteEventRef=OpEventGetFaultDetectionCounter_GetFaultDetectionCounter_EvtInfo_AutoCreatedDemEvent_WDG_E_REG_WRITE_VERIFY
        OpEventGetEventEnableCondition_GetEventEnableCondition_EvtInfo_AutoCreatedDemEvent_WDG_E_REG_WRITE_VERIFY: RteEventRef=OpEventGetEventEnableCondition_GetEventEnableCondition_EvtInfo_AutoCreatedDemEvent_WDG_E_REG_WRITE_VERIFY
        OpEventGetEventFreezeFrameDataEx_GetEventFreezeFrameDataEx_EvtInfo_AutoCreatedDemEvent_WDG_E_DISABLE_REJECTED: RteEventRef=OpEventGetEventFreezeFrameDataEx_GetEventFreezeFrameDataEx_EvtInfo_AutoCreatedDemEvent_WDG_E_DISABLE_REJECTED
        OpEventGetEventUdsStatus_GetEventUdsStatus_EvtInfo_AutoCreatedDemEvent_WDG_E_MODE_FAILED: RteEventRef=OpEventGetEventUdsStatus_GetEventUdsStatus_EvtInfo_AutoCreatedDemEvent_WDG_E_MODE_FAILED
        OpEventGetEventFailed_GetEventFailed_EvtInfo_AutoCreatedDemEvent_WDG_E_DISABLE_REJECTED: RteEventRef=OpEventGetEventFailed_GetEventFailed_EvtInfo_AutoCreatedDemEvent_WDG_E_DISABLE_REJECTED
        OpEventGetEventFailed_GetEventFailed_EvtInfo_AutoCreatedDemEvent_WDG_E_TRIGGER_TIMEOUT: RteEventRef=OpEventGetEventFailed_GetEventFailed_EvtInfo_AutoCreatedDemEvent_WDG_E_TRIGGER_TIMEOUT
        OpEventGetEventExtendedDataRecordEx_GetEventExtendedDataRecordEx_EvtInfo_AutoCreatedDemEvent_WDG_E_MODE_FAILED: RteEventRef=OpEventGetEventExtendedDataRecordEx_GetEventExtendedDataRecordEx_EvtInfo_AutoCreatedDemEvent_WDG_E_MODE_FAILED
        OpEventGetEventFailed_GetEventFailed_EvtInfo_AutoCreatedDemEvent_WDG_E_MODE_FAILED: RteEventRef=OpEventGetEventFailed_GetEventFailed_EvtInfo_AutoCreatedDemEvent_WDG_E_MODE_FAILED
        OpEventGetEventFailed_GetEventFailed_EvtInfo_AutoCreatedDemEvent_WDG_E_REG_WRITE_VERIFY: RteEventRef=OpEventGetEventFailed_GetEventFailed_EvtInfo_AutoCreatedDemEvent_WDG_E_REG_WRITE_VERIFY
        OpEventGetMonitorStatus_GetMonitorStatus_EvtInfo_AutoCreatedDemEvent_WDG_E_MODE_FAILED: RteEventRef=OpEventGetMonitorStatus_GetMonitorStatus_EvtInfo_AutoCreatedDemEvent_WDG_E_MODE_FAILED
        OpEventGetEventFreezeFrameDataEx_GetEventFreezeFrameDataEx_EvtInfo_AutoCreatedDemEvent_WDG_E_TRIGGER_TIMEOUT: RteEventRef=OpEventGetEventFreezeFrameDataEx_GetEventFreezeFrameDataEx_EvtInfo_AutoCreatedDemEvent_WDG_E_TRIGGER_TIMEOUT
        OpEventGetEventExtendedDataRecordEx_GetEventExtendedDataRecordEx_EvtInfo_AutoCreatedDemEvent_WDG_E_DISABLE_REJECTED: RteEventRef=OpEventGetEventExtendedDataRecordEx_GetEventExtendedDataRecordEx_EvtInfo_AutoCreatedDemEvent_WDG_E_DISABLE_REJECTED
        OpEventGetEventTested_GetEventTested_EvtInfo_AutoCreatedDemEvent_WDG_E_TRIGGER_TIMEOUT: RteEventRef=OpEventGetEventTested_GetEventTested_EvtInfo_AutoCreatedDemEvent_WDG_E_TRIGGER_TIMEOUT
        OpEventGetEventUdsStatus_GetEventUdsStatus_EvtInfo_AutoCreatedDemEvent_WDG_E_REG_WRITE_VERIFY: RteEventRef=OpEventGetEventUdsStatus_GetEventUdsStatus_EvtInfo_AutoCreatedDemEvent_WDG_E_REG_WRITE_VERIFY
        OpEventGetFaultDetectionCounter_GetFaultDetectionCounter_EvtInfo_AutoCreatedDemEvent_WDG_E_DISABLE_REJECTED: RteEventRef=OpEventGetFaultDetectionCounter_GetFaultDetectionCounter_EvtInfo_AutoCreatedDemEvent_WDG_E_DISABLE_REJECTED
        OpEventGetEventFreezeFrameDataEx_GetEventFreezeFrameDataEx_EvtInfo_AutoCreatedDemEvent_WDG_E_REG_WRITE_VERIFY: RteEventRef=OpEventGetEventFreezeFrameDataEx_GetEventFreezeFrameDataEx_EvtInfo_AutoCreatedDemEvent_WDG_E_REG_WRITE_VERIFY
        OpEventGetDTCOfEvent_GetDTCOfEvent_EvtInfo_AutoCreatedDemEvent_WDG_E_MODE_FAILED: RteEventRef=OpEventGetDTCOfEvent_GetDTCOfEvent_EvtInfo_AutoCreatedDemEvent_WDG_E_MODE_FAILED
        OpEventGetEventExtendedDataRecordEx_GetEventExtendedDataRecordEx_EvtInfo_AutoCreatedDemEvent_WDG_E_TRIGGER_TIMEOUT: RteEventRef=OpEventGetEventExtendedDataRecordEx_GetEventExtendedDataRecordEx_EvtInfo_AutoCreatedDemEvent_WDG_E_TRIGGER_TIMEOUT
        OpEventGetEventExtendedDataRecordEx_GetEventExtendedDataRecordEx_EvtInfo_AutoCreatedDemEvent_WDG_E_REG_WRITE_VERIFY: RteEventRef=OpEventGetEventExtendedDataRecordEx_GetEventExtendedDataRecordEx_EvtInfo_AutoCreatedDemEvent_WDG_E_REG_WRITE_VERIFY
        OpEventGetDebouncingOfEvent_GetDebouncingOfEvent_EvtInfo_AutoCreatedDemEvent_WDG_E_TRIGGER_TIMEOUT: RteEventRef=OpEventGetDebouncingOfEvent_GetDebouncingOfEvent_EvtInfo_AutoCreatedDemEvent_WDG_E_TRIGGER_TIMEOUT
        OpEventGetEventEnableCondition_GetEventEnableCondition_EvtInfo_AutoCreatedDemEvent_WDG_E_MODE_FAILED: RteEventRef=OpEventGetEventEnableCondition_GetEventEnableCondition_EvtInfo_AutoCreatedDemEvent_WDG_E_MODE_FAILED
        OpEventGetDTCOfEvent_GetDTCOfEvent_EvtInfo_AutoCreatedDemEvent_WDG_E_TRIGGER_TIMEOUT: RteEventRef=OpEventGetDTCOfEvent_GetDTCOfEvent_EvtInfo_AutoCreatedDemEvent_WDG_E_TRIGGER_TIMEOUT
        OpEventGetEventFreezeFrameDataEx_GetEventFreezeFrameDataEx_EvtInfo_AutoCreatedDemEvent_WDG_E_MODE_FAILED: RteEventRef=OpEventGetEventFreezeFrameDataEx_GetEventFreezeFrameDataEx_EvtInfo_AutoCreatedDemEvent_WDG_E_MODE_FAILED
        OpEventGetDebouncingOfEvent_GetDebouncingOfEvent_EvtInfo_AutoCreatedDemEvent_WDG_E_REG_WRITE_VERIFY: RteEventRef=OpEventGetDebouncingOfEvent_GetDebouncingOfEvent_EvtInfo_AutoCreatedDemEvent_WDG_E_REG_WRITE_VERIFY
        OpEventGetDTCOfEvent_GetDTCOfEvent_EvtInfo_AutoCreatedDemEvent_WDG_E_DISABLE_REJECTED: RteEventRef=OpEventGetDTCOfEvent_GetDTCOfEvent_EvtInfo_AutoCreatedDemEvent_WDG_E_DISABLE_REJECTED
        OpEventGetMonitorStatus_GetMonitorStatus_EvtInfo_AutoCreatedDemEvent_WDG_E_DISABLE_REJECTED: RteEventRef=OpEventGetMonitorStatus_GetMonitorStatus_EvtInfo_AutoCreatedDemEvent_WDG_E_DISABLE_REJECTED
        OpEventGetMonitorStatus_GetMonitorStatus_EvtInfo_AutoCreatedDemEvent_WDG_E_REG_WRITE_VERIFY: RteEventRef=OpEventGetMonitorStatus_GetMonitorStatus_EvtInfo_AutoCreatedDemEvent_WDG_E_REG_WRITE_VERIFY
        OpEventGetFaultDetectionCounter_GetFaultDetectionCounter_EvtInfo_AutoCreatedDemEvent_WDG_E_TRIGGER_TIMEOUT: RteEventRef=OpEventGetFaultDetectionCounter_GetFaultDetectionCounter_EvtInfo_AutoCreatedDemEvent_WDG_E_TRIGGER_TIMEOUT
        OpEventGetEventUdsStatus_GetEventUdsStatus_EvtInfo_AutoCreatedDemEvent_WDG_E_DISABLE_REJECTED: RteEventRef=OpEventGetEventUdsStatus_GetEventUdsStatus_EvtInfo_AutoCreatedDemEvent_WDG_E_DISABLE_REJECTED
        OpEventGetEventEnableCondition_GetEventEnableCondition_EvtInfo_AutoCreatedDemEvent_WDG_E_DISABLE_REJECTED: RteEventRef=OpEventGetEventEnableCondition_GetEventEnableCondition_EvtInfo_AutoCreatedDemEvent_WDG_E_DISABLE_REJECTED
        OpEventGetEventStatus_GetEventStatus_EvtInfo_AutoCreatedDemEvent_WDG_E_MODE_FAILED: RteEventRef=OpEventGetEventStatus_GetEventStatus_EvtInfo_AutoCreatedDemEvent_WDG_E_MODE_FAILED
        OpEventGetEventUdsStatus_GetEventUdsStatus_EvtInfo_AutoCreatedDemEvent_GptDemEventParameterRefs_GPT_E_REG_WRITE_VERIFY: RteEventRef=OpEventGetEventUdsStatus_GetEventUdsStatus_EvtInfo_AutoCreatedDemEvent_GptDemEventParameterRefs_GPT_E_REG_WRITE_VERIFY
        OpEventGetEventTested_GetEventTested_EvtInfo_AutoCreatedDemEvent_GptDemEventParameterRefs_GPT_E_REG_WRITE_VERIFY: RteEventRef=OpEventGetEventTested_GetEventTested_EvtInfo_AutoCreatedDemEvent_GptDemEventParameterRefs_GPT_E_REG_WRITE_VERIFY
        OpEventGetEventExtendedDataRecordEx_GetEventExtendedDataRecordEx_EvtInfo_AutoCreatedDemEvent_GptDemEventParameterRefs_G_f8202945: RteEventRef=OpEventGetEventExtendedDataRecordEx_GetEventExtendedDataRecordEx_EvtInfo_AutoCreatedDemEvent_GptDemEventParameterRefs_G_f8202945
        OpEventGetEventEnableCondition_GetEventEnableCondition_EvtInfo_AutoCreatedDemEvent_GptDemEventParameterRefs_GPT_E_TIMEO_644fdb41: RteEventRef=OpEventGetEventEnableCondition_GetEventEnableCondition_EvtInfo_AutoCreatedDemEvent_GptDemEventParameterRefs_GPT_E_TIMEO_644fdb41
        OpEventGetDTCOfEvent_GetDTCOfEvent_EvtInfo_AutoCreatedDemEvent_GptDemEventParameterRefs_GPT_E_REG_WRITE_VERIFY: RteEventRef=OpEventGetDTCOfEvent_GetDTCOfEvent_EvtInfo_AutoCreatedDemEvent_GptDemEventParameterRefs_GPT_E_REG_WRITE_VERIFY
        OpEventGetEventTested_GetEventTested_EvtInfo_AutoCreatedDemEvent_GptDemEventParameterRefs_GPT_E_TIMEOUT_FAILURE: RteEventRef=OpEventGetEventTested_GetEventTested_EvtInfo_AutoCreatedDemEvent_GptDemEventParameterRefs_GPT_E_TIMEOUT_FAILURE
        OpEventGetEventEnableCondition_GetEventEnableCondition_EvtInfo_AutoCreatedDemEvent_GptDemEventParameterRefs_GPT_E_REG_W_185cedc7: RteEventRef=OpEventGetEventEnableCondition_GetEventEnableCondition_EvtInfo_AutoCreatedDemEvent_GptDemEventParameterRefs_GPT_E_REG_W_185cedc7
        OpEventGetFaultDetectionCounter_GetFaultDetectionCounter_EvtInfo_AutoCreatedDemEvent_GptDemEventParameterRefs_GPT_E_REG_776325c3: RteEventRef=OpEventGetFaultDetectionCounter_GetFaultDetectionCounter_EvtInfo_AutoCreatedDemEvent_GptDemEventParameterRefs_GPT_E_REG_776325c3
        OpEventGetMonitorStatus_GetMonitorStatus_EvtInfo_AutoCreatedDemEvent_GptDemEventParameterRefs_GPT_E_TIMEOUT_FAILURE: RteEventRef=OpEventGetMonitorStatus_GetMonitorStatus_EvtInfo_AutoCreatedDemEvent_GptDemEventParameterRefs_GPT_E_TIMEOUT_FAILURE
        OpEventGetEventStatus_GetEventStatus_EvtInfo_AutoCreatedDemEvent_GptDemEventParameterRefs_GPT_E_REG_WRITE_VERIFY: RteEventRef=OpEventGetEventStatus_GetEventStatus_EvtInfo_AutoCreatedDemEvent_GptDemEventParameterRefs_GPT_E_REG_WRITE_VERIFY
        OpEventGetEventFailed_GetEventFailed_EvtInfo_AutoCreatedDemEvent_GptDemEventParameterRefs_GPT_E_REG_WRITE_VERIFY: RteEventRef=OpEventGetEventFailed_GetEventFailed_EvtInfo_AutoCreatedDemEvent_GptDemEventParameterRefs_GPT_E_REG_WRITE_VERIFY
        OpEventGetEventUdsStatus_GetEventUdsStatus_EvtInfo_AutoCreatedDemEvent_GptDemEventParameterRefs_GPT_E_TIMEOUT_FAILURE: RteEventRef=OpEventGetEventUdsStatus_GetEventUdsStatus_EvtInfo_AutoCreatedDemEvent_GptDemEventParameterRefs_GPT_E_TIMEOUT_FAILURE
        OpEventGetFaultDetectionCounter_GetFaultDetectionCounter_EvtInfo_AutoCreatedDemEvent_GptDemEventParameterRefs_GPT_E_TIM_ebf03e97: RteEventRef=OpEventGetFaultDetectionCounter_GetFaultDetectionCounter_EvtInfo_AutoCreatedDemEvent_GptDemEventParameterRefs_GPT_E_TIM_ebf03e97
        OpEventGetMonitorStatus_GetMonitorStatus_EvtInfo_AutoCreatedDemEvent_GptDemEventParameterRefs_GPT_E_REG_WRITE_VERIFY: RteEventRef=OpEventGetMonitorStatus_GetMonitorStatus_EvtInfo_AutoCreatedDemEvent_GptDemEventParameterRefs_GPT_E_REG_WRITE_VERIFY
        OpEventGetEventExtendedDataRecordEx_GetEventExtendedDataRecordEx_EvtInfo_AutoCreatedDemEvent_GptDemEventParameterRefs_G_1fad462c: RteEventRef=OpEventGetEventExtendedDataRecordEx_GetEventExtendedDataRecordEx_EvtInfo_AutoCreatedDemEvent_GptDemEventParameterRefs_G_1fad462c
        OpEventGetEventStatus_GetEventStatus_EvtInfo_AutoCreatedDemEvent_GptDemEventParameterRefs_GPT_E_TIMEOUT_FAILURE: RteEventRef=OpEventGetEventStatus_GetEventStatus_EvtInfo_AutoCreatedDemEvent_GptDemEventParameterRefs_GPT_E_TIMEOUT_FAILURE
        OpEventGetDebouncingOfEvent_GetDebouncingOfEvent_EvtInfo_AutoCreatedDemEvent_GptDemEventParameterRefs_GPT_E_REG_WRITE_VERIFY: RteEventRef=OpEventGetDebouncingOfEvent_GetDebouncingOfEvent_EvtInfo_AutoCreatedDemEvent_GptDemEventParameterRefs_GPT_E_REG_WRITE_VERIFY
        OpEventGetEventFailed_GetEventFailed_EvtInfo_AutoCreatedDemEvent_GptDemEventParameterRefs_GPT_E_TIMEOUT_FAILURE: RteEventRef=OpEventGetEventFailed_GetEventFailed_EvtInfo_AutoCreatedDemEvent_GptDemEventParameterRefs_GPT_E_TIMEOUT_FAILURE
        OpEventGetEventFreezeFrameDataEx_GetEventFreezeFrameDataEx_EvtInfo_AutoCreatedDemEvent_GptDemEventParameterRefs_GPT_E_T_0f1d3ad5: RteEventRef=OpEventGetEventFreezeFrameDataEx_GetEventFreezeFrameDataEx_EvtInfo_AutoCreatedDemEvent_GptDemEventParameterRefs_GPT_E_T_0f1d3ad5
        OpEventGetDebouncingOfEvent_GetDebouncingOfEvent_EvtInfo_AutoCreatedDemEvent_GptDemEventParameterRefs_GPT_E_TIMEOUT_FAILURE: RteEventRef=OpEventGetDebouncingOfEvent_GetDebouncingOfEvent_EvtInfo_AutoCreatedDemEvent_GptDemEventParameterRefs_GPT_E_TIMEOUT_FAILURE
        OpEventGetDTCOfEvent_GetDTCOfEvent_EvtInfo_AutoCreatedDemEvent_GptDemEventParameterRefs_GPT_E_TIMEOUT_FAILURE: RteEventRef=OpEventGetDTCOfEvent_GetDTCOfEvent_EvtInfo_AutoCreatedDemEvent_GptDemEventParameterRefs_GPT_E_TIMEOUT_FAILURE
        OpEventGetEventFreezeFrameDataEx_GetEventFreezeFrameDataEx_EvtInfo_AutoCreatedDemEvent_GptDemEventParameterRefs_GPT_E_R_ef55e87b: RteEventRef=OpEventGetEventFreezeFrameDataEx_GetEventFreezeFrameDataEx_EvtInfo_AutoCreatedDemEvent_GptDemEventParameterRefs_GPT_E_R_ef55e87b
        OpEventGetEventEnableCondition_GetEventEnableCondition_EvtInfo_AutoCreatedDemEvent_PwmDemEventParameterRefs_PWM_E_REWRITE_FAILED: RteEventRef=OpEventGetEventEnableCondition_GetEventEnableCondition_EvtInfo_AutoCreatedDemEvent_PwmDemEventParameterRefs_PWM_E_REWRITE_FAILED
        OpEventGetMonitorStatus_GetMonitorStatus_EvtInfo_AutoCreatedDemEvent_PwmDemEventParameterRefs_PWM_E_TIMEOUT_FAILURE: RteEventRef=OpEventGetMonitorStatus_GetMonitorStatus_EvtInfo_AutoCreatedDemEvent_PwmDemEventParameterRefs_PWM_E_TIMEOUT_FAILURE
        OpEventGetEventUdsStatus_GetEventUdsStatus_EvtInfo_AutoCreatedDemEvent_PwmDemEventParameterRefs_PWM_E_REWRITE_FAILED: RteEventRef=OpEventGetEventUdsStatus_GetEventUdsStatus_EvtInfo_AutoCreatedDemEvent_PwmDemEventParameterRefs_PWM_E_REWRITE_FAILED
        OpEventGetEventFreezeFrameDataEx_GetEventFreezeFrameDataEx_EvtInfo_AutoCreatedDemEvent_PwmDemEventParameterRefs_PWM_E_T_87036e1f: RteEventRef=OpEventGetEventFreezeFrameDataEx_GetEventFreezeFrameDataEx_EvtInfo_AutoCreatedDemEvent_PwmDemEventParameterRefs_PWM_E_T_87036e1f
        OpEventGetFaultDetectionCounter_GetFaultDetectionCounter_EvtInfo_AutoCreatedDemEvent_PwmDemEventParameterRefs_PWM_E_REW_f0942057: RteEventRef=OpEventGetFaultDetectionCounter_GetFaultDetectionCounter_EvtInfo_AutoCreatedDemEvent_PwmDemEventParameterRefs_PWM_E_REW_f0942057
        OpEventGetMonitorStatus_GetMonitorStatus_EvtInfo_AutoCreatedDemEvent_PwmDemEventParameterRefs_PWM_E_REWRITE_FAILED: RteEventRef=OpEventGetMonitorStatus_GetMonitorStatus_EvtInfo_AutoCreatedDemEvent_PwmDemEventParameterRefs_PWM_E_REWRITE_FAILED
        OpEventGetEventFreezeFrameDataEx_GetEventFreezeFrameDataEx_EvtInfo_AutoCreatedDemEvent_PwmDemEventParameterRefs_PWM_E_R_135f69db: RteEventRef=OpEventGetEventFreezeFrameDataEx_GetEventFreezeFrameDataEx_EvtInfo_AutoCreatedDemEvent_PwmDemEventParameterRefs_PWM_E_R_135f69db
        OpEventGetDTCOfEvent_GetDTCOfEvent_EvtInfo_AutoCreatedDemEvent_PwmDemEventParameterRefs_PWM_E_REWRITE_FAILED: RteEventRef=OpEventGetDTCOfEvent_GetDTCOfEvent_EvtInfo_AutoCreatedDemEvent_PwmDemEventParameterRefs_PWM_E_REWRITE_FAILED
        OpEventGetDebouncingOfEvent_GetDebouncingOfEvent_EvtInfo_AutoCreatedDemEvent_PwmDemEventParameterRefs_PWM_E_TIMEOUT_FAILURE: RteEventRef=OpEventGetDebouncingOfEvent_GetDebouncingOfEvent_EvtInfo_AutoCreatedDemEvent_PwmDemEventParameterRefs_PWM_E_TIMEOUT_FAILURE
        OpEventGetEventExtendedDataRecordEx_GetEventExtendedDataRecordEx_EvtInfo_AutoCreatedDemEvent_PwmDemEventParameterRefs_P_4c1ba44f: RteEventRef=OpEventGetEventExtendedDataRecordEx_GetEventExtendedDataRecordEx_EvtInfo_AutoCreatedDemEvent_PwmDemEventParameterRefs_P_4c1ba44f
        OpEventGetEventTested_GetEventTested_EvtInfo_AutoCreatedDemEvent_PwmDemEventParameterRefs_PWM_E_REWRITE_FAILED: RteEventRef=OpEventGetEventTested_GetEventTested_EvtInfo_AutoCreatedDemEvent_PwmDemEventParameterRefs_PWM_E_REWRITE_FAILED
        OpEventGetEventFailed_GetEventFailed_EvtInfo_AutoCreatedDemEvent_PwmDemEventParameterRefs_PWM_E_TIMEOUT_FAILURE: RteEventRef=OpEventGetEventFailed_GetEventFailed_EvtInfo_AutoCreatedDemEvent_PwmDemEventParameterRefs_PWM_E_TIMEOUT_FAILURE
        OpEventGetDTCOfEvent_GetDTCOfEvent_EvtInfo_AutoCreatedDemEvent_PwmDemEventParameterRefs_PWM_E_TIMEOUT_FAILURE: RteEventRef=OpEventGetDTCOfEvent_GetDTCOfEvent_EvtInfo_AutoCreatedDemEvent_PwmDemEventParameterRefs_PWM_E_TIMEOUT_FAILURE
        OpEventGetEventStatus_GetEventStatus_EvtInfo_AutoCreatedDemEvent_PwmDemEventParameterRefs_PWM_E_TIMEOUT_FAILURE: RteEventRef=OpEventGetEventStatus_GetEventStatus_EvtInfo_AutoCreatedDemEvent_PwmDemEventParameterRefs_PWM_E_TIMEOUT_FAILURE
        OpEventGetEventStatus_GetEventStatus_EvtInfo_AutoCreatedDemEvent_PwmDemEventParameterRefs_PWM_E_REWRITE_FAILED: RteEventRef=OpEventGetEventStatus_GetEventStatus_EvtInfo_AutoCreatedDemEvent_PwmDemEventParameterRefs_PWM_E_REWRITE_FAILED
        OpEventGetEventEnableCondition_GetEventEnableCondition_EvtInfo_AutoCreatedDemEvent_PwmDemEventParameterRefs_PWM_E_TIMEO_ec518f8b: RteEventRef=OpEventGetEventEnableCondition_GetEventEnableCondition_EvtInfo_AutoCreatedDemEvent_PwmDemEventParameterRefs_PWM_E_TIMEO_ec518f8b
        OpEventGetEventExtendedDataRecordEx_GetEventExtendedDataRecordEx_EvtInfo_AutoCreatedDemEvent_PwmDemEventParameterRefs_P_703e7d8f: RteEventRef=OpEventGetEventExtendedDataRecordEx_GetEventExtendedDataRecordEx_EvtInfo_AutoCreatedDemEvent_PwmDemEventParameterRefs_P_703e7d8f
        OpEventGetEventUdsStatus_GetEventUdsStatus_EvtInfo_AutoCreatedDemEvent_PwmDemEventParameterRefs_PWM_E_TIMEOUT_FAILURE: RteEventRef=OpEventGetEventUdsStatus_GetEventUdsStatus_EvtInfo_AutoCreatedDemEvent_PwmDemEventParameterRefs_PWM_E_TIMEOUT_FAILURE
        OpEventGetEventTested_GetEventTested_EvtInfo_AutoCreatedDemEvent_PwmDemEventParameterRefs_PWM_E_TIMEOUT_FAILURE: RteEventRef=OpEventGetEventTested_GetEventTested_EvtInfo_AutoCreatedDemEvent_PwmDemEventParameterRefs_PWM_E_TIMEOUT_FAILURE
        OpEventGetEventFailed_GetEventFailed_EvtInfo_AutoCreatedDemEvent_PwmDemEventParameterRefs_PWM_E_REWRITE_FAILED: RteEventRef=OpEventGetEventFailed_GetEventFailed_EvtInfo_AutoCreatedDemEvent_PwmDemEventParameterRefs_PWM_E_REWRITE_FAILED
        OpEventGetDebouncingOfEvent_GetDebouncingOfEvent_EvtInfo_AutoCreatedDemEvent_PwmDemEventParameterRefs_PWM_E_REWRITE_FAILED: RteEventRef=OpEventGetDebouncingOfEvent_GetDebouncingOfEvent_EvtInfo_AutoCreatedDemEvent_PwmDemEventParameterRefs_PWM_E_REWRITE_FAILED
        OpEventGetFaultDetectionCounter_GetFaultDetectionCounter_EvtInfo_AutoCreatedDemEvent_PwmDemEventParameterRefs_PWM_E_TIM_63ee6a5d: RteEventRef=OpEventGetFaultDetectionCounter_GetFaultDetectionCounter_EvtInfo_AutoCreatedDemEvent_PwmDemEventParameterRefs_PWM_E_TIM_63ee6a5d
    NvM (RteBswModuleInstance): RteBswImplementationRef=NvM_Impl, RteBswModuleConfigurationRef=NvM
      NvM_MainFunctionTimingEvent0 (RteBswEventToTaskMapping):
        RteBswImmediateRestart = false
        RteBswPositionInTask = 4
        RteBswEventRef = NvM_MainFunctionTimingEvent0
        RteBswMappedToTaskRef = OsTask_BswMainFunctions
        RteBswUsedOsEventRef = Rte_Ev_Cyclic2_OsTask_BswMainFunctions_0_10ms
        RteBswUsedOsAlarmRef = Rte_Al_TE2_OsTask_BswMainFunctions_0_10ms
      NVM_EXCLUSIVE_AREA_0 (RteBswExclusiveAreaImpl): RteExclusiveAreaImplMechanism=ALL_INTERRUPT_BLOCKING, RteBswExclusiveAreaRef=NVM_EXCLUSIVE_AREA_0
    NvM_EcuSwComposition (RteSwComponentInstance): RteSoftwareComponentInstanceRef=NvM
      6 x RteEventToTaskMapping, all with RteImmediateRestart=false:
        Timer_NvM_MainFunction: RtePositionInTask=4, RteEventRef=Timer_NvM_MainFunction, RteMappedToTaskRef=OsTask_BswMainFunctions, RteUsedOsEventRef=Rte_Ev_Cyclic2_OsTask_BswMainFunctions_0_10ms, RteUsedOsAlarmRef=Rte_Al_TE2_OsTask_BswMainFunctions_0_10ms
        OpEventGetErrorStatus_GetErrorStatus_PS_IVDConfigurationList: RteEventRef=OpEventGetErrorStatus_GetErrorStatus_PS_IVDConfigurationList
        OpEventSetRamBlockStatus_SetRamBlockStatus_PS_IVDConfigurationList: RteEventRef=OpEventSetRamBlockStatus_SetRamBlockStatus_PS_IVDConfigurationList
        OpEventReadBlock_ReadBlock_PS_IVDConfigurationList: RteEventRef=OpEventReadBlock_ReadBlock_PS_IVDConfigurationList
        OpEventWriteBlock_WriteBlock_PS_IVDConfigurationList: RteEventRef=OpEventWriteBlock_WriteBlock_PS_IVDConfigurationList
        OpEventRestoreBlockDefaults_RestoreBlockDefaults_PS_IVDConfigurationList: RteEventRef=OpEventRestoreBlockDefaults_RestoreBlockDefaults_PS_IVDConfigurationList
    4 x RteBswModuleInstance:
      Ea: RteBswImplementationRef=Ea_Impl, RteBswModuleConfigurationRef=Ea
        Ea_MainFunctionBackgroundEvent0 (RteBswEventToTaskMapping): RteBswImmediateRestart=false, RteBswPositionInTask=2, RteBswEventRef=Ea_MainFunctionBackgroundEvent0, RteBswMappedToTaskRef=OsTask_Background
      Eep: RteBswImplementationRef=Eep_Impl, RteBswModuleConfigurationRef=Eep
        EEP_30_XXSPI01_EXCLUSIVE_AREA_0 (RteBswExclusiveAreaImpl): RteExclusiveAreaImplMechanism=ALL_INTERRUPT_BLOCKING, RteBswExclusiveAreaRef=EEP_30_XXSPI01_EXCLUSIVE_AREA_0
        Eep_30_XXspi01_MainFunctionBackgroundEvent0 (RteBswEventToTaskMapping):
          RteBswImmediateRestart = false
          RteBswPositionInTask = 3
          RteBswEventRef = Eep_30_XXspi01_MainFunctionBackgroundEvent0
          RteBswMappedToTaskRef = OsTask_Background
      Rte: RteBswImplementationRef=Rte_Impl, RteBswModuleConfigurationRef=Rte
      BswM: RteBswImplementationRef=BswM_Impl, RteBswModuleConfigurationRef=BswM
        BswM_MainFunctionTimingEvent0 (RteBswEventToTaskMapping):
          RteBswImmediateRestart = false
          RteBswPositionInTask = 5
          RteBswEventRef = BswM_MainFunctionTimingEvent0
          RteBswMappedToTaskRef = OsTask_BswMainFunctions
          RteBswUsedOsEventRef = Rte_Ev_Cyclic2_OsTask_BswMainFunctions_0_10ms
          RteBswUsedOsAlarmRef = Rte_Al_TE2_OsTask_BswMainFunctions_0_10ms
        BSWM_EXCLUSIVE_AREA_0 (RteBswExclusiveAreaImpl): RteExclusiveAreaImplMechanism=ALL_INTERRUPT_BLOCKING, RteBswExclusiveAreaRef=BSWM_EXCLUSIVE_AREA_0
    BswM_EcuSwComposition (RteSwComponentInstance): RteSoftwareComponentInstanceRef=BswM
      Timer_BswM_MainFunction (RteEventToTaskMapping):
        RteImmediateRestart = false
        RtePositionInTask = 5
        RteEventRef = Timer_BswM_MainFunction
        RteMappedToTaskRef = OsTask_BswMainFunctions
        RteUsedOsEventRef = Rte_Ev_Cyclic2_OsTask_BswMainFunctions_0_10ms
        RteUsedOsAlarmRef = Rte_Al_TE2_OsTask_BswMainFunctions_0_10ms
    CddBoosterMaximMAX20069_EcuSwComposition (RteSwComponentInstance): RteSoftwareComponentInstanceRef=CddBoosterMaximMAX20069
      22 x RteEventToTaskMapping, all with RteImmediateRestart=false:
        MST_CddBoosterMaximMAX20069_Init_0: RtePositionInTask=13, RteEventRef=MSECddBstrInit_0, RteMappedToTaskRef=OsTask_ApplInitDeInit, RteUsedOsEventRef=Rte_Ev_OnExit_OsTask_ApplInitDeInit_SwcDisplayControl_PpSwcDispCtrlDisplayMode_Mode_UNINIT
        TMT_CddBoosterMaximMAX20069_MainFunction: RtePositionInTask=22, RteEventRef=TECddBstrMainFunction, RteMappedToTaskRef=OsTask_ApplMainFunctions, RteUsedOsAlarmRef=Rte_Al_TE_OsTask_ApplMainFunctions_0_10ms, RteUsedOsEventRef=Rte_Ev_Cyclic_OsTask_ApplMainFunctions_0_10ms
        TMT_CddBoosterMaximMAX20069_PowerControl: RtePositionInTask=0, RteEventRef=TECddBstrPowerControl, RteMappedToTaskRef=OsTask_ApplTimedInitDeInit, RteUsedOsAlarmRef=Rte_Al_TE_OsTask_ApplTimedInitDeInit_0_1ms, RteUsedOsEventRef=Rte_Ev_Cyclic_OsTask_ApplTimedInitDeInit_0_1ms
        TMT_CddBoosterMaximMAX20069_Verify: RtePositionInTask=0, RteEventRef=TECddBstrVerify, RteMappedToTaskRef=OsTask_ApplVerify, RteUsedOsAlarmRef=Rte_Al_TE_OsTask_ApplVerify_0_10ms, RteUsedOsEventRef=Rte_Ev_Cyclic_OsTask_ApplVerify_0_10ms
        OIT_PpCddBoosterMaximMAX20069Verify_GetVerifyStatus_PpCddBoosterMaximMAX20069Verify_GetVerifyStatus: RteEventRef=OIT_PpCddBoosterMaximMAX20069Verify_GetVerifyStatus_PpCddBoosterMaximMAX20069Verify_GetVerifyStatus
        OIT_PpCddBoosterMaximMAX20069Verify_GetRecoveryStatus_PpCddBoosterMaximMAX20069Verify_GetRecoveryStatus: RteEventRef=OIT_PpCddBoosterMaximMAX20069Verify_GetRecoveryStatus_PpCddBoosterMaximMAX20069Verify_GetRecoveryStatus
        OIT_PpCddBoosterMaximMAX20069Verify_ScheduleVerifyRequest_PpCddBoosterMaximMAX20069Verify_ScheduleVerifyRequest: RteEventRef=OIT_PpCddBoosterMaximMAX20069Verify_ScheduleVerifyRequest_PpCddBoosterMaximMAX20069Verify_ScheduleVerifyRequest
        OIT_PpCddBoosterMaximMAX20069Verify_StartRecovery_PpCddBoosterMaximMAX20069Verify_StartRecovery: RteEventRef=OIT_PpCddBoosterMaximMAX20069Verify_StartRecovery_PpCddBoosterMaximMAX20069Verify_StartRecovery
        OIT_PpBoosterVersionInfo_GetVersionInfo_PpBoosterVersionInfo_GetVersionInfo: RteEventRef=OIT_PpBoosterVersionInfo_GetVersionInfo_PpBoosterVersionInfo_GetVersionInfo
        OIT_PpCddBstrBacklightControl_SetDutyCycle_PpCddBstrBacklightControl_SetDutyCycle: RteEventRef=OIT_PpCddBstrBacklightControl_SetDutyCycle_PpCddBstrBacklightControl_SetDutyCycle
        OIT_PpCddBstrBacklightControl_GetDutyCycle_PpCddBstrBacklightControl_GetDutyCycle: RteEventRef=OIT_PpCddBstrBacklightControl_GetDutyCycle_PpCddBstrBacklightControl_GetDutyCycle
        DRT_CddBstr_OnModeRequest_PpCddBstrModeRequest_requestedMode: RtePositionInTask=8, RteEventRef=DRECddBstrSwcDispCtrlModeReq, RteMappedToTaskRef=OsTask_ApplMainFunctions, RteUsedOsEventRef=Rte_Ev_Run_CddBoosterMaximMAX20069_CddBstr_ProcessSwcDispCtrlModeReq
        OIT_PpCddBstrDeviceAccess_SetDeviceAccess_1_PpCddBstrDeviceAccess_SetDeviceAccess: RteEventRef=OIT_PpCddBstrDeviceAccess_SetDeviceAccess_1_PpCddBstrDeviceAccess_SetDeviceAccess
        MST_CddBstr_DeInit_0: RtePositionInTask=65, RteEventRef=MSECddBstrDeinit, RteMappedToTaskRef=OsTask_ApplInitDeInit, RteUsedOsEventRef=Rte_Ev_OnEntry_OsTask_ApplInitDeInit_SwcDisplayControl_PpSwcDispCtrlDisplayMode_Mode_UNINIT
        MST_CddBstr_Init_1: RtePositionInTask=13, RteEventRef=MSECddBstrInit_1, RteMappedToTaskRef=OsTask_ApplInitDeInit, RteUsedOsEventRef=Rte_Ev_OnExit_OsTask_ApplInitDeInit_SwcDisplayControl_PpSwcDispCtrlDisplayMode_Mode_OFF
        MST_CddBstr_OnEntryDcmDefaultSession_0: RtePositionInTask=3, RteEventRef=MSECddBstrOnEnterDefaultSession, RteMappedToTaskRef=OsTask_DcmSessionChanges, RteUsedOsEventRef=Rte_Ev_OnEntry_OsTask_DcmSessionChanges_Dcm_DcmDiagnosticSessionControl_DcmDiagnosticSessionControl_DEFAULT_SESSION
        OIT_CddBstr_DutyCycle_CheckRead_PpDsCddBstrBacklightDutyCycle_ConditionCheckRead: RteEventRef=OIT_CddBstr_DutyCycle_CheckRead_PpDsCddBstrBacklightDutyCycle_ConditionCheckRead
        OIT_CddBstr_DutyCycle_Read_PpDsCddBstrBacklightDutyCycle_ReadData: RteEventRef=OIT_CddBstr_DutyCycle_Read_PpDsCddBstrBacklightDutyCycle_ReadData
        OIT_CddBstr_ReadRegister_Start_PpRsCddBstrReadRegister_Start: RteEventRef=OIT_CddBstr_ReadRegister_Start_PpRsCddBstrReadRegister_Start
        OIT_CddBstr_SimDutyCycle_Start_PpRsCddBstrSimDutyCycle_Start: RteEventRef=OIT_CddBstr_SimDutyCycle_Start_PpRsCddBstrSimDutyCycle_Start
        OIT_CddBstr_SimDutyCycle_Stop_PpRsCddBstrSimDutyCycle_Stop: RteEventRef=OIT_CddBstr_SimDutyCycle_Stop_PpRsCddBstrSimDutyCycle_Stop
        OIT_CddBstr_WriteRegister_Start_PpRsCddBstrWriteRegister_Start: RteEventRef=OIT_CddBstr_WriteRegister_Start_PpRsCddBstrWriteRegister_Start
    CddBoosterMaximMAX20069 (RteSwComponentType): RteComponentTypeRef=CddBoosterMaximMAX20069, RteImplementationRef=CddBoosterMaximMAX20069_Implementation
      ComponentTypeCalibration (RteComponentTypeCalibration): RteCalibrationSupportEnabled=false
    SwcError_EcuSwComposition (RteSwComponentInstance): RteSoftwareComponentInstanceRef=SwcError
      17 x RteEventToTaskMapping, all with RteImmediateRestart=false:
        OIT_PpErrorEvent_GetErrorStatus_PpErrorEvent_GetErrorStatus: RteEventRef=OIT_PpErrorEvent_GetErrorStatus_PpErrorEvent_GetErrorStatus
        OIT_PpErrorEvent_ReportError_PpErrorEvent_ReportError: RteEventRef=OIT_PpErrorEvent_ReportError_PpErrorEvent_ReportError
        OIT_PpErrorEvent_ReportString_PpErrorEvent_ReportString: RteEventRef=OIT_PpErrorEvent_ReportString_PpErrorEvent_ReportString
        OIT_PpSwcErrorVersionInfo_GetVersionInfo_PpSwcErrorVersionInfo_GetVersionInfo: RteEventRef=OIT_PpSwcErrorVersionInfo_GetVersionInfo_PpSwcErrorVersionInfo_GetVersionInfo
        OIT_PpSwcErrorResetToFactorySettings_ResetToFactorySettings_PpSwcErrorResetToFactorySettings_ResetToFactorySettings: RteEventRef=OIT_PpSwcErrorResetToFactorySettings_ResetToFactorySettings_PpSwcErrorResetToFactorySettings_ResetToFactorySettings
        MST_SwcError_OnEntryDcmDefaultSession_0: RtePositionInTask=10, RteEventRef=MST_SwcError_OnEntryDcmDefaultSession_0, RteMappedToTaskRef=OsTask_DcmSessionChanges, RteUsedOsEventRef=Rte_Ev_Run_SwcError_SwcError_OnEntryDcmDefaultSession
        OIT_PpRsSwcErrorGetErrorCounters_Start_PpRsSwcErrorGetErrorCounters_Start: RteEventRef=OIT_PpRsSwcErrorGetErrorCounters_Start_PpRsSwcErrorGetErrorCounters_Start
        OIT_SwcError_ClearErrorCountersStart_PpRsSwcErrorClearErrorCounters_Start: RteEventRef=OIT_SwcError_ClearErrorCountersStart_PpRsSwcErrorClearErrorCounters_Start
        OIT_SwcError_ClearErrorTraceStart_PpRsSwcErrorClearErrorTrace_Start: RteEventRef=OIT_SwcError_ClearErrorTraceStart_PpRsSwcErrorClearErrorTrace_Start
        OIT_SwcError_ErrorCountSevLevSimStart_PpRsSwcErrorErrorCountSevLevSim_Start: RteEventRef=OIT_SwcError_ErrorCountSevLevSimStart_PpRsSwcErrorErrorCountSevLevSim_Start
        OIT_SwcError_ErrorCountSevLevSimStop_PpRsSwcErrorErrorCountSevLevSim_Stop: RteEventRef=OIT_SwcError_ErrorCountSevLevSimStop_PpRsSwcErrorErrorCountSevLevSim_Stop
        OIT_SwcError_GetErrorStatusStart_PpRsSwcErrorGetErrorStatus_Start: RteEventRef=OIT_SwcError_GetErrorStatusStart_PpRsSwcErrorGetErrorStatus_Start
        OIT_SwcError_GetErrorTraceStart_PpRsSwcErrorGetErrorTrace_Start: RteEventRef=OIT_SwcError_GetErrorTraceStart_PpRsSwcErrorGetErrorTrace_Start
        OIT_SwcError_TraceSevLevSimStart_PpRsSwcErrorTraceSevLevSim_Start: RteEventRef=OIT_SwcError_TraceSevLevSimStart_PpRsSwcErrorTraceSevLevSim_Start
        OIT_SwcError_TraceSevLevSimStop_PpRsSwcErrorTraceSevLevSim_Stop: RteEventRef=OIT_SwcError_TraceSevLevSimStop_PpRsSwcErrorTraceSevLevSim_Stop
        OIT_SwcError_UartSevLevSimStart_PpRsSwcErrorUartSevLevSim_Start: RteEventRef=OIT_SwcError_UartSevLevSimStart_PpRsSwcErrorUartSevLevSim_Start
        OIT_SwcError_UartSevLevSimStop_PpRsSwcErrorUartSevLevSim_Stop: RteEventRef=OIT_SwcError_UartSevLevSimStop_PpRsSwcErrorUartSevLevSim_Stop
      EASwcErrorCounters (RteExclusiveAreaImplementation):
        RteExclusiveAreaImplMechanism = OS_RESOURCE
        RteExclusiveAreaRef = EASwcErrorCounters
        RteExclusiveAreaOsResourceRef = Rte_Res_SwcError_EASwcErrorCounters
      IESwcErrorInit (RteEventToTaskMapping): RteImmediateRestart=false, RtePositionInTask=2, RteEventRef=IESwcErrorInit, RteMappedToTaskRef=OsTask_ApplInitDeInit
      MSESwcErrorDeInit (RteEventToTaskMapping):
        RteImmediateRestart = false
        RtePositionInTask = 74
        RteEventRef = MSESwcErrorDeInit
        RteMappedToTaskRef = OsTask_ApplInitDeInit
        RteUsedOsEventRef = Rte_Ev_OnEntry_OsTask_ApplInitDeInit_SwcDisplayControl_PpSwcDispCtrlDisplayMode_Mode_UNINIT
    SwcError (RteSwComponentType): RteComponentTypeRef=SwcError, RteImplementationRef=SwcError_Implementation
      ComponentTypeCalibration (RteComponentTypeCalibration): RteCalibrationSupportEnabled=false
    CddDebugInfo_EcuSwComposition (RteSwComponentInstance): RteSoftwareComponentInstanceRef=CddDebugInfo
      3 x RteEventToTaskMapping, all with RteImmediateRestart=false:
        evCddDebugInfoWriteStringEndNotification: RteCyclicTriggerImplementation=None, RtePositionInTask=13, RteEventRef=TECddDgbInfoOnTxReady, RteMappedToTaskRef=OsTask_ApplMainFunctions, RteUsedOsEventRef=Rte_Ev_Run1_CddDebugInfo_CddDbgInfo_OnTxReady
        OIT_PpDebugEvent_WriteString_PpDebugEvent_WriteString: RteEventRef=OIT_PpDebugEvent_WriteString_PpDebugEvent_WriteString
        OIT_PpCddDebugInfoVersionInfo_GetVersionInfo_PpCddDebugInfoVersionInfo_GetVersionInfo: RteEventRef=OIT_PpCddDebugInfoVersionInfo_GetVersionInfo_PpCddDebugInfoVersionInfo_GetVersionInfo
      EACddDbgInfoBuffer (RteExclusiveAreaImplementation):
        RteExclusiveAreaImplMechanism = OS_RESOURCE
        RteExclusiveAreaRef = EACddDbgInfoBuffer
        RteExclusiveAreaOsResourceRef = Rte_Res_CddDebugInfo_EACddDbgInfoBuffer
      IECddDebugInfoInit (RteEventToTaskMapping): RteImmediateRestart=false, RtePositionInTask=1, RteEventRef=IECddDebugInfoInit, RteMappedToTaskRef=OsTask_ApplInitDeInit
    CddDebugInfo (RteSwComponentType): RteComponentTypeRef=CddDebugInfo, RteImplementationRef=CddDebugInfo_Implementation
      ComponentTypeCalibration (RteComponentTypeCalibration): RteCalibrationSupportEnabled=false
    CddNvMManager (RteSwComponentType): RteComponentTypeRef=CddNvMManager, RteImplementationRef=CddNvMManager_Implementation
      ComponentTypeCalibration (RteComponentTypeCalibration): RteCalibrationSupportEnabled=false
    SwcDisplayInfo_EcuSwComposition (RteSwComponentInstance): RteSoftwareComponentInstanceRef=SwcDisplayInfo
      40 x RteEventToTaskMapping, all with RteImmediateRestart=false:
        MSESwcDispInfoInit_0: RtePositionInTask=24, RteEventRef=MSESwcDispInfoInit_0, RteMappedToTaskRef=OsTask_ApplInitDeInit, RteUsedOsEventRef=Rte_Ev_OnExit_OsTask_ApplInitDeInit_SwcDisplayControl_PpSwcDispCtrlDisplayMode_Mode_UNINIT
        DRESwcDispInfoSteeringWheelPos: RtePositionInTask=0, RteEventRef=DRESwcDispInfoSteeringWheelPos, RteMappedToTaskRef=OsTask_Communication, RteUsedOsEventRef=Rte_Ev_Run_SwcDisplayInfo_SwcDispInfo_ProcessSteeringWheelPos
        MSESwcDispInfoInit_1: RtePositionInTask=24, RteEventRef=MSESwcDispInfoInit_1, RteMappedToTaskRef=OsTask_ApplInitDeInit, RteUsedOsEventRef=Rte_Ev_OnExit_OsTask_ApplInitDeInit_SwcDisplayControl_PpSwcDispCtrlDisplayMode_Mode_OFF
        OIT_PpRsSwcDispInfoCompVerInfo_Start_PpRsSwcDispInfoCompVerInfo_Start: RteEventRef=OIT_PpRsSwcDispInfoCompVerInfo_Start_PpRsSwcDispInfoCompVerInfo_Start
        OIT_PpDsSwcDispInfoHwIdentification_ConditionCheckRead_PpDsSwcDispInfoHwIdentification_ConditionCheckRead: RteEventRef=OIT_PpDsSwcDispInfoHwIdentification_ConditionCheckRead_PpDsSwcDispInfoHwIdentification_ConditionCheckRead
        OIT_PpDsSwcDispInfoHwIdentification_ReadData_PpDsSwcDispInfoHwIdentification_ReadData: RteEventRef=OIT_PpDsSwcDispInfoHwIdentification_ReadData_PpDsSwcDispInfoHwIdentification_ReadData
        OIT_PpDsSwcDispInfoVwEcuHwNo_ConditionCheckRead_PpDsSwcDispInfoVwEcuHwNo_ConditionCheckRead: RteEventRef=OIT_PpDsSwcDispInfoVwEcuHwNo_ConditionCheckRead_PpDsSwcDispInfoVwEcuHwNo_ConditionCheckRead
        OIT_PpDsSwcDispInfoVwEcuHwNo_ReadData_PpDsSwcDispInfoVwEcuHwNo_ReadData: RteEventRef=OIT_PpDsSwcDispInfoVwEcuHwNo_ReadData_PpDsSwcDispInfoVwEcuHwNo_ReadData
        OIT_PpDsSwcDispInfoAsamOdxFileId_ConditionCheckRead_PpDsSwcDispInfoAsamOdxFileId_ConditionCheckRead: RteEventRef=OIT_PpDsSwcDispInfoAsamOdxFileId_ConditionCheckRead_PpDsSwcDispInfoAsamOdxFileId_ConditionCheckRead
        OIT_PpDsSwcDispInfoAsamOdxFileId_ReadDataLength_PpDsSwcDispInfoAsamOdxFileId_ReadDataLength: RteEventRef=OIT_PpDsSwcDispInfoAsamOdxFileId_ReadDataLength_PpDsSwcDispInfoAsamOdxFileId_ReadDataLength
        OIT_PpDsSwcDispInfoAsamOdxFileId_ReadData_PpDsSwcDispInfoAsamOdxFileId_ReadData: RteEventRef=OIT_PpDsSwcDispInfoAsamOdxFileId_ReadData_PpDsSwcDispInfoAsamOdxFileId_ReadData
        OIT_PpDsSwcDispInfoEcuSerNo_ConditionCheckRead_PpDsSwcDispInfoEcuSerNo_ConditionCheckRead: RteEventRef=OIT_PpDsSwcDispInfoEcuSerNo_ConditionCheckRead_PpDsSwcDispInfoEcuSerNo_ConditionCheckRead
        OIT_PpDsSwcDispInfoEcuSerNo_ReadData_PpDsSwcDispInfoEcuSerNo_ReadData: RteEventRef=OIT_PpDsSwcDispInfoEcuSerNo_ReadData_PpDsSwcDispInfoEcuSerNo_ReadData
        OIT_PpDsSwcDispInfoAsamOdxFileVer_ConditionCheckRead_PpDsSwcDispInfoAsamOdxFileVer_ConditionCheckRead: RteEventRef=OIT_PpDsSwcDispInfoAsamOdxFileVer_ConditionCheckRead_PpDsSwcDispInfoAsamOdxFileVer_ConditionCheckRead
        OIT_PpDsSwcDispInfoAsamOdxFileVer_ReadData_PpDsSwcDispInfoAsamOdxFileVer_ReadData: RteEventRef=OIT_PpDsSwcDispInfoAsamOdxFileVer_ReadData_PpDsSwcDispInfoAsamOdxFileVer_ReadData
        OIT_PpDsSwcDispInfoTechSpecVer_ConditionCheckRead_PpDsSwcDispInfoTechSpecVer_ConditionCheckRead: RteEventRef=OIT_PpDsSwcDispInfoTechSpecVer_ConditionCheckRead_PpDsSwcDispInfoTechSpecVer_ConditionCheckRead
        OIT_PpDsSwcDispInfoTechSpecVer_ReadData_PpDsSwcDispInfoTechSpecVer_ReadData: RteEventRef=OIT_PpDsSwcDispInfoTechSpecVer_ReadData_PpDsSwcDispInfoTechSpecVer_ReadData
        OIT_PpDsSwcDispInfoVwEcuHwVerNo_ConditionCheckRead_PpDsSwcDispInfoVwEcuHwVerNo_ConditionCheckRead: RteEventRef=OIT_PpDsSwcDispInfoVwEcuHwVerNo_ConditionCheckRead_PpDsSwcDispInfoVwEcuHwVerNo_ConditionCheckRead
        OIT_PpDsSwcDispInfoVwEcuHwVerNo_ReadData_PpDsSwcDispInfoVwEcuHwVerNo_ReadData: RteEventRef=OIT_PpDsSwcDispInfoVwEcuHwVerNo_ReadData_PpDsSwcDispInfoVwEcuHwVerNo_ReadData
        OIT_PpDsSwcDispInfoVwSparePartNo_ConditionCheckRead_PpDsSwcDispInfoVwSparePartNo_ConditionCheckRead: RteEventRef=OIT_PpDsSwcDispInfoVwSparePartNo_ConditionCheckRead_PpDsSwcDispInfoVwSparePartNo_ConditionCheckRead
        OIT_PpDsSwcDispInfoVwSparePartNo_ReadData_PpDsSwcDispInfoVwSparePartNo_ReadData: RteEventRef=OIT_PpDsSwcDispInfoVwSparePartNo_ReadData_PpDsSwcDispInfoVwSparePartNo_ReadData
        OIT_PpDsSwcDispInfoVwSysNameOrEngType_ConditionCheckRead_PpDsSwcDispInfoVwSysNameOrEngType_ConditionCheckRead: RteEventRef=OIT_PpDsSwcDispInfoVwSysNameOrEngType_ConditionCheckRead_PpDsSwcDispInfoVwSysNameOrEngType_ConditionCheckRead
        OIT_PpDsSwcDispInfoVwSysNameOrEngType_ReadData_PpDsSwcDispInfoVwSysNameOrEngType_ReadData: RteEventRef=OIT_PpDsSwcDispInfoVwSysNameOrEngType_ReadData_PpDsSwcDispInfoVwSysNameOrEngType_ReadData
        OIT_PpDsSwcDispInfoVwFazitIdString_ConditionCheckRead_PpDsSwcDispInfoVwFazitIdString_ConditionCheckRead: RteEventRef=OIT_PpDsSwcDispInfoVwFazitIdString_ConditionCheckRead_PpDsSwcDispInfoVwFazitIdString_ConditionCheckRead
        OIT_PpDsSwcDispInfoVwFazitIdString_ReadData_PpDsSwcDispInfoVwFazitIdString_ReadData: RteEventRef=OIT_PpDsSwcDispInfoVwFazitIdString_ReadData_PpDsSwcDispInfoVwFazitIdString_ReadData
        OIT_PpDsSwcDispInfoDispVariant_ConditionCheckRead_PpDsSwcDispInfoDispVariant_ConditionCheckRead: RteEventRef=OIT_PpDsSwcDispInfoDispVariant_ConditionCheckRead_PpDsSwcDispInfoDispVariant_ConditionCheckRead
        OIT_PpDsSwcDispInfoDispVariant_ReadData_PpDsSwcDispInfoDispVariant_ReadData: RteEventRef=OIT_PpDsSwcDispInfoDispVariant_ReadData_PpDsSwcDispInfoDispVariant_ReadData
        OIT_PpDsSwcDispInfoSvnUrl_ConditionCheckRead_PpDsSwcDispInfoSvnUrl_ConditionCheckRead: RteEventRef=OIT_PpDsSwcDispInfoSvnUrl_ConditionCheckRead_PpDsSwcDispInfoSvnUrl_ConditionCheckRead
        OIT_PpDsSwcDispInfoSvnUrl_ReadData_PpDsSwcDispInfoSvnUrl_ReadData: RteEventRef=OIT_PpDsSwcDispInfoSvnUrl_ReadData_PpDsSwcDispInfoSvnUrl_ReadData
        OIT_PpDsSwcDispInfoDispName_ConditionCheckRead_PpDsSwcDispInfoDispName_ConditionCheckRead: RteEventRef=OIT_PpDsSwcDispInfoDispName_ConditionCheckRead_PpDsSwcDispInfoDispName_ConditionCheckRead
        OIT_PpDsSwcDispInfoDispName_ReadData_PpDsSwcDispInfoDispName_ReadData: RteEventRef=OIT_PpDsSwcDispInfoDispName_ReadData_PpDsSwcDispInfoDispName_ReadData
        OIT_PpDsSwcDispInfoDispHwVersion_ConditionCheckRead_PpDsSwcDispInfoDispHwVersion_ConditionCheckRead: RteEventRef=OIT_PpDsSwcDispInfoDispHwVersion_ConditionCheckRead_PpDsSwcDispInfoDispHwVersion_ConditionCheckRead
        OIT_PpDsSwcDispInfoDispHwVersion_ReadData_PpDsSwcDispInfoDispHwVersion_ReadData: RteEventRef=OIT_PpDsSwcDispInfoDispHwVersion_ReadData_PpDsSwcDispInfoDispHwVersion_ReadData
        OIT_PpDsSwcDispInfoAppSwVersion_ConditionCheckRead_PpDsSwcDispInfoAppSwVersion_ConditionCheckRead: RteEventRef=OIT_PpDsSwcDispInfoAppSwVersion_ConditionCheckRead_PpDsSwcDispInfoAppSwVersion_ConditionCheckRead
        OIT_PpDsSwcDispInfoAppSwVersion_ReadData_PpDsSwcDispInfoAppSwVersion_ReadData: RteEventRef=OIT_PpDsSwcDispInfoAppSwVersion_ReadData_PpDsSwcDispInfoAppSwVersion_ReadData
        OIT_PpDsSwcDispInfoSvnRevision_ConditionCheckRead_PpDsSwcDispInfoSvnRevision_ConditionCheckRead: RteEventRef=OIT_PpDsSwcDispInfoSvnRevision_ConditionCheckRead_PpDsSwcDispInfoSvnRevision_ConditionCheckRead
        OIT_PpDsSwcDispInfoSvnRevision_ReadData_PpDsSwcDispInfoSvnRevision_ReadData: RteEventRef=OIT_PpDsSwcDispInfoSvnRevision_ReadData_PpDsSwcDispInfoSvnRevision_ReadData
        OIT_PpDsSwcDispInfoVwAppSwVerNo_ConditionCheckRead_PpDsSwcDispInfoVwAppSwVerNo_ConditionCheckRead: RteEventRef=OIT_PpDsSwcDispInfoVwAppSwVerNo_ConditionCheckRead_PpDsSwcDispInfoVwAppSwVerNo_ConditionCheckRead
        OIT_PpDsSwcDispInfoVwAppSwVerNo_ReadData_PpDsSwcDispInfoVwAppSwVerNo_ReadData: RteEventRef=OIT_PpDsSwcDispInfoVwAppSwVerNo_ReadData_PpDsSwcDispInfoVwAppSwVerNo_ReadData
        MSESwcDispInfoDeinit: RtePositionInTask=47, RteEventRef=MSESwcDispInfoDeinit, RteMappedToTaskRef=OsTask_ApplInitDeInit, RteUsedOsEventRef=Rte_Ev_OnEntry_OsTask_ApplInitDeInit_SwcDisplayControl_PpSwcDispCtrlDisplayMode_Mode_UNINIT
    SwcDisplayInfo (RteSwComponentType): RteComponentTypeRef=SwcDisplayInfo, RteImplementationRef=SwcDisplayInfo_Implementation
      ComponentTypeCalibration (RteComponentTypeCalibration): RteCalibrationSupportEnabled=false
    SwcVerify_EcuSwComposition (RteSwComponentInstance): RteSoftwareComponentInstanceRef=SwcVerify
      15 x RteEventToTaskMapping, all with RteImmediateRestart=false:
        MST_SwcVerify_DeInit_0: RtePositionInTask=49, RteEventRef=MSESwcVerifyDeinit, RteMappedToTaskRef=OsTask_ApplInitDeInit, RteUsedOsEventRef=Rte_Ev_OnEntry_OsTask_ApplInitDeInit_SwcDisplayControl_PpSwcDispCtrlDisplayMode_Mode_UNINIT
        TMT_SwcVerify_MainFunction: RtePositionInTask=29, RteEventRef=TESwcVerifyMainFunction, RteMappedToTaskRef=OsTask_ApplMainFunctions, RteUsedOsEventRef=Rte_Ev_Cyclic_OsTask_ApplMainFunctions_0_10ms, RteUsedOsAlarmRef=Rte_Al_TE_OsTask_ApplMainFunctions_0_10ms
        OIT_PpSwcVerifyVersionInfo_GetVersionInfo_PpSwcVerifyVersionInfo_GetVersionInfo: RteEventRef=OIT_PpSwcVerifyVersionInfo_GetVersionInfo_PpSwcVerifyVersionInfo_GetVersionInfo
        MST_SwcVerify_Init_0: RtePositionInTask=23, RteEventRef=MSESwcVerifyInit_0, RteMappedToTaskRef=OsTask_ApplInitDeInit, RteUsedOsEventRef=Rte_Ev_OnExit_OsTask_ApplInitDeInit_SwcDisplayControl_PpSwcDispCtrlDisplayMode_Mode_UNINIT
        MST_SwcVerify_Init_1: RtePositionInTask=23, RteEventRef=MSESwcVerifyInit_1, RteMappedToTaskRef=OsTask_ApplInitDeInit, RteUsedOsEventRef=Rte_Ev_OnExit_OsTask_ApplInitDeInit_SwcDisplayControl_PpSwcDispCtrlDisplayMode_Mode_OFF
        OIT_PpRsSwcVerifyModuleVerifyDisable_Stop_PpRsSwcVerifyModuleVerifyDisable_Stop: RteEventRef=OIT_PpRsSwcVerifyModuleVerifyDisable_Stop_PpRsSwcVerifyModuleVerifyDisable_Stop
        OIT_PpRsSwcVerifyModuleVerifyDisable_Start_PpRsSwcVerifyModuleVerifyDisable_Start: RteEventRef=OIT_PpRsSwcVerifyModuleVerifyDisable_Start_PpRsSwcVerifyModuleVerifyDisable_Start
        OIT_PpRsSwcVerifyVerifyRequest_RequestResults_PpRsSwcVerifyVerifyRequest_RequestResults: RteEventRef=OIT_PpRsSwcVerifyVerifyRequest_RequestResults_PpRsSwcVerifyVerifyRequest_RequestResults
        OIT_PpRsSwcVerifyVerifyRequest_Start_PpRsSwcVerifyVerifyRequest_Start: RteEventRef=OIT_PpRsSwcVerifyVerifyRequest_Start_PpRsSwcVerifyVerifyRequest_Start
        OIT_PpRsSwcVerifyRecoveryRequest_RequestResults_PpRsSwcVerifyRecoveryRequest_RequestResults: RteEventRef=OIT_PpRsSwcVerifyRecoveryRequest_RequestResults_PpRsSwcVerifyRecoveryRequest_RequestResults
        OIT_PpRsSwcVerifyRecoveryRequest_Start_PpRsSwcVerifyRecoveryRequest_Start: RteEventRef=OIT_PpRsSwcVerifyRecoveryRequest_Start_PpRsSwcVerifyRecoveryRequest_Start
        OIT_PpDsSwcVerifyVerifyEnable_WriteData_PpDsSwcVerifyVerifyEnable_WriteData: RteEventRef=OIT_PpDsSwcVerifyVerifyEnable_WriteData_PpDsSwcVerifyVerifyEnable_WriteData
        OIT_PpDsSwcVerifyVerifyEnable_ConditionCheckRead_PpDsSwcVerifyVerifyEnable_ConditionCheckRead: RteEventRef=OIT_PpDsSwcVerifyVerifyEnable_ConditionCheckRead_PpDsSwcVerifyVerifyEnable_ConditionCheckRead
        OIT_PpDsSwcVerifyVerifyEnable_ReadData_PpDsSwcVerifyVerifyEnable_ReadData: RteEventRef=OIT_PpDsSwcVerifyVerifyEnable_ReadData_PpDsSwcVerifyVerifyEnable_ReadData
        MST_SwcVerify_OnEntryDefaultSession_0: RtePositionInTask=11, RteEventRef=MST_SwcVerify_OnEntryDefaultSession_0, RteMappedToTaskRef=OsTask_DcmSessionChanges, RteUsedOsEventRef=Rte_Ev_OnEntry_OsTask_DcmSessionChanges_Dcm_DcmDiagnosticSessionControl_DcmDiagnosticSessionControl_DEFAULT_SESSION
    CddPeripheralControl_EcuSwComposition (RteSwComponentInstance): RteSoftwareComponentInstanceRef=CddPeripheralControl
      MST_CddPeripheralControl_Init_0 (RteEventToTaskMapping):
        RteImmediateRestart = false
        RtePositionInTask = 20
        RteEventRef = MST_CddPeripheralControl_Init_0
        RteMappedToTaskRef = OsTask_ApplInitDeInit
        RteUsedOsEventRef = Rte_Ev_OnExit_OsTask_ApplInitDeInit_SwcDisplayControl_PpSwcDispCtrlDisplayMode_Mode_UNINIT
      EACddPerCtrlDiagAccess (RteExclusiveAreaImplementation):
        RteExclusiveAreaImplMechanism = OS_RESOURCE
        RteExclusiveAreaRef = EACddPerCtrlDiagAccess
        RteExclusiveAreaOsResourceRef = Rte_Res_CddPeripheralControl_EACddPerCtrlDiagAccess
      13 x RteEventToTaskMapping, all with RteImmediateRestart=false:
        OIT_PpCddPeripheralControlVersionInfo_GetVersionInfo_PpCddPeripheralControlVersionInfo_GetVersionInfo_001: RteEventRef=OIT_PpCddPeripheralControlVersionInfo_GetVersionInfo_PpCddPeripheralControlVersionInfo_GetVersionInfo
        OIT_PpRsCddPerCtrlTriggerWdgReset_Start_PpRsCddPerCtrlTriggerWdgReset_Start: RteEventRef=OIT_PpRsCddPerCtrlTriggerWdgReset_Start_PpRsCddPerCtrlTriggerWdgReset_Start
        OIT_PpRsCddPerCtrlReadI2CDevice_Stop_PpRsCddPerCtrlReadI2CDevice_Stop: RteEventRef=OIT_PpRsCddPerCtrlReadI2CDevice_Stop_PpRsCddPerCtrlReadI2CDevice_Stop
        OIT_PpRsCddPerCtrlReadI2CDevice_Start_PpRsCddPerCtrlReadI2CDevice_Start: RteEventRef=OIT_PpRsCddPerCtrlReadI2CDevice_Start_PpRsCddPerCtrlReadI2CDevice_Start
        OIT_PpRsCddPerCtrlDioControl_Stop_PpRsCddPerCtrlDioControl_Stop: RteEventRef=OIT_PpRsCddPerCtrlDioControl_Stop_PpRsCddPerCtrlDioControl_Stop
        OIT_PpRsCddPerCtrlDioControl_Start_PpRsCddPerCtrlDioControl_Start: RteEventRef=OIT_PpRsCddPerCtrlDioControl_Start_PpRsCddPerCtrlDioControl_Start
        OIT_PpRsCddPerCtrlWriteI2CDevice_Stop_PpRsCddPerCtrlWriteI2CDevice_Stop: RteEventRef=OIT_PpRsCddPerCtrlWriteI2CDevice_Stop_PpRsCddPerCtrlWriteI2CDevice_Stop
        OIT_PpRsCddPerCtrlWriteI2CDevice_Start_PpRsCddPerCtrlWriteI2CDevice_Start: RteEventRef=OIT_PpRsCddPerCtrlWriteI2CDevice_Start_PpRsCddPerCtrlWriteI2CDevice_Start
        OIT_PpRsCddPerCtrlSPIDeviceTransfer_Stop_PpRsCddPerCtrlSPIDeviceTransfer_Stop: RteEventRef=OIT_PpRsCddPerCtrlSPIDeviceTransfer_Stop_PpRsCddPerCtrlSPIDeviceTransfer_Stop
        OIT_PpRsCddPerCtrlSPIDeviceTransfer_Start_PpRsCddPerCtrlSPIDeviceTransfer_Start: RteEventRef=OIT_PpRsCddPerCtrlSPIDeviceTransfer_Start_PpRsCddPerCtrlSPIDeviceTransfer_Start
        OIT_PpRsCddPerCtrlGetADCRawValues_Start_PpRsCddPerCtrlGetADCRawValues_Start: RteEventRef=OIT_PpRsCddPerCtrlGetADCRawValues_Start_PpRsCddPerCtrlGetADCRawValues_Start
        MST_CddPerCtrl_DeInit_0: RtePositionInTask=68, RteEventRef=MST_CddPerCtrl_DeInit_0, RteMappedToTaskRef=OsTask_ApplInitDeInit, RteUsedOsEventRef=Rte_Ev_OnEntry_OsTask_ApplInitDeInit_SwcDisplayControl_PpSwcDispCtrlDisplayMode_Mode_UNINIT
        MST_CddPerCtrl_Init_1: RtePositionInTask=20, RteEventRef=MST_CddPerCtrl_Init_1, RteMappedToTaskRef=OsTask_ApplInitDeInit, RteUsedOsEventRef=Rte_Ev_OnExit_OsTask_ApplInitDeInit_SwcDisplayControl_PpSwcDispCtrlDisplayMode_Mode_OFF
    SwcVerify (RteSwComponentType): RteComponentTypeRef=SwcVerify, RteImplementationRef=SwcVerify_Implementation
      ComponentTypeCalibration (RteComponentTypeCalibration): RteCalibrationSupportEnabled=false
    9 x RteSwComponentInstance:
      CddButton_EcuSwComposition: RteSoftwareComponentInstanceRef=CddButton
        6 x RteEventToTaskMapping, all with RteImmediateRestart=false:
          MST_CddButtonMicrochipAttiny1614_DeInit_0: RtePositionInTask=51, RteEventRef=MST_CddButton_DeInit, RteMappedToTaskRef=OsTask_ApplInitDeInit, RteUsedOsEventRef=Rte_Ev_OnEntry_OsTask_ApplInitDeInit_SwcDisplayControl_PpSwcDispCtrlDisplayMode_Mode_UNINIT
          MST_CddButtonMicrochipAttiny1614_Init_0: RtePositionInTask=15, RteEventRef=MST_CddButton_Init_0, RteMappedToTaskRef=OsTask_ApplInitDeInit, RteUsedOsEventRef=Rte_Ev_OnExit_OsTask_ApplInitDeInit_SwcDisplayControl_PpSwcDispCtrlDisplayMode_Mode_UNINIT
          OIT_PpRsCddButtonButtonStatusSimulation_Start_PpRsCddButtonButtonStatusSimulation_Start: RteEventRef=OIT_PpRsCddButtonButtonStatusSimulation_Start_PpRsCddButtonButtonStatusSimulation_Start
          OIT_PpRsCddButtonButtonStatusSimulation_Stop_PpRsCddButtonButtonStatusSimulation_Stop: RteEventRef=OIT_PpRsCddButtonButtonStatusSimulation_Stop_PpRsCddButtonButtonStatusSimulation_Stop
          OIT_PpCddButtonVersionInfo_GetVersionInfo_PpCddButtonVersionInfo_GetVersionInfo: RteEventRef=OIT_PpCddButtonVersionInfo_GetVersionInfo_PpCddButtonVersionInfo_GetVersionInfo
          MST_CddButton_Init_1: RtePositionInTask=15, RteEventRef=MST_CddButton_Init_1, RteMappedToTaskRef=OsTask_ApplInitDeInit, RteUsedOsEventRef=Rte_Ev_OnExit_OsTask_ApplInitDeInit_SwcDisplayControl_PpSwcDispCtrlDisplayMode_Mode_OFF
      SwcTouch_EcuSwComposition: RteSoftwareComponentInstanceRef=SwcTouch
        13 x RteEventToTaskMapping, all with RteImmediateRestart=false:
          OIT_PpTouchHidData_Get_PpTouchHidData_Get: RteEventRef=OIT_PpTouchHidData_Get_PpTouchHidData_Get
          OIT_PpSwcTouchVersionInfo_GetVersionInfo_PpSwcTouchVersionInfo_GetVersionInfo: RteEventRef=OIT_PpSwcTouchVersionInfo_GetVersionInfo_PpSwcTouchVersionInfo_GetVersionInfo
          OIT_PpTouchHidMessagePlausibilisation_ActiveDataTransmitting_PpTouchHidMessagePlausibilisation_ActiveDataTransmitting: RteEventRef=OIT_PpTouchHidMessagePlausibilisation_ActiveDataTransmitting_PpTouchHidMessagePlausibilisation_ActiveDataTransmitting
          OIT_PpTouchHidMessagePlausibilisation_CancelActiveData_PpTouchHidMessagePlausibilisation_CancelActiveData: RteEventRef=OIT_PpTouchHidMessagePlausibilisation_CancelActiveData_PpTouchHidMessagePlausibilisation_CancelActiveData
          MSESwcTouchInit_0: RtePositionInTask=30, RteEventRef=MSESwcTouchInit_0, RteUsedOsEventRef=Rte_Ev_OnExit_OsTask_ApplInitDeInit_SwcDisplayControl_PpSwcDispCtrlDisplayMode_Mode_UNINIT, RteMappedToTaskRef=OsTask_ApplInitDeInit
          DRESwcTouchDisplayTouch: RtePositionInTask=1, RteEventRef=DRESwcTouchDisplayTouch, RteUsedOsEventRef=Rte_Ev_OnRx_OsTask_Touch_CddTouchCypressGen7_PpCddTouchDisplayData_fingerData, RteMappedToTaskRef=OsTask_Touch
          DRESwcTouchSliderTouch: RtePositionInTask=3, RteEventRef=DRESwcTouchSliderTouch, RteUsedOsEventRef=Rte_Ev_Run_SwcTouch_SwcTouch_ProcessSliderData, RteMappedToTaskRef=OsTask_Touch
          DRESwcTouchDisplayTouchLO: RtePositionInTask=2, RteEventRef=DRESwcTouchDisplayTouchLO, RteUsedOsEventRef=Rte_Ev_Run_SwcTouch_SwcTouch_ProcessDisplayDataLO, RteMappedToTaskRef=OsTask_Touch
          MSESwcTouchInit_1: RtePositionInTask=30, RteEventRef=MSESwcTouchInit_1, RteUsedOsEventRef=Rte_Ev_OnExit_OsTask_ApplInitDeInit_SwcDisplayControl_PpSwcDispCtrlDisplayMode_Mode_OFF, RteMappedToTaskRef=OsTask_ApplInitDeInit
          OIT_PpSwcTouchHidTxConfirmation_HidTxConfirmation_PpSwcTouchHidTxConfirmation_HidTxConfirmation: RteEventRef=OIT_PpSwcTouchHidTxConfirmation_HidTxConfirmation_PpSwcTouchHidTxConfirmation_HidTxConfirmation
          OIT_PpSwcTouchProperties_SetSliderMode_PpSwcTouchProperties_SetSliderMode: RteEventRef=OIT_PpSwcTouchProperties_SetSliderMode_PpSwcTouchProperties_SetSliderMode
          OIT_PpSwcTouchProperties_GetSliderMode_PpSwcTouchProperties_GetSliderMode: RteEventRef=OIT_PpSwcTouchProperties_GetSliderMode_PpSwcTouchProperties_GetSliderMode
          TESwcTouchMainFunction: RtePositionInTask=0, RteEventRef=TESwcTouchMainFunction, RteMappedToTaskRef=OsTask_Touch, RteUsedOsEventRef=Rte_Ev_Run1_SwcTouch_SwcTouch_MainFunction, RteUsedOsAlarmRef=Rte_Al_TE_SwcTouch_SwcTouch_MainFunction
      CddVoltageMonitor_EcuSwComposition: RteSoftwareComponentInstanceRef=CddVoltageMonitor
        17 x RteEventToTaskMapping, all with RteImmediateRestart=false:
          OIT_PpCddVoltageMonitorVersionInfo_GetVersionInfo_PpCddVoltageMonitorVersionInfo_GetVersionInfo: RteEventRef=OIT_PpCddVoltageMonitorVersionInfo_GetVersionInfo_PpCddVoltageMonitorVersionInfo_GetVersionInfo
          MSECddVoltMonInit_0: RtePositionInTask=18, RteEventRef=MSECddVoltMonInit_0, RteMappedToTaskRef=OsTask_ApplInitDeInit, RteUsedOsEventRef=Rte_Ev_OnExit_OsTask_ApplInitDeInit_SwcDisplayControl_PpSwcDispCtrlDisplayMode_Mode_UNINIT
          TECddVoltMonMainFunction: RtePositionInTask=28, RteEventRef=TECddVoltMonMainFunction, RteMappedToTaskRef=OsTask_ApplMainFunctions, RteUsedOsEventRef=Rte_Ev_Cyclic_OsTask_ApplMainFunctions_0_10ms, RteUsedOsAlarmRef=Rte_Al_TE_OsTask_ApplMainFunctions_0_10ms
          MSECddVoltMonDeinit: RtePositionInTask=50, RteEventRef=MSECddVoltMonDeinit, RteMappedToTaskRef=OsTask_ApplInitDeInit, RteUsedOsEventRef=Rte_Ev_OnEntry_OsTask_ApplInitDeInit_SwcDisplayControl_PpSwcDispCtrlDisplayMode_Mode_UNINIT
          MSECddVoltMonInit_1: RtePositionInTask=18, RteEventRef=MSECddVoltMonInit_1, RteMappedToTaskRef=OsTask_ApplInitDeInit, RteUsedOsEventRef=Rte_Ev_OnExit_OsTask_ApplInitDeInit_SwcDisplayControl_PpSwcDispCtrlDisplayMode_Mode_OFF
          MSECddVoltMonDcmOnEntryDefaultSession: RtePositionInTask=8, RteEventRef=MSECddVoltMonDcmOnEntryDefaultSession, RteMappedToTaskRef=OsTask_DcmSessionChanges, RteUsedOsEventRef=Rte_Ev_Run_CddVoltageMonitor_CddVoltMon_OnEntryDefaultSession
          OIT_PpRsCddVoltMonVoltageControl_RequestResults_PpRsCddVoltMonVoltageControl_RequestResults: RteEventRef=OIT_PpRsCddVoltMonVoltageControl_RequestResults_PpRsCddVoltMonVoltageControl_RequestResults
          OIT_PpRsCddVoltMonVoltageControl_Stop_PpRsCddVoltMonVoltageControl_Stop: RteEventRef=OIT_PpRsCddVoltMonVoltageControl_Stop_PpRsCddVoltMonVoltageControl_Stop
          OIT_PpRsCddVoltMonVoltageControl_Start_PpRsCddVoltMonVoltageControl_Start: RteEventRef=OIT_PpRsCddVoltMonVoltageControl_Start_PpRsCddVoltMonVoltageControl_Start
          OIT_PpDsCddVoltMonMaxBatteryVoltage_WriteData_PpDsCddVoltMonMaxBatteryVoltage_WriteData: RteEventRef=OIT_PpDsCddVoltMonMaxBatteryVoltage_WriteData_PpDsCddVoltMonMaxBatteryVoltage_WriteData
          OIT_PpDsCddVoltMonMaxBatteryVoltage_ConditionCheckRead_PpDsCddVoltMonMaxBatteryVoltage_ConditionCheckRead: RteEventRef=OIT_PpDsCddVoltMonMaxBatteryVoltage_ConditionCheckRead_PpDsCddVoltMonMaxBatteryVoltage_ConditionCheckRead
          OIT_PpDsCddVoltMonMaxBatteryVoltage_ReadData_PpDsCddVoltMonMaxBatteryVoltage_ReadData: RteEventRef=OIT_PpDsCddVoltMonMaxBatteryVoltage_ReadData_PpDsCddVoltMonMaxBatteryVoltage_ReadData
          OIT_PpDsCddVoltMonMinBatteryVoltage_WriteData_PpDsCddVoltMonMinBatteryVoltage_WriteData: RteEventRef=OIT_PpDsCddVoltMonMinBatteryVoltage_WriteData_PpDsCddVoltMonMinBatteryVoltage_WriteData
          OIT_PpDsCddVoltMonMinBatteryVoltage_ConditionCheckRead_PpDsCddVoltMonMinBatteryVoltage_ConditionCheckRead: RteEventRef=OIT_PpDsCddVoltMonMinBatteryVoltage_ConditionCheckRead_PpDsCddVoltMonMinBatteryVoltage_ConditionCheckRead
          OIT_PpDsCddVoltMonMinBatteryVoltage_ReadData_PpDsCddVoltMonMinBatteryVoltage_ReadData: RteEventRef=OIT_PpDsCddVoltMonMinBatteryVoltage_ReadData_PpDsCddVoltMonMinBatteryVoltage_ReadData
          OIT_PpCddVoltMonVBatSimulation_Start_PpCddVoltMonVBatSimulation_Start: RteEventRef=OIT_PpCddVoltMonVBatSimulation_Start_PpCddVoltMonVBatSimulation_Start
          OIT_PpCddVoltMonVBatSimulation_Stop_PpCddVoltMonVBatSimulation_Stop: RteEventRef=OIT_PpCddVoltMonVBatSimulation_Stop_PpCddVoltMonVBatSimulation_Stop
      CddConnectionCheck_EcuSwComposition: RteSoftwareComponentInstanceRef=CddConnectionCheck
        3 x RteEventToTaskMapping, all with RteImmediateRestart=false:
          TMT_CddConnectionCheck_MainFunction: RtePositionInTask=26, RteEventRef=TECddConChkMainFunction, RteMappedToTaskRef=OsTask_ApplMainFunctions, RteUsedOsEventRef=Rte_Ev_Cyclic_OsTask_ApplMainFunctions_0_10ms, RteUsedOsAlarmRef=Rte_Al_TE_OsTask_ApplMainFunctions_0_10ms
          OIT_PpConnectionCheckVersionInfo_GetVersionInfo_PpConnectionCheckVersionInfo_GetVersionInfo: RteEventRef=OIT_PpConnectionCheckVersionInfo_GetVersionInfo_PpConnectionCheckVersionInfo_GetVersionInfo
          OIT_PpDsCddConChkConnectionStatus_ReadData_PpDsCddConChkConnectionStatus_ReadData: RteEventRef=OIT_PpDsCddConChkConnectionStatus_ReadData_PpDsCddConChkConnectionStatus_ReadData
      SwcDimming_EcuSwComposition: RteSoftwareComponentInstanceRef=SwcDimming
        3 x RteEventToTaskMapping, all with RteImmediateRestart=false:
          MST_SwcDimming_Init_0: RtePositionInTask=25, RteEventRef=MSESwcDimInit, RteUsedOsEventRef=Rte_Ev_OnExit_OsTask_ApplInitDeInit_SwcDisplayControl_PpSwcDispCtrlDisplayMode_Mode_UNINIT, RteMappedToTaskRef=OsTask_ApplInitDeInit
          TMT_SwcDimming_MainFunction: RtePositionInTask=14, RteEventRef=TMT_SwcDimming_MainFunction, RteMappedToTaskRef=OsTask_ApplMainFunctions, RteUsedOsEventRef=Rte_Ev_Cyclic_OsTask_ApplMainFunctions_0_1ms, RteUsedOsAlarmRef=Rte_Al_TE_OsTask_ApplMainFunctions_0_1ms
          OIT_PpSwcDimmingVersionInfo_GetVersionInfo_PpSwcDimmingVersionInfo_GetVersionInfo: RteEventRef=OIT_PpSwcDimmingVersionInfo_GetVersionInfo_PpSwcDimmingVersionInfo_GetVersionInfo
        EASwcDimDiagnostics (RteExclusiveAreaImplementation):
          RteExclusiveAreaImplMechanism = OS_RESOURCE
          RteExclusiveAreaRef = EASwcDimDiagnostics
          RteExclusiveAreaOsResourceRef = Rte_Res_SwcDimming_EASwcDimDiagnostics
        30 x RteEventToTaskMapping, all with RteImmediateRestart=false:
          DRESwcDimDeratingLimit: RtePositionInTask=48, RteEventRef=DRESwcDimDeratingLimit, RteMappedToTaskRef=OsTask_ApplMainFunctions, RteUsedOsEventRef=Rte_Ev_Run_SwcDimming_SwcDim_ProcessDeratingLimit
          DRESwcDimDim1Data: RtePositionInTask=49, RteEventRef=DRESwcDimDim1Data, RteMappedToTaskRef=OsTask_ApplMainFunctions, RteUsedOsEventRef=Rte_Ev_Run_SwcDimming_SwcDim_ProcessDim01Data
          DRESwcDimZr01Data: RtePositionInTask=50, RteEventRef=DRESwcDimZr01Data, RteMappedToTaskRef=OsTask_ApplMainFunctions, RteUsedOsEventRef=Rte_Ev_OnRx_OsTask_ApplMainFunctions_DI_Screendesign_oZentralrechner_01_oMIBCAN_be1aac5d_Rx
          OIT_PpRsSwcDimSetDispPwmOutput_Stop_PpRsSwcDimSetDispPwmOutput_Stop: RteEventRef=OIT_PpRsSwcDimSetDispPwmOutput_Stop_PpRsSwcDimSetDispPwmOutput_Stop
          OIT_PpRsSwcDimSetDispPwmOutput_Start_PpRsSwcDimSetDispPwmOutput_Start: RteEventRef=OIT_PpRsSwcDimSetDispPwmOutput_Start_PpRsSwcDimSetDispPwmOutput_Start
          OIT_PpRsSwcDimSetSldrPwmOutput_Stop_PpRsSwcDimSetSldrPwmOutput_Stop: RteEventRef=OIT_PpRsSwcDimSetSldrPwmOutput_Stop_PpRsSwcDimSetSldrPwmOutput_Stop
          OIT_PpRsSwcDimSetSldrPwmOutput_Start_PpRsSwcDimSetSldrPwmOutput_Start: RteEventRef=OIT_PpRsSwcDimSetSldrPwmOutput_Start_PpRsSwcDimSetSldrPwmOutput_Start
          OIT_PpRsSwcDimSetDispLutDay_Start_PpRsSwcDimSetDispLutDay_Start: RteEventRef=OIT_PpRsSwcDimSetDispLutDay_Start_PpRsSwcDimSetDispLutDay_Start
          OIT_PpRsSwcDimSetDispLutNight_Start_PpRsSwcDimSetDispLutNight_Start: RteEventRef=OIT_PpRsSwcDimSetDispLutNight_Start_PpRsSwcDimSetDispLutNight_Start
          OIT_PpRsSwcDimSetSldrLut_Start_PpRsSwcDimSetSldrLut_Start: RteEventRef=OIT_PpRsSwcDimSetSldrLut_Start_PpRsSwcDimSetSldrLut_Start
          OIT_PpRsSwcDimSetDispPwmMin_Start_PpRsSwcDimSetDispPwmMin_Start: RteEventRef=OIT_PpRsSwcDimSetDispPwmMin_Start_PpRsSwcDimSetDispPwmMin_Start
          OIT_PpRsSwcDimSetSldrXsErrorDefault_Start_PpRsSwcDimSetSldrXsErrorDefault_Start: RteEventRef=OIT_PpRsSwcDimSetSldrXsErrorDefault_Start_PpRsSwcDimSetSldrXsErrorDefault_Start
          OIT_PpRsSwcDimSetSldrXtErrorDefault_Start_PpRsSwcDimSetSldrXtErrorDefault_Start: RteEventRef=OIT_PpRsSwcDimSetSldrXtErrorDefault_Start_PpRsSwcDimSetSldrXtErrorDefault_Start
          OIT_PpRsSwcDimSetDispErrorDefault_Start_PpRsSwcDimSetDispErrorDefault_Start: RteEventRef=OIT_PpRsSwcDimSetDispErrorDefault_Start_PpRsSwcDimSetDispErrorDefault_Start
          OIT_PpRsSwcDimSetDispOffsetMultiplier_Start_PpRsSwcDimSetDispOffsetMultiplier_Start: RteEventRef=OIT_PpRsSwcDimSetDispOffsetMultiplier_Start_PpRsSwcDimSetDispOffsetMultiplier_Start
          OIT_PpRsSwcDimSetTauDampUp_Start_PpRsSwcDimSetTauDampUp_Start: RteEventRef=OIT_PpRsSwcDimSetTauDampUp_Start_PpRsSwcDimSetTauDampUp_Start
          OIT_PpRsSwcDimSetTauDampDown_Start_PpRsSwcDimSetTauDampDown_Start: RteEventRef=OIT_PpRsSwcDimSetTauDampDown_Start_PpRsSwcDimSetTauDampDown_Start
          OIT_PpRsSwcDimSetTauDayToNight_Start_PpRsSwcDimSetTauDayToNight_Start: RteEventRef=OIT_PpRsSwcDimSetTauDayToNight_Start_PpRsSwcDimSetTauDayToNight_Start
          OIT_PpRsSwcDimSetTauNightToDay_Start_PpRsSwcDimSetTauNightToDay_Start: RteEventRef=OIT_PpRsSwcDimSetTauNightToDay_Start_PpRsSwcDimSetTauNightToDay_Start
          OIT_PpRsSwcDimSetDispDampInterval_Start_PpRsSwcDimSetDispDampInterval_Start: RteEventRef=OIT_PpRsSwcDimSetDispDampInterval_Start_PpRsSwcDimSetDispDampInterval_Start
          OIT_PpDsSwcDimReadDispDimOutPreOffset_ConditionCheckRead_PpDsSwcDimReadDispDimOutPreOffset_ConditionCheckRead: RteEventRef=OIT_PpDsSwcDimReadDispDimOutPreOffset_ConditionCheckRead_PpDsSwcDimReadDispDimOutPreOffset_ConditionCheckRead
          OIT_PpDsSwcDimReadDispDimOutPreOffset_ReadData_PpDsSwcDimReadDispDimOutPreOffset_ReadData: RteEventRef=OIT_PpDsSwcDimReadDispDimOutPreOffset_ReadData_PpDsSwcDimReadDispDimOutPreOffset_ReadData
          OIT_PpDsSwcDimReadDispDimOutPostOffset_ConditionCheckRead_PpDsSwcDimReadDispDimOutPostOffset_ConditionCheckRead: RteEventRef=OIT_PpDsSwcDimReadDispDimOutPostOffset_ConditionCheckRead_PpDsSwcDimReadDispDimOutPostOffset_ConditionCheckRead
          OIT_PpDsSwcDimReadDispDimOutPostOffset_ReadData_PpDsSwcDimReadDispDimOutPostOffset_ReadData: RteEventRef=OIT_PpDsSwcDimReadDispDimOutPostOffset_ReadData_PpDsSwcDimReadDispDimOutPostOffset_ReadData
          OIT_PpDsSwcDimReadSldrDimOutPwm_ConditionCheckRead_PpDsSwcDimReadSldrDimOutPwm_ConditionCheckRead: RteEventRef=OIT_PpDsSwcDimReadSldrDimOutPwm_ConditionCheckRead_PpDsSwcDimReadSldrDimOutPwm_ConditionCheckRead
          OIT_PpDsSwcDimReadSldrDimOutPwm_ReadData_PpDsSwcDimReadSldrDimOutPwm_ReadData: RteEventRef=OIT_PpDsSwcDimReadSldrDimOutPwm_ReadData_PpDsSwcDimReadSldrDimOutPwm_ReadData
          OIT_PpDsSwcDimReadDispDimOutPwm_ConditionCheckRead_PpDsSwcDimReadDispDimOutPwm_ConditionCheckRead: RteEventRef=OIT_PpDsSwcDimReadDispDimOutPwm_ConditionCheckRead_PpDsSwcDimReadDispDimOutPwm_ConditionCheckRead
          OIT_PpDsSwcDimReadDispDimOutPwm_ReadData_PpDsSwcDimReadDispDimOutPwm_ReadData: RteEventRef=OIT_PpDsSwcDimReadDispDimOutPwm_ReadData_PpDsSwcDimReadDispDimOutPwm_ReadData
          MST_SwcDim_DeInit_0: RtePositionInTask=73, RteEventRef=MST_SwcDim_DeInit_0, RteMappedToTaskRef=OsTask_ApplInitDeInit, RteUsedOsEventRef=Rte_Ev_OnEntry_OsTask_ApplInitDeInit_SwcDisplayControl_PpSwcDispCtrlDisplayMode_Mode_UNINIT
          MST_SwcDim_Init_0: RtePositionInTask=25, RteEventRef=MST_SwcDim_Init_0, RteUsedOsEventRef=Rte_Ev_OnExit_OsTask_ApplInitDeInit_SwcDisplayControl_PpSwcDispCtrlDisplayMode_Mode_OFF, RteMappedToTaskRef=OsTask_ApplInitDeInit
      SwcTemperatureCorrection_EcuSwComposition: RteSoftwareComponentInstanceRef=SwcTemperatureCorrection
        7 x RteEventToTaskMapping, all with RteImmediateRestart=false:
          MST_SwcTemperatureCorrection_DeInit_0: RtePositionInTask=58, RteEventRef=MST_SwcTemperatureCorrection_DeInit_0, RteMappedToTaskRef=OsTask_ApplInitDeInit, RteUsedOsEventRef=Rte_Ev_OnEntry_OsTask_ApplInitDeInit_SwcDisplayControl_PpSwcDispCtrlDisplayMode_Mode_UNINIT
          MST_SwcTemperatureCorrection_Init_0: RtePositionInTask=29, RteEventRef=MST_SwcTemperatureCorrection_Init_0, RteMappedToTaskRef=OsTask_ApplInitDeInit, RteUsedOsEventRef=Rte_Ev_OnExit_OsTask_ApplInitDeInit_SwcDisplayControl_PpSwcDispCtrlDisplayMode_Mode_UNINIT
          TMT_SwcTemperatureCorrection_MainFunction: RtePositionInTask=0, RteEventRef=TMT_SwcTemperatureCorrection_MainFunction, RteMappedToTaskRef=OsTask_Dimming, RteUsedOsEventRef=Rte_Ev_Run1_SwcTemperatureCorrection_SwcTempCor_MainFunction, RteUsedOsAlarmRef=Rte_Al_TE_SwcTemperatureCorrection_SwcTempCor_MainFunction
          DRT_SwcTemperatureCorrection_SetCorrectionTargets_PpBacklightTemperature_temperature: RtePositionInTask=2, RteEventRef=DRT_SwcTemperatureCorrection_SetCorrectionTargets_PpBacklightTemperature_temperature, RteMappedToTaskRef=OsTask_Dimming, RteUsedOsEventRef=Rte_Ev_Run_SwcTemperatureCorrection_SwcTempCor_ProcessBacklightTemp
          OIT_PpSwcTemperatureCorrectionVersionInfo_GetVersionInfo_PpSwcTemperatureCorrectionVersionInfo_GetVersionInfo: RteEventRef=OIT_PpSwcTemperatureCorrectionVersionInfo_GetVersionInfo_PpSwcTemperatureCorrectionVersionInfo_GetVersionInfo
          OIT_PpSwcTemperatureCorrectionResetToFactorySettings_ResetToFactorySettings_PpSwcTemperatureCorrectionResetToFactorySett8FAF0F68: RteEventRef=OIT_PpSwcTemperatureCorrectionResetToFactorySettings_ResetToFactorySettings_PpSwcTemperatureCorrectionResetToFactorySett8FAF0F68
          MST_SwcTemperatureCorrection_Init_1: RtePositionInTask=29, RteEventRef=MST_SwcTemperatureCorrection_Init_1, RteMappedToTaskRef=OsTask_ApplInitDeInit, RteUsedOsEventRef=Rte_Ev_OnExit_OsTask_ApplInitDeInit_SwcDisplayControl_PpSwcDispCtrlDisplayMode_Mode_OFF
      SwcDisplayControl_EcuSwComposition: RteSoftwareComponentInstanceRef=SwcDisplayControl
        16 x RteEventToTaskMapping, all with RteImmediateRestart=false:
          OIT_PpRsSwcDisplayControl_TestPattern_Stop_PpRsSwcDisplayControl_TestPattern_Stop: RtePositionInTask=26, RteEventRef=MSESwcDispCtrlInit_0, RteMappedToTaskRef=OsTask_ApplInitDeInit, RteUsedOsEventRef=Rte_Ev_OnExit_OsTask_ApplInitDeInit_SwcDisplayControl_PpSwcDispCtrlDisplayMode_Mode_UNINIT
          OIT_PpRsSwcDisplayControl_TestPattern_Start_PpRsSwcDisplayControl_TestPattern_Start: RteEventRef=OIT_PpRsSwcDisplayControl_TestPattern_Start_PpRsSwcDisplayControl_TestPattern_Start
          OIT_PpSwcDisplayControlVersionInfo_GetVersionInfo_PpSwcDisplayControlVersionInfo_GetVersionInfo: RteEventRef=OIT_PpSwcDisplayControlVersionInfo_GetVersionInfo_PpSwcDisplayControlVersionInfo_GetVersionInfo
          DRT_SwcDispCtrl_ProcessZr01Data_PpSwcComRxZr01Data_ZR_State_DU_1: RtePositionInTask=6, RteEventRef=DRESwcDispCtrlZr01Data, RteMappedToTaskRef=OsTask_ApplMainFunctions, RteUsedOsEventRef=Rte_Ev_Run_SwcDisplayControl_SwcDispCtrl_ProcessZr01Data
          TESwcDispCtrlMainFunction: RtePositionInTask=30, RteEventRef=TESwcDispCtrlMainFunction, RteUsedOsAlarmRef=Rte_Al_TE_OsTask_ApplMainFunctions_0_10ms, RteUsedOsEventRef=Rte_Ev_Cyclic_OsTask_ApplMainFunctions_0_10ms, RteMappedToTaskRef=OsTask_ApplMainFunctions
          OIT_PpRsSwcDisplayControl_TestPattern_Stop_PpRsSwcDisplayControl_TestPattern_Stop_001: RteEventRef=OIT_PpRsSwcDisplayControl_TestPattern_Stop_PpRsSwcDisplayControl_TestPattern_Stop
          MSESwcDispCtrlOnExitSldrBacklightEnabled: RtePositionInTask=0, RteEventRef=MSESwcDispCtrlOnExitSldrBacklightEnabled, RteUsedOsEventRef=Rte_Ev_Run_SwcDisplayControl_SwcDispCtrl_OnExitSldrBacklightEnabled, RteMappedToTaskRef=OsTask_ApplMainFunctions
          MSESwcDispCtrlOnEnterSldrBacklightEnabled: RtePositionInTask=3, RteEventRef=MSESwcDispCtrlOnEnterSldrBacklightEnabled, RteUsedOsEventRef=Rte_Ev_Run_SwcDisplayControl_SwcDispCtrl_OnEnterSldrBacklightEnabled, RteMappedToTaskRef=OsTask_ApplMainFunctions
          TESwcDispCtrlModeHandler: RtePositionInTask=20, RteEventRef=TESwcDispCtrlModeHandler, RteUsedOsAlarmRef=Rte_Al_TE_OsTask_ApplMainFunctions_0_10ms, RteUsedOsEventRef=Rte_Ev_Cyclic_OsTask_ApplMainFunctions_0_10ms, RteMappedToTaskRef=OsTask_ApplMainFunctions
          DRESwcDispCtrlBist: RtePositionInTask=37, RteEventRef=DRESwcDispCtrlBist, RteMappedToTaskRef=OsTask_Communication, RteUsedOsEventRef=Rte_Ev_Run_SwcDisplayControl_SwcDispCtrl_ProcessBist
          MSESwcDispCtrlInit_0: RtePositionInTask=26, RteEventRef=MSESwcDispCtrlInit_0, RteMappedToTaskRef=OsTask_ApplInitDeInit, RteUsedOsEventRef=Rte_Ev_OnExit_OsTask_ApplInitDeInit_SwcDisplayControl_PpSwcDispCtrlDisplayMode_Mode_UNINIT
          DRT_SwcDispCtrl_ProcessDim01Data_PpSwcComRxDim01Data_DI_KL_58xs: RtePositionInTask=7, RteEventRef=DRESwcDispCtrlDim1Data, RteMappedToTaskRef=OsTask_ApplMainFunctions, RteUsedOsEventRef=Rte_Ev_Run_SwcDisplayControl_SwcDispCtrl_ProcessDim01Data
          MSESwcDispCtrlOnEnterFullCom: RtePositionInTask=5, RteEventRef=MSESwcDispCtrlOnEnterFullCom, RteUsedOsEventRef=Rte_Ev_OnEntry_OsTask_ApplMainFunctions_ComM_UM_CN_MIBCAN_49695965_currentMode_COMM_FULL_COMMUNICATION, RteMappedToTaskRef=OsTask_ApplMainFunctions
          MSESwcDispCtrlOnExitFullCom: RtePositionInTask=2, RteEventRef=MSESwcDispCtrlOnExitFullCom, RteUsedOsEventRef=Rte_Ev_OnExit_OsTask_ApplMainFunctions_ComM_UM_CN_MIBCAN_49695965_currentMode_COMM_FULL_COMMUNICATION, RteMappedToTaskRef=OsTask_ApplMainFunctions
          MSESwcDispCtrlInit_1: RtePositionInTask=26, RteEventRef=MSESwcDispCtrlInit_1, RteMappedToTaskRef=OsTask_ApplInitDeInit, RteUsedOsEventRef=Rte_Ev_OnExit_OsTask_ApplInitDeInit_SwcDisplayControl_PpSwcDispCtrlDisplayMode_Mode_OFF
          MSESwcDispCtrlOnEnterDefaultSession: RtePositionInTask=9, RteEventRef=MSESwcDispCtrlOnEnterDefaultSession, RteMappedToTaskRef=OsTask_DcmSessionChanges, RteUsedOsEventRef=Rte_Ev_Run_SwcDisplayControl_SwcDispCtrl_OnEnterDefaultSession
      CddTemperatureMonitor_EcuSwComposition: RteSoftwareComponentInstanceRef=CddTemperatureMonitor
        16 x RteEventToTaskMapping, all with RteImmediateRestart=false:
          MST_CddTemperatureMonitor_DeInit_0: RtePositionInTask=53, RteEventRef=MSECddTempMonDeinit, RteMappedToTaskRef=OsTask_ApplInitDeInit, RteUsedOsEventRef=Rte_Ev_OnEntry_OsTask_ApplInitDeInit_SwcDisplayControl_PpSwcDispCtrlDisplayMode_Mode_UNINIT
          MST_CddTemperatureMonitor_Init_0: RtePositionInTask=19, RteEventRef=MSECddTempMonInit_0, RteMappedToTaskRef=OsTask_ApplInitDeInit, RteUsedOsEventRef=Rte_Ev_OnExit_OsTask_ApplInitDeInit_SwcDisplayControl_PpSwcDispCtrlDisplayMode_Mode_UNINIT
          TMT_CddTemperatureMonitor_MainFunction: RtePositionInTask=27, RteEventRef=TECddTempMonMainFunction, RteMappedToTaskRef=OsTask_ApplMainFunctions, RteUsedOsEventRef=Rte_Ev_Cyclic_OsTask_ApplMainFunctions_0_10ms, RteUsedOsAlarmRef=Rte_Al_TE_OsTask_ApplMainFunctions_0_10ms
          OIT_PpCddTemperatureMonitorVersionInfo_GetVersionInfo_PpCddTemperatureMonitorVersionInfo_GetVersionInfo: RteEventRef=OIT_PpCddTemperatureMonitorVersionInfo_GetVersionInfo_PpCddTemperatureMonitorVersionInfo_GetVersionInfo
          OIT_PpCddTemperatureMonitorResetToFactorySettings_ResetToFactorySettings_PpCddTemperatureMonitorResetToFactorySettings_R39193B1E: RteEventRef=OIT_PpCddTemperatureMonitorResetToFactorySettings_ResetToFactorySettings_PpCddTemperatureMonitorResetToFactorySettings_R39193B1E
          OIT_PpTemperatureSimulation_Stop_PpTemperatureSimulation_Stop: RteEventRef=OIT_PpTemperatureSimulation_Stop_PpTemperatureSimulation_Stop
          OIT_PpTemperatureSimulation_Set_PpTemperatureSimulation_Set: RteEventRef=OIT_PpTemperatureSimulation_Set_PpTemperatureSimulation_Set
          MST_CddTemperatureMonitor_Init_1: RtePositionInTask=19, RteEventRef=MSECddTempMonInit_1, RteMappedToTaskRef=OsTask_ApplInitDeInit, RteUsedOsEventRef=Rte_Ev_OnExit_OsTask_ApplInitDeInit_SwcDisplayControl_PpSwcDispCtrlDisplayMode_Mode_OFF
          MST_CddTemperatureMonitor_OnEntryDcmDefaultSession_0: RtePositionInTask=7, RteEventRef=MSECddTempMonDcmOnEntryDefaultSession, RteMappedToTaskRef=OsTask_DcmSessionChanges, RteUsedOsEventRef=Rte_Ev_OnEntry_OsTask_DcmSessionChanges_Dcm_DcmDiagnosticSessionControl_DcmDiagnosticSessionControl_DEFAULT_SESSION
          OIT_CddTempMon_MaxTemperature_Read_PpDsCddTempMonMaxTemperature_ReadData: RteEventRef=OIT_CddTempMon_MaxTemperature_Read_PpDsCddTempMonMaxTemperature_ReadData
          OIT_CddTempMon_MaxTemperature_Write_PpDsCddTempMonMaxTemperature_WriteData: RteEventRef=OIT_CddTempMon_MaxTemperature_Write_PpDsCddTempMonMaxTemperature_WriteData
          OIT_CddTempMon_MinTemperature_Read_PpDsCddTempMonMinTemperature_ReadData: RteEventRef=OIT_CddTempMon_MinTemperature_Read_PpDsCddTempMonMinTemperature_ReadData
          OIT_CddTempMon_MinTemperature_Write_PpDsCddTempMonMinTemperature_WriteData: RteEventRef=OIT_CddTempMon_MinTemperature_Write_PpDsCddTempMonMinTemperature_WriteData
          OIT_CddTempMon_TempControl_RequestResults_PpRsCddTempMonTemperatureControl_RequestResults: RteEventRef=OIT_CddTempMon_TempControl_RequestResults_PpRsCddTempMonTemperatureControl_RequestResults
          OIT_CddTempMon_TempControl_Start_PpRsCddTempMonTemperatureControl_Start: RteEventRef=OIT_CddTempMon_TempControl_Start_PpRsCddTempMonTemperatureControl_Start
          OIT_CddTempMon_TempControl_Stop_PpRsCddTempMonTemperatureControl_Stop: RteEventRef=OIT_CddTempMon_TempControl_Stop_PpRsCddTempMonTemperatureControl_Stop
      SwcSelfDiagnostics_EcuSwComposition: RteSoftwareComponentInstanceRef=SwcSelfDiagnostics
        22 x RteEventToTaskMapping, all with RteImmediateRestart=false:
          background_event: RtePositionInTask=0, RteEventRef=BESwcSelfDiagCpuLoadBackgroundTicker, RteMappedToTaskRef=OsTask_Background
          MST_SwcSelfDiagnostics_DeInit_0: RtePositionInTask=57, RteEventRef=MSESwcSelfDiagDeInit, RteMappedToTaskRef=OsTask_ApplInitDeInit, RteUsedOsEventRef=Rte_Ev_OnEntry_OsTask_ApplInitDeInit_SwcDisplayControl_PpSwcDispCtrlDisplayMode_Mode_UNINIT
          DRT_SwcSelfDiagnostics_EvaluateBacklightTemperature_PpBacklightTemperature_temperature: RtePositionInTask=2, RteEventRef=DRESwcSelfDiagEvaluateBacklightTemp, RteMappedToTaskRef=OsTask_SelfDiagnostics, RteUsedOsEventRef=Rte_Ev_Run_SwcSelfDiagnostics_SwcSelfDiag_EvaluateBacklightTemp
          DRT_SwcSelfDiagnostics_EvaluateBatteryVoltage_PpBatteryVoltage_voltage: RtePositionInTask=3, RteEventRef=DRESwcSelfDiagEvaluateBatteryVoltage, RteMappedToTaskRef=OsTask_SelfDiagnostics, RteUsedOsEventRef=Rte_Ev_Run_SwcSelfDiagnostics_SwcSelfDiag_EvaluateBatteryVoltage
          MST_SwcSelfDiagnostics_Init_0: RtePositionInTask=27, RteEventRef=MSESwcSelfDiagInit_0, RteMappedToTaskRef=OsTask_ApplInitDeInit, RteUsedOsEventRef=Rte_Ev_OnExit_OsTask_ApplInitDeInit_SwcDisplayControl_PpSwcDispCtrlDisplayMode_Mode_UNINIT
          TMT_SwcSelfDiagnostics_MainFunction: RtePositionInTask=31, RteEventRef=TESwcSelfDiagMainFunction, RteMappedToTaskRef=OsTask_ApplMainFunctions, RteUsedOsEventRef=Rte_Ev_Cyclic_OsTask_ApplMainFunctions_0_10ms, RteUsedOsAlarmRef=Rte_Al_TE_OsTask_ApplMainFunctions_0_10ms
          TMT_SwcSelfDiagnostics_UpdateCpuLoad: RtePositionInTask=0, RteEventRef=TESwcSelfDiagUpdateCpuLoad, RteMappedToTaskRef=OsTask_SelfDiagnostics, RteUsedOsEventRef=Rte_Ev_Run1_SwcSelfDiagnostics_SwcSelfDiag_UpdateCpuLoad, RteUsedOsAlarmRef=Rte_Al_TE_SwcSelfDiagnostics_SwcSelfDiag_UpdateCpuLoad
          TMT_SwcSelfDiagnostics_UpdateRuntime: RtePositionInTask=1, RteEventRef=TESwcSelfDiagUpdateRuntime, RteMappedToTaskRef=OsTask_SelfDiagnostics, RteUsedOsEventRef=Rte_Ev_Run_SwcSelfDiagnostics_SwcSelfDiag_UpdateRuntime, RteUsedOsAlarmRef=Rte_Al_TE_SwcSelfDiagnostics_SwcSelfDiag_UpdateRuntime
          OIT_PpSwcSelfDiagnosticsVersionInfo_GetVersionInfo_PpSwcSelfDiagnosticsVersionInfo_GetVersionInfo: RteEventRef=OIT_PpSwcSelfDiagnosticsVersionInfo_GetVersionInfo_PpSwcSelfDiagnosticsVersionInfo_GetVersionInfo
          OIT_PpSwcSelfDiagnosticsResetToFactorySettings_ResetToFactorySettings_PpSwcSelfDiagnosticsResetToFactorySettings_ResetToF05290DF: RteEventRef=OIT_PpSwcSelfDiagnosticsResetToFactorySettings_ResetToFactorySettings_PpSwcSelfDiagnosticsResetToFactorySettings_ResetToF05290DF
          MST_SwcSelfDiagnostics_Init_1: RtePositionInTask=27, RteEventRef=MSESwcSelfDiagInit_1, RteMappedToTaskRef=OsTask_ApplInitDeInit, RteUsedOsEventRef=Rte_Ev_OnExit_OsTask_ApplInitDeInit_SwcDisplayControl_PpSwcDispCtrlDisplayMode_Mode_OFF
          OIT_PpRsSwcSelfDiagStackUsage_Start_PpRsSwcSelfDiagStackUsage_Start: RteEventRef=OIT_PpRsSwcSelfDiagStackUsage_Start_PpRsSwcSelfDiagStackUsage_Start
          OIT_PpRsSwcSelfDiagAverageCpuLoad_RequestResults_PpRsSwcSelfDiagAverageCpuLoad_RequestResults: RteEventRef=OIT_PpRsSwcSelfDiagAverageCpuLoad_RequestResults_PpRsSwcSelfDiagAverageCpuLoad_RequestResults
          OIT_PpRsSwcSelfDiagAverageCpuLoad_Stop_PpRsSwcSelfDiagAverageCpuLoad_Stop: RteEventRef=OIT_PpRsSwcSelfDiagAverageCpuLoad_Stop_PpRsSwcSelfDiagAverageCpuLoad_Stop
          OIT_PpRsSwcSelfDiagAverageCpuLoad_Start_PpRsSwcSelfDiagAverageCpuLoad_Start: RteEventRef=OIT_PpRsSwcSelfDiagAverageCpuLoad_Start_PpRsSwcSelfDiagAverageCpuLoad_Start
          OIT_PpDsSwcSelfDiagEcuRuntime_WriteData_PpDsSwcSelfDiagEcuRuntime_WriteData: RteEventRef=OIT_PpDsSwcSelfDiagEcuRuntime_WriteData_PpDsSwcSelfDiagEcuRuntime_WriteData
          OIT_PpDsSwcSelfDiagEcuRuntime_ConditionCheckRead_PpDsSwcSelfDiagEcuRuntime_ConditionCheckRead: RteEventRef=OIT_PpDsSwcSelfDiagEcuRuntime_ConditionCheckRead_PpDsSwcSelfDiagEcuRuntime_ConditionCheckRead
          OIT_PpDsSwcSelfDiagEcuRuntime_ReadData_PpDsSwcSelfDiagEcuRuntime_ReadData: RteEventRef=OIT_PpDsSwcSelfDiagEcuRuntime_ReadData_PpDsSwcSelfDiagEcuRuntime_ReadData
          DRESwcSelfDiagEvaluateBlTempDeratingLimit: RtePositionInTask=4, RteEventRef=DRESwcSelfDiagEvaluateBlTempDeratingLimit, RteMappedToTaskRef=OsTask_SelfDiagnostics, RteUsedOsEventRef=Rte_Ev_Run_SwcSelfDiagnostics_SwcSelfDiag_EvaluateBlTempDeratingLimit
          OIT_SwcSelfDiag_CpuLoad_CheckRead_PpDsSwcSelfDiagCpuLoad_ConditionCheckRead: RteEventRef=OIT_SwcSelfDiag_CpuLoad_CheckRead_PpDsSwcSelfDiagCpuLoad_ConditionCheckRead
          OIT_SwcSelfDiag_CpuLoad_Read_PpDsSwcSelfDiagCpuLoad_ReadData: RteEventRef=OIT_SwcSelfDiag_CpuLoad_Read_PpDsSwcSelfDiagCpuLoad_ReadData
          OIT_SwcSelfDiag_CpuLoad_Write_PpDsSwcSelfDiagCpuLoad_WriteData: RteEventRef=OIT_SwcSelfDiag_CpuLoad_Write_PpDsSwcSelfDiagCpuLoad_WriteData
    10 x RteSwComponentType:
      CddConnectionCheck: RteComponentTypeRef=CddConnectionCheck, RteImplementationRef=CddConnectionCheck_Implementation
        ComponentTypeCalibration (RteComponentTypeCalibration): RteCalibrationSupportEnabled=false
      SwcTemperatureCorrection: RteComponentTypeRef=SwcTemperatureCorrection, RteImplementationRef=SwcTemperatureCorrection_Implementation
        ComponentTypeCalibration (RteComponentTypeCalibration): RteCalibrationSupportEnabled=false
      SwcSelfDiagnostics: RteComponentTypeRef=SwcSelfDiagnostics, RteImplementationRef=SwcSelfDiagnostics_Implementation
        ComponentTypeCalibration (RteComponentTypeCalibration): RteCalibrationSupportEnabled=false
      SwcDimming: RteComponentTypeRef=SwcDimming, RteImplementationRef=SwcDimming_Implementation
        ComponentTypeCalibration (RteComponentTypeCalibration): RteCalibrationSupportEnabled=false
      CddPeripheralControl: RteComponentTypeRef=CddPeripheralControl, RteImplementationRef=CddPeripheralControl_Implementation
        ComponentTypeCalibration (RteComponentTypeCalibration): RteCalibrationSupportEnabled=false
      SwcDisplayControl: RteComponentTypeRef=SwcDisplayControl, RteImplementationRef=SwcDisplayControl_Implementation
        ComponentTypeCalibration (RteComponentTypeCalibration): RteCalibrationSupportEnabled=false
      CddVoltageMonitor: RteComponentTypeRef=CddVoltageMonitor, RteImplementationRef=CddVoltageMonitor_Implementation
        ComponentTypeCalibration (RteComponentTypeCalibration): RteCalibrationSupportEnabled=false
      CddTemperatureMonitor: RteComponentTypeRef=CddTemperatureMonitor, RteImplementationRef=CddTemperatureMonitor_Implementation
        ComponentTypeCalibration (RteComponentTypeCalibration): RteCalibrationSupportEnabled=false
      CddButton: RteComponentTypeRef=CddButton, RteImplementationRef=CddButton_Implementation
        ComponentTypeCalibration (RteComponentTypeCalibration): RteCalibrationSupportEnabled=false
      SwcTouch: RteComponentTypeRef=SwcTouch, RteImplementationRef=SwcTouch_Implementation
        ComponentTypeCalibration (RteComponentTypeCalibration): RteCalibrationSupportEnabled=false
    4 x RteSwComponentInstance:
      CddComIf_EcuSwComposition: RteSoftwareComponentInstanceRef=CddComIf
        10 x RteEventToTaskMapping, all with RteImmediateRestart=false:
          MST_CddComIf_DeInit_0: RtePositionInTask=55, RteEventRef=MST_CddComIf_DeInit_0, RteMappedToTaskRef=OsTask_ApplInitDeInit, RteUsedOsEventRef=Rte_Ev_OnEntry_OsTask_ApplInitDeInit_SwcDisplayControl_PpSwcDispCtrlDisplayMode_Mode_UNINIT
          MST_CddComIf_Init_0: RtePositionInTask=21, RteEventRef=MST_CddComIf_Init_0, RteMappedToTaskRef=OsTask_ApplInitDeInit, RteUsedOsEventRef=Rte_Ev_OnExit_OsTask_ApplInitDeInit_SwcDisplayControl_PpSwcDispCtrlDisplayMode_Mode_UNINIT
          TMT_CddComIf_MainFunction: RtePositionInTask=25, RteEventRef=TMT_CddComIf_MainFunction, RteMappedToTaskRef=OsTask_ApplMainFunctions, RteUsedOsEventRef=Rte_Ev_Cyclic_OsTask_ApplMainFunctions_0_10ms, RteUsedOsAlarmRef=Rte_Al_TE_OsTask_ApplMainFunctions_0_10ms
          OIT_PpCddComIfVersionInfo_GetVersionInfo_PpCddComIfVersionInfo_GetVersionInfo: RteEventRef=OIT_PpCddComIfVersionInfo_GetVersionInfo_PpCddComIfVersionInfo_GetVersionInfo
          MST_CddComIf_Init_1: RtePositionInTask=21, RteEventRef=MST_CddComIf_Init_1, RteMappedToTaskRef=OsTask_ApplInitDeInit, RteUsedOsEventRef=Rte_Ev_OnExit_OsTask_ApplInitDeInit_SwcDisplayControl_PpSwcDispCtrlDisplayMode_Mode_OFF
          OIT_PpCddComIfTransmit_Transmit_PpCddComIfTransmit_Transmit: RteEventRef=OIT_PpCddComIfTransmit_Transmit_PpCddComIfTransmit_Transmit
          MST_CddComIf_OnEnterFullCom_0: RtePositionInTask=69, RteEventRef=MST_CddComIf_OnEnterFullCom_0, RteMappedToTaskRef=OsTask_ApplMainFunctions, RteUsedOsEventRef=Rte_Ev_OnEntry_OsTask_ApplMainFunctions_ComM_UM_CN_MIBCAN_49695965_currentMode_COMM_FULL_COMMUNICATION
          MST_CddComIf_OnEnterNoCom_0: RtePositionInTask=72, RteEventRef=MST_CddComIf_OnEnterNoCom_0, RteMappedToTaskRef=OsTask_ApplMainFunctions, RteUsedOsEventRef=Rte_Ev_OnEntry_OsTask_ApplMainFunctions_ComM_UM_CN_MIBCAN_49695965_currentMode_COMM_NO_COMMUNICATION
          MST_CddComIf_OnExitFullCom_0: RtePositionInTask=64, RteEventRef=MST_CddComIf_OnExitFullCom_0, RteMappedToTaskRef=OsTask_ApplMainFunctions, RteUsedOsEventRef=Rte_Ev_OnExit_OsTask_ApplMainFunctions_ComM_UM_CN_MIBCAN_49695965_currentMode_COMM_FULL_COMMUNICATION
          MST_Runnable_0: RtePositionInTask=66, RteEventRef=MST_Runnable_0, RteMappedToTaskRef=OsTask_ApplMainFunctions, RteUsedOsEventRef=Rte_Ev_OnExit_OsTask_ApplMainFunctions_ComM_UM_CN_MIBCAN_49695965_currentMode_COMM_NO_COMMUNICATION
      SwcComHandlerTx_EcuSwComposition: RteSoftwareComponentInstanceRef=SwcComHandlerTx
        9 x RteEventToTaskMapping, all with RteImmediateRestart=false:
          OIT_PpHid_DataAvailable_PpHid_DataAvailable: RteEventRef=OIT_PpHid_DataAvailable_PpHid_DataAvailable
          TMT_SwcComHandlerTx_MainFunction: RtePositionInTask=32, RteEventRef=TMT_SwcComHandlerTx_MainFunction, RteMappedToTaskRef=OsTask_ApplMainFunctions, RteUsedOsEventRef=Rte_Ev_Cyclic_OsTask_ApplMainFunctions_0_1ms, RteUsedOsAlarmRef=Rte_Al_TE_OsTask_ApplMainFunctions_0_1ms
          OIT_PpSwcComHandlerTxVersionInfo_GetVersionInfo_PpSwcComHandlerTxVersionInfo_GetVersionInfo: RteEventRef=OIT_PpSwcComHandlerTxVersionInfo_GetVersionInfo_PpSwcComHandlerTxVersionInfo_GetVersionInfo
          MST_SwcComHandlerTx_ProcessDispCtrlChange_0: RtePositionInTask=33, RteEventRef=MST_SwcComHandlerTx_ProcessDispCtrlChange_0, RteMappedToTaskRef=OsTask_Communication, RteUsedOsEventRef=Rte_Ev_OnEntry_OsTask_Communication_SwcDisplayControl_PpSwcDispCtrlModeSwitch_mode_SWCDISPCTRL_OPMODE_ABTLOCAL
          DRT_SwcComTx_ProcessWakeupReason_PpCddWUDetWakeupReason_wakeupReason: RtePositionInTask=35, RteEventRef=DRT_SwcComTx_ProcessWakeupReason_PpCddWUDetWakeupReason_wakeupReason, RteMappedToTaskRef=OsTask_Communication, RteUsedOsEventRef=Rte_Ev_Run_SwcComHandlerTx_SwcComTx_ProcessWakeupReason
          OIT_PpSwcComTxIfTxConfirmation_IfTxConfirmation_PpSwcComTxIfTxConfirmation_IfTxConfirmation: RteEventRef=OIT_PpSwcComTxIfTxConfirmation_IfTxConfirmation_PpSwcComTxIfTxConfirmation_IfTxConfirmation
          OIT_PpSwcComTxTpTxConfirmation_TpTxConfirmation_PpSwcComTxTpTxConfirmation_TpTxConfirmation: RteEventRef=OIT_PpSwcComTxTpTxConfirmation_TpTxConfirmation_PpSwcComTxTpTxConfirmation_TpTxConfirmation
          OIT_PpSwcComTxIfDataAvailable_IfDataAvailable_PpSwcComTxIfDataAvailable_IfDataAvailable: RteEventRef=OIT_PpSwcComTxIfDataAvailable_IfDataAvailable_PpSwcComTxIfDataAvailable_IfDataAvailable
          MST_SwcComHandlerTx_Init_1: RtePositionInTask=32, RteEventRef=MST_SwcComHandlerTx_Init_1, RteMappedToTaskRef=OsTask_ApplInitDeInit, RteUsedOsEventRef=Rte_Ev_OnExit_OsTask_ApplInitDeInit_SwcDisplayControl_PpSwcDispCtrlDisplayMode_Mode_OFF
        EASwcComTxCmdQueueAccess (RteExclusiveAreaImplementation):
          RteExclusiveAreaImplMechanism = OS_RESOURCE
          RteExclusiveAreaRef = EASwcComTxCmdQueueAccess
          RteExclusiveAreaOsResourceRef = Rte_Res_SwcComHandlerTx_EASwcComTxCmdQueueAccess
        6 x RteEventToTaskMapping, all with RteImmediateRestart=false:
          MST_SwcComHandlerTx_Init_0: RtePositionInTask=32, RteEventRef=MST_SwcComHandlerTx_Init_0, RteMappedToTaskRef=OsTask_ApplInitDeInit, RteUsedOsEventRef=Rte_Ev_OnExit_OsTask_ApplInitDeInit_SwcDisplayControl_PpSwcDispCtrlDisplayMode_Mode_UNINIT
          MST_SwcComHandlerTx_DeInit_0: RtePositionInTask=60, RteEventRef=MST_SwcComHandlerTx_DeInit_0, RteMappedToTaskRef=OsTask_ApplInitDeInit, RteUsedOsEventRef=Rte_Ev_OnEntry_OsTask_ApplInitDeInit_SwcDisplayControl_PpSwcDispCtrlDisplayMode_Mode_UNINIT
          OIT_PpSwcComTxTpDataAvailable_TpDataAvailable_PpSwcComTxTpDataAvailable_TpDataAvailable: RteEventRef=OIT_PpSwcComTxTpDataAvailable_TpDataAvailable_PpSwcComTxTpDataAvailable_TpDataAvailable
          OIT_SwcComTx_CheckReadEepromWriteCounter_PpDsSwcComTxPropEepromWriteCounter_ConditionCheckRead: RteEventRef=OIT_SwcComTx_CheckReadEepromWriteCounter_PpDsSwcComTxPropEepromWriteCounter_ConditionCheckRead
          OIT_SwcComTx_WriteEepromWriteCounter_PpDsSwcComTxPropEepromWriteCounter_WriteData: RteEventRef=OIT_SwcComTx_WriteEepromWriteCounter_PpDsSwcComTxPropEepromWriteCounter_WriteData
          OIT_SwcComTx_ReadEepromWriteCounter_PpDsSwcComTxPropEepromWriteCounter_ReadData: RteEventRef=OIT_SwcComTx_ReadEepromWriteCounter_PpDsSwcComTxPropEepromWriteCounter_ReadData
      SwcComHandlerRx_EcuSwComposition: RteSoftwareComponentInstanceRef=SwcComHandlerRx
        11 x RteEventToTaskMapping, all with RteImmediateRestart=false:
          OIT_PpComHandlerRxHidData_Get_PpComHandlerRxHidData_Get: RteEventRef=OIT_PpComHandlerRxHidData_Get_PpComHandlerRxHidData_Get
          MSESwcComRxDeInit: RtePositionInTask=59, RteEventRef=MSESwcComRxDeInit, RteMappedToTaskRef=OsTask_ApplInitDeInit, RteUsedOsEventRef=Rte_Ev_OnEntry_OsTask_ApplInitDeInit_SwcDisplayControl_PpSwcDispCtrlDisplayMode_Mode_UNINIT
          TESwcComRxMainFunction: RtePositionInTask=34, RteEventRef=TESwcComRxMainFunction, RteMappedToTaskRef=OsTask_ApplMainFunctions, RteUsedOsEventRef=Rte_Ev_Cyclic_OsTask_ApplMainFunctions_0_10ms, RteUsedOsAlarmRef=Rte_Al_TE_OsTask_ApplMainFunctions_0_10ms
          OIT_PpSwcComHandlerRxVersionInfo_GetVersionInfo_PpSwcComHandlerRxVersionInfo_GetVersionInfo: RteEventRef=OIT_PpSwcComHandlerRxVersionInfo_GetVersionInfo_PpSwcComHandlerRxVersionInfo_GetVersionInfo
          DRESwcComRxZrPlatform: RtePositionInTask=79, RteEventRef=DRESwcComRxZrPlatform, RteMappedToTaskRef=OsTask_ApplMainFunctions, RteUsedOsEventRef=Rte_Ev_Run1_SwcComHandlerRx_SwcComRx_ProcessZrPlatform
          MSESwcComRxAbtLocalMode: RtePositionInTask=13, RteEventRef=MSESwcComRxAbtLocalMode, RteMappedToTaskRef=OsTask_Communication, RteUsedOsEventRef=Rte_Ev_OnEntry_OsTask_Communication_SwcDisplayControl_PpSwcDispCtrlModeSwitch_mode_SWCDISPCTRL_OPMODE_ABTLOCAL
          OIT_PpCddComTpRxIndication_Transmit_PpCddComTpRxIndication_Transmit: RteEventRef=OIT_PpCddComTpRxIndication_Transmit_PpCddComTpRxIndication_Transmit
          MSESwcComRxInit: RtePositionInTask=31, RteEventRef=MSESwcComRxInit, RteMappedToTaskRef=OsTask_ApplInitDeInit, RteUsedOsEventRef=Rte_Ev_OnEntry_OsTask_ApplInitDeInit_SwcDisplayControl_PpSwcDispCtrlDisplayMode_Mode_INIT
          DRESwcComRxWakeupReason: RtePositionInTask=78, RteEventRef=DRESwcComRxWakeupReason, RteMappedToTaskRef=OsTask_ApplMainFunctions, RteUsedOsEventRef=Rte_Ev_Run_SwcComHandlerRx_SwcComRx_ProcessWakeupReason
          DRESwcComRxZr01: RtePositionInTask=67, RteEventRef=DRESwcComRxZr01, RteMappedToTaskRef=OsTask_ApplMainFunctions, RteUsedOsEventRef=Rte_Ev_OnRx_OsTask_ApplMainFunctions_DI_Screendesign_oZentralrechner_01_oMIBCAN_be1aac5d_Rx
          TESwcComRxWakeUpReasonTimeout: RtePositionInTask=71, RteCyclicTriggerImplementation=None, RteEventRef=TESwcComRxWakeUpReasonTimeout, RteMappedToTaskRef=OsTask_ApplMainFunctions, RteUsedOsEventRef=Rte_Ev_Run1_SwcComHandlerRx_SwcComRx_WakeupReasonTimeout
      CddComTp_EcuSwComposition: RteSoftwareComponentInstanceRef=CddComTp
        5 x RteEventToTaskMapping, all with RteImmediateRestart=false:
          MST_CddComTp_DeInit_0: RtePositionInTask=56, RteEventRef=MST_CddComTp_DeInit_0, RteMappedToTaskRef=OsTask_ApplInitDeInit, RteUsedOsEventRef=Rte_Ev_OnEntry_OsTask_ApplInitDeInit_SwcDisplayControl_PpSwcDispCtrlDisplayMode_Mode_UNINIT
          MST_CddComTp_Init_0: RtePositionInTask=22, RteEventRef=MST_CddComTp_Init_0, RteMappedToTaskRef=OsTask_ApplInitDeInit, RteUsedOsEventRef=Rte_Ev_OnExit_OsTask_ApplInitDeInit_SwcDisplayControl_PpSwcDispCtrlDisplayMode_Mode_UNINIT
          TMT_CddComTp_MainFunction: RtePositionInTask=15, RteEventRef=TMT_CddComTp_MainFunction, RteMappedToTaskRef=OsTask_ApplMainFunctions, RteUsedOsEventRef=Rte_Ev_Cyclic_OsTask_ApplMainFunctions_0_1ms, RteUsedOsAlarmRef=Rte_Al_TE_OsTask_ApplMainFunctions_0_1ms
          OIT_PpCddComTpVersionInfo_GetVersionInfo_PpCddComTpVersionInfo_GetVersionInfo: RteEventRef=OIT_PpCddComTpVersionInfo_GetVersionInfo_PpCddComTpVersionInfo_GetVersionInfo
          OIT_PpCddComTpTransmit_Transmit_PpCddComTpTransmit_Transmit: RtePositionInTask=2, RteEventRef=OIT_PpCddComTpTransmit_Transmit_PpCddComTpTransmit_Transmit, RteMappedToTaskRef=OsTask_Communication, RteUsedOsEventRef=Rte_Ev_Run_CddComTp_CddComTp_Transmit
        EACddComTpBuffers (RteExclusiveAreaImplementation): RteExclusiveAreaImplMechanism=ALL_INTERRUPT_BLOCKING, RteExclusiveAreaRef=EACddComTpBuffers
        5 x RteEventToTaskMapping, all with RteImmediateRestart=false:
          MST_CddComTp_Init_1: RtePositionInTask=22, RteEventRef=MST_CddComTp_Init_1, RteMappedToTaskRef=OsTask_ApplInitDeInit, RteUsedOsEventRef=Rte_Ev_OnExit_OsTask_ApplInitDeInit_SwcDisplayControl_PpSwcDispCtrlDisplayMode_Mode_OFF
          MSECddComTpOnEnterFullCom: RtePositionInTask=60, RteEventRef=MSECddComTpOnEnterFullCom, RteMappedToTaskRef=OsTask_ApplMainFunctions, RteUsedOsEventRef=Rte_Ev_OnEntry_OsTask_ApplMainFunctions_ComM_UM_CN_MIBCAN_49695965_currentMode_COMM_FULL_COMMUNICATION
          MSECddComTpOnExitFullCom: RtePositionInTask=58, RteEventRef=MSECddComTpOnExitFullCom, RteMappedToTaskRef=OsTask_ApplMainFunctions, RteUsedOsEventRef=Rte_Ev_OnExit_OsTask_ApplMainFunctions_ComM_UM_CN_MIBCAN_49695965_currentMode_COMM_FULL_COMMUNICATION
          MSECddComTpOnEnterNoCom: RtePositionInTask=61, RteEventRef=MSECddComTpOnEnterNoCom, RteMappedToTaskRef=OsTask_ApplMainFunctions, RteUsedOsEventRef=Rte_Ev_OnEntry_OsTask_ApplMainFunctions_ComM_UM_CN_MIBCAN_49695965_currentMode_COMM_NO_COMMUNICATION
          MST_CddComTp_OnExitNoCom_0: RtePositionInTask=59, RteEventRef=MST_CddComTp_OnExitNoCom_0, RteMappedToTaskRef=OsTask_ApplMainFunctions, RteUsedOsEventRef=Rte_Ev_OnExit_OsTask_ApplMainFunctions_ComM_UM_CN_MIBCAN_49695965_currentMode_COMM_NO_COMMUNICATION
    4 x RteSwComponentType:
      SwcComHandlerTx: RteComponentTypeRef=SwcComHandlerTx, RteImplementationRef=SwcComHandlerTx_Implementation
        ComponentTypeCalibration (RteComponentTypeCalibration): RteCalibrationSupportEnabled=false
      CddComTp: RteComponentTypeRef=CddComTp, RteImplementationRef=CddComTp_Implementation
        ComponentTypeCalibration (RteComponentTypeCalibration): RteCalibrationSupportEnabled=false
      SwcComHandlerRx: RteComponentTypeRef=SwcComHandlerRx, RteImplementationRef=SwcComHandlerRx_Implementation
        ComponentTypeCalibration (RteComponentTypeCalibration): RteCalibrationSupportEnabled=false
      CddComIf: RteComponentTypeRef=CddComIf, RteImplementationRef=CddComIf_Implementation
        ComponentTypeCalibration (RteComponentTypeCalibration): RteCalibrationSupportEnabled=false
    ComM_EcuSwComposition (RteSwComponentInstance): RteSoftwareComponentInstanceRef=ComM
      13 x RteEventToTaskMapping, all with RteImmediateRestart=false:
        Timer_ComM_MainFunction_0: RtePositionInTask=17, RteEventRef=Timer_ComM_MainFunction_0, RteMappedToTaskRef=OsTask_BswMainFunctions, RteUsedOsEventRef=Rte_Ev_Cyclic2_OsTask_BswMainFunctions_0_20ms, RteUsedOsAlarmRef=Rte_Al_TE2_OsTask_BswMainFunctions_0_20ms
        OpEventLimitECUToNoComMode_LimitECUToNoComMode_modeLimitation: RteEventRef=OpEventLimitECUToNoComMode_LimitECUToNoComMode_modeLimitation
        OpEventReadInhibitCounter_ReadInhibitCounter_modeLimitation: RteEventRef=OpEventReadInhibitCounter_ReadInhibitCounter_modeLimitation
        OpEventResetInhibitCounter_ResetInhibitCounter_modeLimitation: RteEventRef=OpEventResetInhibitCounter_ResetInhibitCounter_modeLimitation
        OpEventSetECUGroupClassification_SetECUGroupClassification_modeLimitation: RteEventRef=OpEventSetECUGroupClassification_SetECUGroupClassification_modeLimitation
        OpEventRequestComMode_RequestComMode_UR_CN_MIBCAN_49695965: RteEventRef=OpEventRequestComMode_RequestComMode_UR_CN_MIBCAN_49695965
        OpEventPreventWakeUp_PreventWakeUp_CW_CN_MIBCAN_0d25aee7: RteEventRef=OpEventPreventWakeUp_PreventWakeUp_CW_CN_MIBCAN_0d25aee7
        OpEventGetCurrentComMode_GetCurrentComMode_UR_CN_MIBCAN_49695965: RteEventRef=OpEventGetCurrentComMode_GetCurrentComMode_UR_CN_MIBCAN_49695965
        OpEventGetMaxComMode_GetMaxComMode_UR_CN_MIBCAN_49695965: RteEventRef=OpEventGetMaxComMode_GetMaxComMode_UR_CN_MIBCAN_49695965
        OpEventGetInhibitionStatus_GetInhibitionStatus_CL_CN_MIBCAN_0d25aee7: RteEventRef=OpEventGetInhibitionStatus_GetInhibitionStatus_CL_CN_MIBCAN_0d25aee7
        OpEventGetInhibitionStatus_GetInhibitionStatus_CW_CN_MIBCAN_0d25aee7: RteEventRef=OpEventGetInhibitionStatus_GetInhibitionStatus_CW_CN_MIBCAN_0d25aee7
        OpEventGetRequestedComMode_GetRequestedComMode_UR_CN_MIBCAN_49695965: RteEventRef=OpEventGetRequestedComMode_GetRequestedComMode_UR_CN_MIBCAN_49695965
        OpEventLimitChannelToNoComMode_LimitChannelToNoComMode_CL_CN_MIBCAN_0d25aee7: RteEventRef=OpEventLimitChannelToNoComMode_LimitChannelToNoComMode_CL_CN_MIBCAN_0d25aee7
