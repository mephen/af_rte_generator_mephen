AUTOSAR XML (schema 00048)
package /ActiveEcuC
  module config Os: implementation-config-variant=VARIANT-PRE-COMPILE, module-description=Os_Impl  # Requirements PLAIN_TEXT ABTE-SWREQ-3273 ABTE-SWREQ-3274
    OsCounter_1ms (OsCounter):
      OsCounterMaxAllowedValue = 2147483647
      OsCounterMinCycle = 1
      OsCounterType = HARDWARE
      OsSecondsPerTick = 0.001
      OsCounterTicksPerBase = 60000
      OsCounterAccessingApplication = SystemApplication_OsCore0
      OsDriver: OsDriverHighResolution=false, OsDriverHardwareTimerChannelRef=OSTM0/OSTM0, OsDriverIsrRef=CounterIsr_SystemTimer
    OsOS:
      OsStackMonitoring = true
      OsStatus = EXTENDED
      OsUseGetServiceId = false
      OsUseParameterAccess = false
      OsUseResScheduler = false
      OsForcibleTermination = false
      OsGenerateCalloutStubs = true
      OsGenerateMemMap = COMPLETE
      OsGenerateMemMapForNearAddressing = true
      OsGenerateMemMapForThreads = false
      OsServiceProtection = false
      OsStackUsageMeasurement = true
      OsUseXSignalAsyncApiCalls = false
      OsFpuUsage = NONE
      OsScalabilityClass = SC1
      OsNumberOfCores = 1
      OsUseCase = STANDARD
      OsMasterCore = OsCore0
      OsSystemTimer = OsCounter_1ms
      OsHooks: OsErrorHook=true, OsPostTaskHook=false, OsPreTaskHook=false, OsShutdownHook=true, OsStartupHook=false
      OsStackSummary
        20 x OsStack, all with OsStackCore=OsCore0:
          OsCore0_Error: OsStackSize=1024, OsStackType=CORE_ERROR_STACK, OsStackUser=OsCore0
          OsCore0_Init: OsStackSize=1024, OsStackType=CORE_INIT_STACK, OsStackUser=OsCore0
          OsCore0_Kernel: OsStackSize=1024, OsStackType=CORE_KERNEL_STACK, OsStackUser=OsCore0
          OsCore0_Isr_Core: OsStackSize=2048, OsStackType=ISR_SHARED_CORE_STACK, OsStackUser=CounterIsr_SystemTimer, OsStackUser=INTIIC0EE, OsStackUser=INTIIC0RI, OsStackUser=INTIIC0TEI, OsStackUser=ADC0_SG1_CAT2_ISR, OsStackUser=CanIsrStatus_0, OsStackUser=CanIsrTx_0, OsStackUser=EXT_INTP_CH07_CAT2_ISR, OsStackUser=SPI_CSIH0_TIR_CAT2_ISR, OsStackUser=SPI_CSIH3_TIR_CAT2_ISR, OsStackUser=WDG_59_DRIVERA_TRIGGERFUNCTION_CAT2_ISR, OsStackUser=SPI_CSIH2_TIR_CAT2_ISR, OsStackUser=EXT_INTP_CH03_CAT2_ISR, OsStackUser=TAUD0_CH00_CAT2_ISR, OsStackUser=IRQDmaChannel2TransmitComplete, OsStackUser=IRQDmaChannel5TransmitComplete, OsStackUser=IRQDmaChannel5ReceiveComplete, OsStackUser=TAUD0_CH02_CAT2_ISR, OsStackUser=TAUD0_CH04_CAT2_ISR, OsStackUser=TAUD0_CH01_CAT2_ISR, OsStackUser=CanIsrGlobalRxFifo_0, OsStackUser=CounterIsr_OsCounter_10ms, OsStackUser=ADC1_SG1_CAT2_ISR
          OsCore0_Task_Prio4294967295: OsStackSize=2048, OsStackType=TASK_SHARED_PRIORITY_STACK, OsStackUser=IdleTask_OsCore0
          OsTask_BswMainFunctions: OsStackSize=2048, OsStackType=TASK_EXTENDED_STACK, OsStackUser=Os/OsTask_BswMainFunctions
          OsCore0_Task_Prio5: OsStackSize=2048, OsStackType=TASK_SHARED_PRIORITY_STACK, OsStackUser=OsTask_Background
          OsCore0_Task_Prio1001: OsStackSize=2048, OsStackType=TASK_SHARED_PRIORITY_STACK, OsStackUser=Default_Init_Task
          OsTask_ApplInitDeInit: OsStackSize=2048, OsStackType=TASK_EXTENDED_STACK, OsStackUser=Os/OsTask_ApplInitDeInit
          OsTask_ApplMainFunctions: OsStackSize=2048, OsStackType=TASK_EXTENDED_STACK, OsStackUser=Os/OsTask_ApplMainFunctions
          OsTask_Communication: OsStackSize=2048, OsStackType=TASK_EXTENDED_STACK, OsStackUser=Os/OsTask_Communication
          OsTask_Dimming: OsStackSize=3072, OsStackType=TASK_EXTENDED_STACK, OsStackUser=Os/OsTask_Dimming
          OsTask_SelfDiagnostics: OsStackSize=2048, OsStackType=TASK_EXTENDED_STACK, OsStackUser=Os/OsTask_SelfDiagnostics
          OsTask_Touch: OsStackSize=2048, OsStackType=TASK_EXTENDED_STACK, OsStackUser=Os/OsTask_Touch
          OsTask_ApplTimedInitDeInit: OsStackSize=2048, OsStackType=TASK_EXTENDED_STACK, OsStackUser=Os/OsTask_ApplTimedInitDeInit
          OsTask_ApplVerify: OsStackSize=1024, OsStackType=TASK_EXTENDED_STACK, OsStackUser=Os/OsTask_ApplVerify
          OsCore0_Shutdown: OsStackSize=1024, OsStackType=CORE_SHUTDOWN_STACK, OsStackUser=OsCore0
          OsTask_DcmSessionChanges: OsStackSize=3072, OsStackType=TASK_EXTENDED_STACK, OsStackUser=Os/OsTask_DcmSessionChanges
          OsTask_NvmAccess: OsStackSize=1024, OsStackType=TASK_EXTENDED_STACK, OsStackUser=Os/OsTask_NvmAccess
          OsCore0_Isr_Level1: OsStackSize=2048, OsStackType=ISR_SHARED_LEVEL_STACK, OsStackUser=TAUD0_CH05_CAT2_ISR
    OSDEFAULTAPPMODE (OsAppMode)
    OS_APPMODE_ANY (OsAppMode)
    OsPublishedInformation: OsKernelVersion=7, OsPlatformName=Rh850
      RH850F1KM (OsDerivativeInformation):
        OsMpuAlignment = 4
        OsMpuEndAddressAccessible = true
        OsStackAlignment = 4
        OsExceptionVectorTableAlignment = 512
        OsInterruptVectorTableAlignment = 512
        OsHardwareManuals = RH850/F1KM Group Users Manual: Hardware Rev.0.50 Jan 2017 RH850G3KH Users Manual: Software Rev.1.10 Jul 2016
        OsMpuPrivilegedRegionsConfigurable = false
        CORE0 (OsPhysicalCore):
          OsPhysicalCoreId = 0
          OsPhysicalCoreDefaultEntrySymbol = RESET_CORE0
          OsPhysicalCoreType = G3KH
          OsPhysicalCoreExceptionSources = 16
          OsPhysicalCoreIsAutostart = true
          OsPhysicalCoreMasterStartAllowed = false
          OsPhysicalCorePrivelegedHwAccess = true
          OsPhysicalCoreStackProtectionUnit = MPU_CORE0
          MPU_CORE0 (OsPhysicalCoreMpu): OsPhysicalCoreMpuId=0, OsPhysicalCoreMpuMaxRegions=16, OsPhysicalCoreMpuType=CORE_MPU_G3X
        3 x OsHardwareTimer, all with OsHardwareTimerSize=32:
          OSTM0: OsHardwareTimerBaseAddress=4292280320, OsHardwareTimerUnit=FRTPIT, OsHardwareTimerId=0, OsHardwareTimerType=OSTM
            OSTM0 (OsHardwareTimerChannel): OsHardwareTimerChannelIntSource=84, OsHardwareTimerChannelOffset=0, OsHardwareTimerChannelId=0
          TAUJ0: OsHardwareTimerBaseAddress=4293197824, OsHardwareTimerUnit=PIT, OsHardwareTimerId=0, OsHardwareTimerType=TAUJ
            4 x OsHardwareTimerChannel:
              TAUJ0_CH0: OsHardwareTimerChannelIntSource=80, OsHardwareTimerChannelOffset=0, OsHardwareTimerChannelId=0
              TAUJ0_CH1: OsHardwareTimerChannelIntSource=81, OsHardwareTimerChannelOffset=1, OsHardwareTimerChannelId=1
              TAUJ0_CH2: OsHardwareTimerChannelIntSource=82, OsHardwareTimerChannelOffset=2, OsHardwareTimerChannelId=2
              TAUJ0_CH3: OsHardwareTimerChannelIntSource=83, OsHardwareTimerChannelOffset=3, OsHardwareTimerChannelId=3
          TAUJ1: OsHardwareTimerBaseAddress=4293201920, OsHardwareTimerUnit=PIT, OsHardwareTimerId=1, OsHardwareTimerType=TAUJ
            4 x OsHardwareTimerChannel:
              TAUJ1_CH0: OsHardwareTimerChannelIntSource=168, OsHardwareTimerChannelOffset=0, OsHardwareTimerChannelId=0
              TAUJ1_CH1: OsHardwareTimerChannelIntSource=169, OsHardwareTimerChannelOffset=1, OsHardwareTimerChannelId=1
              TAUJ1_CH2: OsHardwareTimerChannelIntSource=170, OsHardwareTimerChannelOffset=2, OsHardwareTimerChannelId=2
              TAUJ1_CH3: OsHardwareTimerChannelIntSource=171, OsHardwareTimerChannelOffset=3, OsHardwareTimerChannelId=3
        INTC (OsSystemIntCtrl): OsSystemIntCtrlBaseAddress=4294896128, OsSystemIntCtrlMaxPrios=16, OsSystemIntCtrlMaxSources=376, OsSystemIntCtrlPrioOrder=DESC
          6 x OsSystemIntCtrlAddress:
            INTC1: OsSystemIntCtrlAddressValue=4294896128
            INTC2: OsSystemIntCtrlAddressValue=4294946816
            EIBD1: OsSystemIntCtrlAddressValue=0
            EIBD2: OsSystemIntCtrlAddressValue=0
            IPIR: OsSystemIntCtrlAddressValue=0
            TPTMSEL: OsSystemIntCtrlAddressValue=0
        MPAT (OsMemoryRegionSpecifics)
          6 x OsMemoryRegionAccess:
            SR: OsMemoryRegionAccessRights=R, OsMemoryRegionAccessType=SUPERVISOR
            SW: OsMemoryRegionAccessRights=W, OsMemoryRegionAccessType=SUPERVISOR
            SX: OsMemoryRegionAccessRights=X, OsMemoryRegionAccessType=SUPERVISOR
            UR: OsMemoryRegionAccessRights=R, OsMemoryRegionAccessType=USER
            UW: OsMemoryRegionAccessRights=W, OsMemoryRegionAccessType=USER
            UX: OsMemoryRegionAccessRights=X, OsMemoryRegionAccessType=USER
        TAUJ2 (OsHardwareTimer): OsHardwareTimerBaseAddress=4293198080, OsHardwareTimerUnit=PIT, OsHardwareTimerSize=32, OsHardwareTimerId=2, OsHardwareTimerType=TAUJ
          4 x OsHardwareTimerChannel:
            TAUJ2_CH0: OsHardwareTimerChannelIntSource=277, OsHardwareTimerChannelOffset=0, OsHardwareTimerChannelId=0
            TAUJ2_CH1: OsHardwareTimerChannelIntSource=278, OsHardwareTimerChannelOffset=1, OsHardwareTimerChannelId=1
            TAUJ2_CH2: OsHardwareTimerChannelIntSource=279, OsHardwareTimerChannelOffset=2, OsHardwareTimerChannelId=2
            TAUJ2_CH3: OsHardwareTimerChannelIntSource=280, OsHardwareTimerChannelOffset=3, OsHardwareTimerChannelId=3
        TAUJ3 (OsHardwareTimer): OsHardwareTimerBaseAddress=4293202176, OsHardwareTimerUnit=PIT, OsHardwareTimerSize=32, OsHardwareTimerId=3, OsHardwareTimerType=TAUJ
          4 x OsHardwareTimerChannel:
            TAUJ3_CH0: OsHardwareTimerChannelIntSource=281, OsHardwareTimerChannelOffset=0, OsHardwareTimerChannelId=0
            TAUJ3_CH1: OsHardwareTimerChannelIntSource=282, OsHardwareTimerChannelOffset=1, OsHardwareTimerChannelId=1
            TAUJ3_CH2: OsHardwareTimerChannelIntSource=283, OsHardwareTimerChannelOffset=2, OsHardwareTimerChannelId=2
            TAUJ3_CH3: OsHardwareTimerChannelIntSource=284, OsHardwareTimerChannelOffset=3, OsHardwareTimerChannelId=3
        OsInterruptRouting: OsSELBINTC1BaseAddress=4290777088
          13 x OsInterruptRoutingSource, all with OsInterruptRoutingRegister=SELB_INTC1:
            OsSELBINTC10: OsInterruptRoutingBit=0, OsInterruptSourceAlternative=116, OsInterruptSourceDefault=16
            OsSELBINTC11: OsInterruptRoutingBit=1, OsInterruptSourceAlternative=117, OsInterruptSourceDefault=17
            OsSELBINTC12: OsInterruptRoutingBit=2, OsInterruptSourceAlternative=118, OsInterruptSourceDefault=27
            OsSELBINTC13: OsInterruptRoutingBit=3, OsInterruptSourceAlternative=119, OsInterruptSourceDefault=28
            OsSELBINTC14: OsInterruptRoutingBit=4, OsInterruptSourceAlternative=132, OsInterruptSourceDefault=8
            OsSELBINTC15: OsInterruptRoutingBit=5, OsInterruptSourceAlternative=133, OsInterruptSourceDefault=10
            OsSELBINTC16: OsInterruptRoutingBit=6, OsInterruptSourceAlternative=134, OsInterruptSourceDefault=11
            OsSELBINTC17: OsInterruptRoutingBit=7, OsInterruptSourceAlternative=135, OsInterruptSourceDefault=12
            OsSELBINTC18: OsInterruptRoutingBit=8, OsInterruptSourceAlternative=158, OsInterruptSourceDefault=9
            OsSELBINTC19: OsInterruptRoutingBit=9, OsInterruptSourceAlternative=159, OsInterruptSourceDefault=13
            OsSELBINTC110: OsInterruptRoutingBit=10, OsInterruptSourceAlternative=160, OsInterruptSourceDefault=14
            OsSELBINTC111: OsInterruptRoutingBit=11, OsInterruptSourceAlternative=161, OsInterruptSourceDefault=15
            OsSELBINTC112: OsInterruptRoutingBit=12, OsInterruptSourceAlternative=32, OsInterruptSourceDefault=20
        ROUTED (OsInterruptSupportedType):
          OsInterruptSupportedTypeSeparateSources = false
          OsInterruptSupportedTypeSeparatePriority = false
          OsInterruptSupportedTypeIsMapped = false
          OsInterruptSupportedTypePostActionRequired = false
    OsCore0 (OsCore):
      OsCoreIsAutostart = true
      OsCoreIsAutosar = true
      OsCoreEntrySymbol = RESET_CORE0
      OsCorePhysicalCoreRef = CORE0
      OsCoreEcucCoreRef = EcucCoreDefinition
      OsCoreIdleTask = IdleTask_OsCore0
      OsCoreSystemApplication = SystemApplication_OsCore0
      OsCoreStacks:
        OsCoreKernelStackSize = 1024
        OsCoreStartupStackSize = 1024
        OsCoreShutdownStackSize = 1024
        OsCoreErrorStackSize = 1024
        OsCoreProtectionStackSize = 1024
        OsCoreInitStackSize = 1024
    IdleTask_OsCore0 (OsTask):
      OsTaskActivation = 1
      OsTaskPriority = 4294967295
      OsTaskSchedule = FULL
      OsTaskStackSharing = false
      OsTaskStackSize = 2048
      OsTaskType = AUTO
      OsTaskUsesFpu = false
      OsTaskAccessingApplication = SystemApplication_OsCore0
      OsTaskAutostart: OsTaskAppModeRef=OS_APPMODE_ANY
    SystemApplication_OsCore0 (OsApplication):
      OsTrusted = true
      OsTrustedApplicationDelayTimingViolationCall = false
      OsTrustedApplicationWithProtection = false
      OsApplicationIsPrivileged = true
      OsAppUseTrustedFunctionStubs = false
      OsApplicationCoreRef = EcucCoreDefinition
      OsAppCounterRef = OsCounter_1ms
      OsAppTaskRef = IdleTask_OsCore0
      OsAppIsrRef = CounterIsr_SystemTimer
      OsAppTaskRef = Default_Init_Task
      OsAppTaskRef = Os/OsTask_BswMainFunctions
      OsAppAlarmRef = Rte_Al_TE_CanTp_CanTp_MainFunction
      OsAppTaskRef = Os/OsTask_ApplInitDeInit
      OsAppTaskRef = Os/OsTask_ApplMainFunctions
      OsAppTaskRef = Os/OsTask_ApplTimedInitDeInit
      OsAppTaskRef = Os/OsTask_ApplVerify
      OsAppTaskRef = OsTask_Background
      OsAppTaskRef = Os/OsTask_Communication
      OsAppTaskRef = Os/OsTask_Dimming
      OsAppTaskRef = Os/OsTask_NvmAccess
      OsAppTaskRef = Os/OsTask_SelfDiagnostics
      OsAppTaskRef = Os/OsTask_Touch
      OsAppIsrRef = INTIIC0EE
      OsAppIsrRef = INTIIC0RI
      OsAppIsrRef = INTIIC0TEI
      OsAppAlarmRef = Rte_Al_TE_OsTask_ApplMainFunctions_0_10ms
      OsAppAlarmRef = Rte_Al_TE_OsTask_ApplTimedInitDeInit_0_1ms
      OsAppAlarmRef = Rte_Al_TE_OsTask_ApplVerify_0_10ms
      OsAppAlarmRef = Rte_Al_TE_SwcTemperatureCorrection_SwcTempCor_MainFunction
      OsAppAlarmRef = Rte_Al_TE_SwcSelfDiagnostics_SwcSelfDiag_UpdateCpuLoad
      OsAppIsrRef = ADC0_SG1_CAT2_ISR
      OsAppIsrRef = CanIsrStatus_0
      OsAppIsrRef = CanIsrTx_0
      OsAppAlarmRef = Rte_Al_TE2_OsTask_BswMainFunctions_0_20ms
      OsAppIsrRef = EXT_INTP_CH07_CAT2_ISR
      OsAppIsrRef = SPI_CSIH0_TIR_CAT2_ISR
      OsAppIsrRef = SPI_CSIH3_TIR_CAT2_ISR
      OsAppAlarmRef = OsAlarm_CddHUIfOnZrResetComplete
      OsAppAlarmRef = OsAlarm_CddHUIfOnButtonHold
      OsAppIsrRef = WDG_59_DRIVERA_TRIGGERFUNCTION_CAT2_ISR
      OsAppIsrRef = SPI_CSIH2_TIR_CAT2_ISR
      OsAppIsrRef = EXT_INTP_CH03_CAT2_ISR
      OsAppAlarmRef = OsAlarm_CddWdgIfToggleHwWdgClockLevel
      OsAppIsrRef = TAUD0_CH00_CAT2_ISR
      OsAppIsrRef = IRQDmaChannel2TransmitComplete
      OsAppTaskRef = Os/OsTask_DcmSessionChanges
      OsAppAlarmRef = Rte_Al_TE2_OsTask_BswMainFunctions_0_10ms
      OsAppAlarmRef = Rte_Al_TE_SwcSelfDiagnostics_SwcSelfDiag_UpdateRuntime
      OsAppAlarmRef = Rte_Al_TE_OsTask_ApplMainFunctions_0_1ms
      OsAppIsrRef = IRQDmaChannel5TransmitComplete
      OsAppIsrRef = IRQDmaChannel5ReceiveComplete
      OsAppIsrRef = TAUD0_CH02_CAT2_ISR
      OsAppIsrRef = TAUD0_CH04_CAT2_ISR
      OsAppIsrRef = TAUD0_CH01_CAT2_ISR
      OsAppIsrRef = CanIsrGlobalRxFifo_0
      OsAppCounterRef = OsCounter_10ms
      OsAppIsrRef = CounterIsr_OsCounter_10ms
      OsAppAlarmRef = OsAlarm_SwcDispCtrlNauchLauf
      OsAppAlarmRef = Rte_Al_TE_ShA_Ivd_MainFunction
      OsAppIsrRef = ADC1_SG1_CAT2_ISR
      OsAppAlarmRef = OsAlarm_SwcHidKeystxConfirmationTimeout
      OsAppAlarmRef = OsAlarm_SwcHidKeysOnButtonHold
      OsAppIsrRef = TAUD0_CH05_CAT2_ISR
      OsAppAlarmRef = OsAlarm_CddWakeupDetectClearResetStatus
      OsAppAlarmRef = Rte_Al_TE_CddHwrOnUartRxReady
      OsAppAlarmRef = OsAlarm_SwcComRxWakeupReasonTimeout
      OsAppAlarmRef = Rte_Al_TE_CddUart_CddUart_MainFunction
      OsAppAlarmRef = OsAlarm_CddTouchTimeout
      OsAppAlarmRef = Rte_Al_TE_SwcTouch_SwcTouch_MainFunction
      OsApplicationHooks: OsAppErrorHook=false, OsAppShutdownHook=false, OsAppStartupHook=false
    CounterIsr_SystemTimer (OsIsr):
      OsIsrCategory = CATEGORY_2
      OsIsrInterruptType = EXTERNAL
      OsIsrInterruptSource = 84
      OsIsrInterruptPriority = 0
      OsIsrStackSize = 1024
      OsIsrEnableNesting = false
      OsIsrUsesFpu = false
      OsIsrInitialEnableInterruptSource = false
      OsIsrSpecialFunctionName = Os_TimerPitIsr
    Default_Init_Task (OsTask):
      OsTaskActivation = 1
      OsTaskPriority = 1001
      OsTaskSchedule = FULL
      OsTaskStackSharing = false
      OsTaskStackSize = 2048
      OsTaskType = BASIC
      OsTaskUsesFpu = false
      OsTaskAccessingApplication = SystemApplication_OsCore0
      OsTaskAutostart: OsTaskAppModeRef=OSDEFAULTAPPMODE
    OsResourceEcuM (OsResource): OsResourceProperty=STANDARD, OsResourceAccessingApplication=SystemApplication_OsCore0
    OsTask_BswMainFunctions (OsTask):
      OsTaskActivation = 1
      OsTaskPriority = 110
      OsTaskSchedule = FULL
      OsTaskStackSharing = false
      OsTaskStackSize = 2048
      OsTaskType = EXTENDED
      OsTaskUsesFpu = false
      OsTaskAccessingApplication = SystemApplication_OsCore0
      OsTaskResourceRef = OsResourceEcuM
      OsTaskEventRef = Rte_Ev_Cyclic2_OsTask_BswMainFunctions_0_10ms
      OsTaskEventRef = Rte_Ev_Cyclic2_OsTask_BswMainFunctions_0_20ms
      OsTaskEventRef = Rte_Ev_Run_CanTp_CanTp_MainFunction
      OsTaskResourceRef = Rte_Res_SwcDimming_EASwcDimDiagnostics
      OsTaskResourceRef = Rte_Res_CddWakeupDetect_EACddWUDetDiagnostics
      OsTaskResourceRef = Rte_Res_CddHeadUnitInterface_EACddHUIfDeviceAccess
      OsTaskResourceRef = Rte_Res_CddHWRNXPRT1171_EACddHwrCfgManager
      OsTaskResourceRef = Rte_Res_CddHWRNXPRT1171_EACddHwrCom
      OsTaskResourceRef = Rte_Res_CddHWRNXPRT1171_EACddHwrEventQueue
      OsTaskResourceRef = Rte_Res_CddHWRNXPRT1171_EACddHwrRequestCtrl
      OsTaskEventRef = Rte_Ev_Run_CddUart_CddUart_MainFunction
      OsTaskResourceRef = Rte_Res_SwcComHandlerTx_EASwcComTxCmdQueueAccess
      OsTaskResourceRef = Rte_Res_SwcError_EASwcErrorCounters
      OsTaskResourceRef = Rte_Res_CddHWRNXPRT1171_EACddHwrModes
      OsTaskResourceRef = Rte_Res_CddHWRNXPRT1171_EACddHwrMonitoring
      OsTaskResourceRef = Rte_Res_CddSliderBackLightTiSN1903001_EACddSldrBuffer
      OsTaskResourceRef = Rte_Res_CddTouchCypressGen7_EACddTouchTrigger
      OsTaskResourceRef = Rte_Res_CddTouchCypressGen7_EACddTouchMode
      OsTaskResourceRef = Rte_Res_CddPeripheralControl_EACddPerCtrlDiagAccess
      OsTaskResourceRef = Rte_Res_SwcHWR_EASwcHWRCharDataBuffer
      OsTaskResourceRef = Rte_Res_CddDebugInfo_EACddDbgInfoBuffer
    Rte_Al_TE2_OsTask_BswMainFunctions_0_10ms (OsAlarm): OsAlarmCounterRef=OsCounter_1ms, OsAlarmAccessingApplication=SystemApplication_OsCore0
      OsAlarmAction
        OsAlarmSetEvent: OsAlarmSetEventRef=Rte_Ev_Cyclic2_OsTask_BswMainFunctions_0_10ms, OsAlarmSetEventTaskRef=Os/OsTask_BswMainFunctions
    Rte_Ev_Cyclic2_OsTask_BswMainFunctions_0_10ms (OsEvent)
    10 x OsTask, all with OsTaskActivation=1, OsTaskSchedule=FULL, OsTaskStackSharing=false, OsTaskUsesFpu=false, OsTaskAccessingApplication=SystemApplication_OsCore0:
      OsTask_ApplInitDeInit: OsTaskPriority=20, OsTaskStackSize=2048, OsTaskType=EXTENDED, OsTaskEventRef=Rte_Ev_MS_OsTask_ApplInitDeInit, OsTaskResourceRef=Rte_Res_SwcDimming_EASwcDimDiagnostics, OsTaskResourceRef=Rte_Res_CddWakeupDetect_EACddWUDetDiagnostics, OsTaskResourceRef=Rte_Res_CddHeadUnitInterface_EACddHUIfDeviceAccess, OsTaskEventRef=Rte_Ev_Run_ShA_Ivd_CurrentMode_PostRun, OsTaskEventRef=Rte_Ev_Run_ShA_Ivd_CurrentMode_Run, OsTaskEventRef=Rte_Ev_Run_SwcHidKeys_SwcHidKeys_DeInit, OsTaskEventRef=Rte_Ev_OnEntry_OsTask_ApplInitDeInit_SwcDisplayControl_PpSwcDispCtrlDisplayMode_Mode_UNINIT, OsTaskEventRef=Rte_Ev_OnExit_OsTask_ApplInitDeInit_SwcDisplayControl_PpSwcDispCtrlDisplayMode_Mode_OFF, OsTaskEventRef=Rte_Ev_OnExit_OsTask_ApplInitDeInit_SwcDisplayControl_PpSwcDispCtrlDisplayMode_Mode_UNINIT, OsTaskResourceRef=Rte_Res_CddHWRNXPRT1171_EACddHwrCfgManager, OsTaskResourceRef=Rte_Res_CddHWRNXPRT1171_EACddHwrCom, OsTaskResourceRef=Rte_Res_CddHWRNXPRT1171_EACddHwrEventQueue, OsTaskResourceRef=Rte_Res_CddHWRNXPRT1171_EACddHwrModes, OsTaskResourceRef=Rte_Res_CddHWRNXPRT1171_EACddHwrMonitoring, OsTaskResourceRef=Rte_Res_CddHWRNXPRT1171_EACddHwrRequestCtrl, OsTaskEventRef=Rte_Ev_OnEntry_OsTask_ApplInitDeInit_SwcDisplayControl_PpSwcDispCtrlDisplayMode_Mode_INIT, OsTaskResourceRef=Rte_Res_SwcError_EASwcErrorCounters, OsTaskResourceRef=Rte_Res_SwcComHandlerTx_EASwcComTxCmdQueueAccess, OsTaskResourceRef=Rte_Res_CddSliderBackLightTiSN1903001_EACddSldrBuffer, OsTaskResourceRef=Rte_Res_CddTouchCypressGen7_EACddTouchMode, OsTaskResourceRef=Rte_Res_CddTouchCypressGen7_EACddTouchTrigger, OsTaskResourceRef=Rte_Res_CddPeripheralControl_EACddPerCtrlDiagAccess, OsTaskResourceRef=Rte_Res_SwcHWR_EASwcHWRCharDataBuffer, OsTaskResourceRef=Rte_Res_CddDebugInfo_EACddDbgInfoBuffer  # Annotation PLAIN_TEXT [MJA-17/02/2021] Since CddNvMManager is responsible for the initialization and deinitializtaion of non-volatile memory, it shall be ensured that: * CddNvMManager_Init is the first runnable to execute; * CddNvMManager_DeInit is the last runnable to execute.
      OsTask_ApplMainFunctions: OsTaskPriority=100, OsTaskStackSize=2048, OsTaskType=EXTENDED, OsTaskEventRef=Rte_Ev_Run1_CddSliderBackLightTiSN1903001_CddSldr_OnReadSeqReady, OsTaskEventRef=Rte_Ev_Run_SwcIVD_AppData_Dsdl1_AdrRange, OsTaskEventRef=Rte_Ev_Cyclic_OsTask_ApplMainFunctions_0_10ms, OsTaskEventRef=Rte_Ev_Cyclic_OsTask_ApplMainFunctions_0_1ms, OsTaskEventRef=Rte_Ev_Run_SwcDimming_SwcDim_ProcessDeratingLimit, OsTaskEventRef=Rte_Ev_Run_SwcDimming_SwcDim_ProcessDim01Data, OsTaskResourceRef=Rte_Res_SwcDimming_EASwcDimDiagnostics, OsTaskEventRef=Rte_Ev_Run_ShA_Ivd_MainFunction, OsTaskEventRef=Rte_Ev_Run_SwcDisplayControl_SwcDispCtrl_ProcessDim01Data, OsTaskEventRef=Rte_Ev_Run_SwcIVD_AdaptionCodingOrDsdl2_Data, OsTaskEventRef=Rte_Ev_Run_SwcIVD_AppData_Dsdl1_Data, OsTaskEventRef=Rte_Ev_Run_CddWakeupDetect_CddWUDet_ProcessBem02Data, OsTaskEventRef=Rte_Ev_Run_CddWakeupDetect_CddWUDet_ProcessSi01Data, OsTaskEventRef=Rte_Ev_Run_CddWakeupDetect_CddWUDet_ProcessZr01Data, OsTaskEventRef=Rte_Ev_Run1_SwcHidKeys_SwcHidKeys_OnButtonHold, OsTaskEventRef=Rte_Ev_OnEntry_OsTask_ApplMainFunctions_ComM_UM_CN_MIBCAN_49695965_currentMode_COMM_FULL_COMMUNICATION, OsTaskEventRef=Rte_Ev_Run_CddHWRNXPRT1171_CddHwr_ProcessSwUpdateReq, OsTaskEventRef=Rte_Ev_Run_SwcDisplayControl_SwcDispCtrl_OnEnterSldrBacklightEnabled, OsTaskEventRef=Rte_Ev_Run_CddHWRNXPRT1171_CddHwr_ProcessSwcDispCtrlModeReq, OsTaskEventRef=Rte_Ev_Run_SwcHWR_SwcHWR_DeviceNotReady, OsTaskEventRef=Rte_Ev_Run_SwcHWR_SwcHWR_DeviceReady, OsTaskResourceRef=Rte_Res_CddHWRNXPRT1171_EACddHwrCfgManager, OsTaskResourceRef=Rte_Res_CddHWRNXPRT1171_EACddHwrCom, OsTaskResourceRef=Rte_Res_CddHWRNXPRT1171_EACddHwrEventQueue, OsTaskResourceRef=Rte_Res_CddHWRNXPRT1171_EACddHwrModes, OsTaskResourceRef=Rte_Res_CddHWRNXPRT1171_EACddHwrMonitoring, OsTaskResourceRef=Rte_Res_CddHWRNXPRT1171_EACddHwrRequestCtrl, OsTaskEventRef=Rte_Ev_OnRx_OsTask_ApplMainFunctions_DI_Screendesign_oZentralrechner_01_oMIBCAN_be1aac5d_Rx, OsTaskResourceRef=Rte_Res_CddWakeupDetect_EACddWUDetDiagnostics, OsTaskEventRef=Rte_Ev_Run1_SwcComHandlerRx_SwcComRx_ProcessZrPlatform, OsTaskEventRef=Rte_Ev_Run1_SwcComHandlerRx_SwcComRx_WakeupReasonTimeout, OsTaskEventRef=Rte_Ev_Run_CddHWRNXPRT1171Swdl_CddHwrSwdl_ProcessHwrHealthStatus, OsTaskEventRef=Rte_Ev_Run_CddHWRNXPRT1171Swdl_CddHwrSwdl_SwUpdateOnEnter, OsTaskResourceRef=Rte_Res_SwcError_EASwcErrorCounters, OsTaskEventRef=Rte_Ev_Run_SwcDisplayInfo_SwcDispInfo_ProcessSteeringWheelPos, OsTaskResourceRef=Rte_Res_SwcComHandlerTx_EASwcComTxCmdQueueAccess, OsTaskEventRef=Rte_Ev_Run1_CddHWRNXPRT1171_CddHwr_OnUartRxReady, OsTaskEventRef=Rte_Ev_Run1_CddWakeupDetect_CddWUDet_ClearResetStatus, OsTaskResourceRef=Rte_Res_CddSliderBackLightTiSN1903001_EACddSldrBuffer, OsTaskEventRef=Rte_Ev_OnEntry_OsTask_ApplMainFunctions_ComM_UM_CN_MIBCAN_49695965_currentMode_COMM_NO_COMMUNICATION, OsTaskEventRef=Rte_Ev_OnExit_OsTask_ApplMainFunctions_ComM_UM_CN_MIBCAN_49695965_currentMode_COMM_FULL_COMMUNICATION, OsTaskEventRef=Rte_Ev_OnExit_OsTask_ApplMainFunctions_ComM_UM_CN_MIBCAN_49695965_currentMode_COMM_NO_COMMUNICATION, OsTaskEventRef=Rte_Ev_Run1_CddNvMManager_CddNvMManager_HwrDlStateUpdate, OsTaskEventRef=Rte_Ev_Run_CddDeserializerTIDS90Ux948_CddDser_ProcessSwcDispCtrlModeReq, OsTaskEventRef=Rte_Ev_Run1_CddDebugInfo_CddDbgInfo_OnTxReady, OsTaskEventRef=Rte_Ev_Run_SwcDisplayControl_SwcDispCtrl_OnExitSldrBacklightEnabled, OsTaskEventRef=Rte_Ev_Run1_CddSliderBackLightTiSN1903001_CddSldr_OnWriteSeqReady, OsTaskEventRef=Rte_Ev_Run_CddHWRNXPRT1171Swdl_CddHwrSwdl_ProcessCddHwrAppVersion, OsTaskEventRef=Rte_Ev_Run_SwcComHandlerRx_SwcComRx_ProcessWakeupReason, OsTaskEventRef=Rte_Ev_Run_CddSliderBackLightTiSN1903001_CddSldr_ProcessSwcDispCtrlModeReq, OsTaskEventRef=Rte_Ev_Run1_CddTouchCypressGen7_CddTouch_Timeout, OsTaskEventRef=Rte_Ev_Run_SwcDisplayControl_SwcDispCtrl_ProcessZr01Data, OsTaskEventRef=Rte_Ev_Run1_SwcTestInterface_SwcTestIf_ProcessTouchData, OsTaskEventRef=Rte_Ev_Run_CddTouchCypressGen7_CddTouch_ModeReq, OsTaskEventRef=Rte_Ev_Run2_SwcTestInterface_SwcTestIf_ProcessTouchData, OsTaskResourceRef=Rte_Res_SwcHWR_EASwcHWRCharDataBuffer, OsTaskResourceRef=Rte_Res_CddDebugInfo_EACddDbgInfoBuffer, OsTaskEventRef=Rte_Ev_Run_CddPanelHimaxHx8249B_CddPnl_ProcessSwcDispCtrolModeReq, OsTaskEventRef=Rte_Ev_Run_CddBoosterMaximMAX20069_CddBstr_ProcessSwcDispCtrlModeReq, OsTaskResourceRef=Rte_Res_CddTouchCypressGen7_EACddTouchMode, OsTaskResourceRef=Rte_Res_CddTouchCypressGen7_EACddTouchTrigger
      OsTask_ApplTimedInitDeInit: OsTaskPriority=30, OsTaskStackSize=2048, OsTaskType=EXTENDED, OsTaskEventRef=Rte_Ev_Cyclic_OsTask_ApplTimedInitDeInit_0_1ms, OsTaskResourceRef=Rte_Res_CddSliderBackLightTiSN1903001_EACddSldrBuffer, OsTaskResourceRef=Rte_Res_SwcError_EASwcErrorCounters, OsTaskResourceRef=Rte_Res_SwcComHandlerTx_EASwcComTxCmdQueueAccess, OsTaskResourceRef=Rte_Res_CddDebugInfo_EACddDbgInfoBuffer
      OsTask_ApplVerify: OsTaskPriority=40, OsTaskStackSize=1024, OsTaskType=EXTENDED, OsTaskEventRef=Rte_Ev_Cyclic_OsTask_ApplVerify_0_10ms, OsTaskResourceRef=Rte_Res_SwcComHandlerTx_EASwcComTxCmdQueueAccess, OsTaskResourceRef=Rte_Res_SwcError_EASwcErrorCounters, OsTaskResourceRef=Rte_Res_CddDebugInfo_EACddDbgInfoBuffer
      OsTask_Background: OsTaskPriority=5, OsTaskStackSize=2048, OsTaskType=BASIC, OsTaskResourceRef=Rte_Res_SwcComHandlerTx_EASwcComTxCmdQueueAccess, OsTaskResourceRef=Rte_Res_SwcError_EASwcErrorCounters, OsTaskResourceRef=Rte_Res_CddDebugInfo_EACddDbgInfoBuffer
      OsTask_Communication: OsTaskPriority=150, OsTaskStackSize=2048, OsTaskType=EXTENDED, OsTaskResourceRef=Rte_Res_CddHeadUnitInterface_EACddHUIfDeviceAccess, OsTaskEventRef=Rte_Ev_Run_CddComTp_CddComTp_Transmit, OsTaskEventRef=Rte_Ev_Run_CddHeadUnitInterface_CddHUIf_ProcessButtonStatus, OsTaskEventRef=Rte_Ev_Run_SwcDisplayControl_SwcDispCtrl_ProcessBist, OsTaskEventRef=Rte_Ev_Run1_SwcHidKeys_SwcHidKeys_TxConfirmationTimeout, OsTaskEventRef=Rte_Ev_OnEntry_OsTask_Communication_SwcDisplayControl_PpSwcDispCtrlModeSwitch_mode_SWCDISPCTRL_OPMODE_ABTLOCAL, OsTaskEventRef=Rte_Ev_Run_SwcComHandlerTx_SwcComTx_ProcessWakeupReason, OsTaskResourceRef=Rte_Res_SwcComHandlerTx_EASwcComTxCmdQueueAccess, OsTaskResourceRef=Rte_Res_SwcError_EASwcErrorCounters, OsTaskEventRef=Rte_Ev_Run_CddKnockout_CddKo_ProcessBem02Data, OsTaskEventRef=Rte_Ev_Run_SwcDisplayInfo_SwcDispInfo_ProcessSteeringWheelPos, OsTaskResourceRef=Rte_Res_CddDebugInfo_EACddDbgInfoBuffer, OsTaskResourceRef=Rte_Res_SwcHWR_EASwcHWRCharDataBuffer
      OsTask_Dimming: OsTaskPriority=200, OsTaskStackSize=3072, OsTaskType=EXTENDED, OsTaskEventRef=Rte_Ev_Run1_SwcTemperatureCorrection_SwcTempCor_MainFunction, OsTaskEventRef=Rte_Ev_Run_SwcTemperatureCorrection_SwcTempCor_ProcessBacklightTemp, OsTaskResourceRef=Rte_Res_SwcComHandlerTx_EASwcComTxCmdQueueAccess, OsTaskResourceRef=Rte_Res_SwcError_EASwcErrorCounters, OsTaskResourceRef=Rte_Res_CddDebugInfo_EACddDbgInfoBuffer
      OsTask_NvmAccess: OsTaskPriority=210, OsTaskStackSize=1024, OsTaskType=EXTENDED, OsTaskEventRef=Rte_Ev_Run1_CddNvMManager_CddNvMManager_BlockCounterApplication1Update, OsTaskEventRef=Rte_Ev_Run1_CddNvMManager_CddNvMManager_BlockCounterApplication2Update, OsTaskEventRef=Rte_Ev_Run1_CddNvMManager_CddNvMManager_BlockCounterNonVolatileMemoryUpdate, OsTaskEventRef=Rte_Ev_Run1_CddNvMManager_CddNvMManager_BlockCounterReserved2Update, OsTaskEventRef=Rte_Ev_Run1_CddNvMManager_CddNvMManager_BlockCounterTouchBackupUpdate, OsTaskEventRef=Rte_Ev_Run1_CddNvMManager_CddNvMManager_DeratingCountUpdate, OsTaskEventRef=Rte_Ev_Run1_CddNvMManager_CddNvMManager_DimmingConfigurationUpdate, OsTaskEventRef=Rte_Ev_Run1_CddNvMManager_CddNvMManager_DowngradeProtectionGlobalVersionNumberUpdate, OsTaskEventRef=Rte_Ev_Run1_CddNvMManager_CddNvMManager_DowngradeProtectionVersionApplication1Update, OsTaskEventRef=Rte_Ev_Run1_CddNvMManager_CddNvMManager_DowngradeProtectionVersionApplication2Update, OsTaskEventRef=Rte_Ev_Run1_CddNvMManager_CddNvMManager_DowngradeProtectionVersionNonVolatileMemoryUpdate, OsTaskEventRef=Rte_Ev_Run1_CddNvMManager_CddNvMManager_DowngradeProtectionVersionReserved2Update, OsTaskEventRef=Rte_Ev_Run1_CddNvMManager_CddNvMManager_DowngradeProtectionVersionTouchBackupUpdate, OsTaskEventRef=Rte_Ev_Run1_CddNvMManager_CddNvMManager_EcuInfoUpdate, OsTaskEventRef=Rte_Ev_Run1_CddNvMManager_CddNvMManager_ErrorCountersUpdate, OsTaskEventRef=Rte_Ev_Run1_CddNvMManager_CddNvMManager_ErrorTraceUpdate, OsTaskEventRef=Rte_Ev_Run1_CddNvMManager_CddNvMManager_FingerPrintApplication1Update, OsTaskEventRef=Rte_Ev_Run1_CddNvMManager_CddNvMManager_FingerPrintApplication2Update, OsTaskEventRef=Rte_Ev_Run1_CddNvMManager_CddNvMManager_FingerPrintNonVolatileMemoryUpdate, OsTaskEventRef=Rte_Ev_Run1_CddNvMManager_CddNvMManager_FingerPrintReserved2Update, OsTaskEventRef=Rte_Ev_Run1_CddNvMManager_CddNvMManager_FingerPrintTouchBackupUpdate, OsTaskEventRef=Rte_Ev_Run1_CddNvMManager_CddNvMManager_MinimumSeveritiesUpdate, OsTaskEventRef=Rte_Ev_Run1_CddNvMManager_CddNvMManager_TemperatureMinMaxUpdate, OsTaskEventRef=Rte_Ev_Run1_CddNvMManager_CddNvMManager_VerifyModeUpdate, OsTaskEventRef=Rte_Ev_Run1_CddNvMManager_CddNvMManager_VoltageMinMaxUpdate, OsTaskEventRef=Rte_Ev_Run1_CddNvMManager_CddNvMManager_SwcComHandlerTxBlockCntrsUpdate, OsTaskEventRef=Rte_Ev_Run1_CddNvMManager_CddNvMManager_SwcComHandlerTxEventCntrsUpdate, OsTaskEventRef=Rte_Ev_Run1_CddNvMManager_PpCddNvmManagerLogisticsData_Update, OsTaskEventRef=Rte_Ev_Run1_CddNvMManager_CddNvMManager_SwcHwrCfgDataUpdate, OsTaskEventRef=Rte_Ev_Run1_CddNvMManager_CddNvMManager_SwcDlMngrVerionHistoryUpdate, OsTaskEventRef=Rte_Ev_Run1_CddNvMManager_CddNvMManager_TouchDeviceCfgUpdate, OsTaskEventRef=Rte_Ev_Run1_CddNvMManager_CddNvMManager_CddWUDetNvmData2Update, OsTaskEventRef=Rte_Ev_Run1_CddNvMManager_CddNvMManager_CddWUDetNvmDataUpdate, OsTaskEventRef=Rte_Ev_Run1_CddNvMManager_CddNvMManager_SwcComRxNvmDataUpdate, OsTaskEventRef=Rte_Ev_Run1_CddNvMManager_CddNvMManager_SecAttemptCntrsUpdate, OsTaskEventRef=Rte_Ev_Run1_CddNvMManager_CddNvMManager_ProgInfoUpdate, OsTaskEventRef=Rte_Ev_Run1_CddNvMManager_CddNvmManager_SparePartNumberUpdate, OsTaskEventRef=Rte_Ev_Run1_CddNvMManager_CddNvMManager_DisplayInfoCfgUpdate, OsTaskEventRef=Rte_Ev_Run_CddNvMManager_CddNvMManager_SystemVersionUpdate
      OsTask_SelfDiagnostics: OsTaskPriority=50, OsTaskStackSize=2048, OsTaskType=EXTENDED, OsTaskResourceRef=Rte_Res_SwcComHandlerTx_EASwcComTxCmdQueueAccess, OsTaskResourceRef=Rte_Res_SwcError_EASwcErrorCounters, OsTaskResourceRef=Rte_Res_CddDebugInfo_EACddDbgInfoBuffer, OsTaskEventRef=Rte_Ev_Run1_SwcSelfDiagnostics_SwcSelfDiag_UpdateCpuLoad, OsTaskEventRef=Rte_Ev_Run_SwcSelfDiagnostics_SwcSelfDiag_EvaluateBacklightTemp, OsTaskEventRef=Rte_Ev_Run_SwcSelfDiagnostics_SwcSelfDiag_EvaluateBatteryVoltage, OsTaskEventRef=Rte_Ev_Run_SwcSelfDiagnostics_SwcSelfDiag_EvaluateBlTempDeratingLimit, OsTaskEventRef=Rte_Ev_Run_SwcSelfDiagnostics_SwcSelfDiag_UpdateRuntime
      OsTask_Touch: OsTaskPriority=170, OsTaskStackSize=2048, OsTaskType=AUTO, OsTaskEventRef=Rte_Ev_Run1_CddHeadUnitInterface_CddHUIf_OnButtonHold, OsTaskEventRef=Rte_Ev_Run1_CddHeadUnitInterface_CddHUIf_OnZrResetComplete, OsTaskResourceRef=Rte_Res_CddHeadUnitInterface_EACddHUIfDeviceAccess, OsTaskResourceRef=Rte_Res_CddHWRNXPRT1171_EACddHwrCfgManager, OsTaskResourceRef=Rte_Res_CddHWRNXPRT1171_EACddHwrCom, OsTaskResourceRef=Rte_Res_CddHWRNXPRT1171_EACddHwrEventQueue, OsTaskResourceRef=Rte_Res_CddHWRNXPRT1171_EACddHwrModes, OsTaskResourceRef=Rte_Res_CddHWRNXPRT1171_EACddHwrMonitoring, OsTaskResourceRef=Rte_Res_CddHWRNXPRT1171_EACddHwrRequestCtrl, OsTaskEventRef=Rte_Ev_Run_SwcHidKeys_SwcHidKeys_ProcessButtonStatus, OsTaskEventRef=Rte_Ev_Run_SwcTouch_SwcTouch_ProcessDisplayDataLO, OsTaskEventRef=Rte_Ev_OnRx_OsTask_Touch_CddTouchCypressGen7_PpCddTouchDisplayData_fingerData, OsTaskResourceRef=Rte_Res_SwcError_EASwcErrorCounters, OsTaskResourceRef=Rte_Res_SwcComHandlerTx_EASwcComTxCmdQueueAccess, OsTaskEventRef=Rte_Ev_Run_SwcTouch_SwcTouch_ProcessSliderData, OsTaskResourceRef=Rte_Res_CddDebugInfo_EACddDbgInfoBuffer, OsTaskResourceRef=Rte_Res_SwcHWR_EASwcHWRCharDataBuffer, OsTaskEventRef=Rte_Ev_Run1_SwcTouch_SwcTouch_MainFunction
    3 x OsIsr, all with OsIsrCategory=CATEGORY_2, OsIsrInterruptType=EXTERNAL, OsIsrInterruptPriority=3, OsIsrStackSize=1024, OsIsrEnableNesting=false, OsIsrUsesFpu=false, OsIsrInitialEnableInterruptSource=true, OsIsrSpecialFunctionName=I2c_IrqUnit0:
      INTIIC0EE: OsIsrInterruptSource=77
      INTIIC0RI: OsIsrInterruptSource=78
      INTIIC0TEI: OsIsrInterruptSource=79
    Rte_Ev_MS_OsTask_ApplInitDeInit (OsEvent): OsEventMask=4
    Rte_Al_TE_OsTask_ApplMainFunctions_0_10ms (OsAlarm): OsAlarmCounterRef=OsCounter_1ms, OsAlarmAccessingApplication=SystemApplication_OsCore0
      OsAlarmAction
        OsAlarmSetEvent: OsAlarmSetEventRef=Rte_Ev_Cyclic_OsTask_ApplMainFunctions_0_10ms, OsAlarmSetEventTaskRef=Os/OsTask_ApplMainFunctions
    Rte_Al_TE_OsTask_ApplVerify_0_10ms (OsAlarm): OsAlarmCounterRef=OsCounter_1ms, OsAlarmAccessingApplication=SystemApplication_OsCore0
      OsAlarmAction
        OsAlarmSetEvent: OsAlarmSetEventRef=Rte_Ev_Cyclic_OsTask_ApplVerify_0_10ms, OsAlarmSetEventTaskRef=Os/OsTask_ApplVerify
    Rte_Ev_Cyclic_OsTask_ApplMainFunctions_0_10ms (OsEvent)
    Rte_Al_TE_OsTask_ApplTimedInitDeInit_0_1ms (OsAlarm): OsAlarmCounterRef=OsCounter_1ms, OsAlarmAccessingApplication=SystemApplication_OsCore0
      OsAlarmAction
        OsAlarmSetEvent: OsAlarmSetEventRef=Rte_Ev_Cyclic_OsTask_ApplTimedInitDeInit_0_1ms, OsAlarmSetEventTaskRef=Os/OsTask_ApplTimedInitDeInit
    3 x OsIsr, all with OsIsrCategory=CATEGORY_2, OsIsrInterruptType=EXTERNAL, OsIsrInterruptPriority=0, OsIsrEnableNesting=false, OsIsrUsesFpu=false, OsIsrInitialEnableInterruptSource=true:
      ADC0_SG1_CAT2_ISR: OsIsrInterruptSource=18, OsIsrStackSize=2048
      CanIsrTx_0: OsIsrInterruptSource=26, OsIsrStackSize=1024  # /ActiveEcuC/Can PLAIN_TEXT Can TX message event of controller CT_MIB_MIBCAN_07b1ca5f. This OsIsr container has been created automatically based on the Can driver configuration.
      CanIsrStatus_0: OsIsrInterruptSource=24, OsIsrStackSize=1024  # /ActiveEcuC/Can PLAIN_TEXT Can busoff event of controller CT_MIB_MIBCAN_07b1ca5f. This OsIsr container has been created automatically based on the Can driver configuration.
    Rte_Al_TE2_OsTask_BswMainFunctions_0_20ms (OsAlarm): OsAlarmCounterRef=OsCounter_1ms, OsAlarmAccessingApplication=SystemApplication_OsCore0
      OsAlarmAction
        OsAlarmSetEvent: OsAlarmSetEventRef=Rte_Ev_Cyclic2_OsTask_BswMainFunctions_0_20ms, OsAlarmSetEventTaskRef=Os/OsTask_BswMainFunctions
    3 x OsEvent:
      Rte_Ev_Cyclic2_OsTask_BswMainFunctions_0_20ms
      Rte_Ev_Cyclic_OsTask_ApplTimedInitDeInit_0_1ms
      Rte_Ev_Cyclic_OsTask_ApplVerify_0_10ms
    3 x OsIsr, all with OsIsrCategory=CATEGORY_2, OsIsrInterruptType=EXTERNAL, OsIsrInterruptPriority=0, OsIsrStackSize=1024, OsIsrEnableNesting=false, OsIsrUsesFpu=false, OsIsrInitialEnableInterruptSource=true:
      EXT_INTP_CH07_CAT2_ISR: OsIsrInterruptSource=129
      SPI_CSIH0_TIR_CAT2_ISR: OsIsrInterruptSource=30
      SPI_CSIH3_TIR_CAT2_ISR: OsIsrInterruptSource=159
    OsAlarm_CddHUIfOnZrResetComplete (OsAlarm): OsAlarmCounterRef=OsCounter_1ms, OsAlarmAccessingApplication=SystemApplication_OsCore0
      OsAlarmAction
        OsAlarmSetEvent: OsAlarmSetEventRef=Rte_Ev_Run1_CddHeadUnitInterface_CddHUIf_OnZrResetComplete, OsAlarmSetEventTaskRef=Os/OsTask_Touch
    OsAlarm_CddHUIfOnButtonHold (OsAlarm): OsAlarmCounterRef=OsCounter_1ms, OsAlarmAccessingApplication=SystemApplication_OsCore0
      OsAlarmAction
        OsAlarmSetEvent: OsAlarmSetEventRef=Rte_Ev_Run1_CddHeadUnitInterface_CddHUIf_OnButtonHold, OsAlarmSetEventTaskRef=Os/OsTask_Touch
    3 x OsIsr, all with OsIsrCategory=CATEGORY_2, OsIsrInterruptType=EXTERNAL, OsIsrInterruptPriority=0, OsIsrStackSize=1024, OsIsrEnableNesting=false, OsIsrUsesFpu=false, OsIsrInitialEnableInterruptSource=true:
      WDG_59_DRIVERA_TRIGGERFUNCTION_CAT2_ISR: OsIsrInterruptSource=40
      SPI_CSIH2_TIR_CAT2_ISR: OsIsrInterruptSource=133
      EXT_INTP_CH03_CAT2_ISR: OsIsrInterruptSource=43
    OsAlarm_CddWdgIfToggleHwWdgClockLevel (OsAlarm): OsAlarmCounterRef=OsCounter_1ms, OsAlarmAccessingApplication=SystemApplication_OsCore0
      OsAlarmAction
        OsAlarmCallback: OsAlarmCallbackName=CddWdgIf_ToggleHwWdgClockLevel
    TAUD0_CH00_CAT2_ISR (OsIsr):
      OsIsrCategory = CATEGORY_2
      OsIsrInterruptType = EXTERNAL
      OsIsrInterruptSource = 8
      OsIsrInterruptPriority = 0
      OsIsrStackSize = 1024
      OsIsrEnableNesting = false
      OsIsrUsesFpu = false
      OsIsrInitialEnableInterruptSource = true
    IRQDmaChannel2TransmitComplete (OsIsr):
      OsIsrCategory = CATEGORY_2
      OsIsrInterruptType = EXTERNAL
      OsIsrInterruptSource = 62
      OsIsrInterruptPriority = 0
      OsIsrStackSize = 1024
      OsIsrEnableNesting = false
      OsIsrUsesFpu = false
      OsIsrInitialEnableInterruptSource = true
      OsIsrSpecialFunctionName = CddUart_DmaChannel2TransmitCompleteNotification
    OsTask_DcmSessionChanges (OsTask):
      OsTaskActivation = 1
      OsTaskPriority = 120
      OsTaskSchedule = FULL
      OsTaskStackSharing = false
      OsTaskStackSize = 3072
      OsTaskType = EXTENDED
      OsTaskUsesFpu = false
      OsTaskAccessingApplication = SystemApplication_OsCore0
      OsTaskEventRef = Rte_Ev_Run_CddDownloadManager_CddDownloadManager_OnEntryDcmProgrammingSession
      OsTaskEventRef = Rte_Ev_Run_CddDownloadManager_CddDownloadManager_OnEntryDcmDefaultSession
      OsTaskEventRef = Rte_Ev_Run_CddDownloadManager_CddDownloadManager_OnExitDcmProgrammingSession
      OsTaskEventRef = Rte_Ev_OnEntry_OsTask_DcmSessionChanges_Dcm_DcmDiagnosticSessionControl_DcmDiagnosticSessionControl_DEFAULT_SESSION
      OsTaskResourceRef = Rte_Res_SwcError_EASwcErrorCounters
      OsTaskEventRef = Rte_Ev_Run_SwcError_SwcError_OnEntryDcmDefaultSession
      OsTaskEventRef = Rte_Ev_Run_SwcDisplayControl_SwcDispCtrl_OnEnterDefaultSession
      OsTaskEventRef = Rte_Ev_Run_CddVoltageMonitor_CddVoltMon_OnEntryDefaultSession
      OsTaskResourceRef = Rte_Res_SwcComHandlerTx_EASwcComTxCmdQueueAccess
      OsTaskResourceRef = Rte_Res_CddTouchCypressGen7_EACddTouchTrigger
      OsTaskResourceRef = Rte_Res_CddDebugInfo_EACddDbgInfoBuffer
      OsTaskEventRef = Rte_Ev_Run_CddDownloadManager_CddDlMngr_OnEntryProgrammingSession
      OsTaskEventRef = Rte_Ev_Run_CddDownloadManager_CddDlMngr_OnExitProgrammingSession
    28 x OsEvent:
      Rte_Ev_Run_CddDownloadManager_CddDownloadManager_OnEntryDcmProgrammingSession
      Rte_Ev_Run_CddDownloadManager_CddDownloadManager_OnEntryDcmDefaultSession
      Rte_Ev_Run_CddDownloadManager_CddDownloadManager_OnExitDcmProgrammingSession
      Rte_Ev_Run1_CddNvMManager_CddNvMManager_BlockCounterApplication1Update
      Rte_Ev_Run1_CddNvMManager_CddNvMManager_BlockCounterApplication2Update
      Rte_Ev_Run1_CddNvMManager_CddNvMManager_BlockCounterNonVolatileMemoryUpdate
      Rte_Ev_Run1_CddNvMManager_CddNvMManager_BlockCounterReserved2Update
      Rte_Ev_Run1_CddNvMManager_CddNvMManager_BlockCounterTouchBackupUpdate
      Rte_Ev_Run1_CddNvMManager_CddNvMManager_DeratingCountUpdate
      Rte_Ev_Run1_CddNvMManager_CddNvMManager_DimmingConfigurationUpdate
      Rte_Ev_Run1_CddNvMManager_CddNvMManager_DowngradeProtectionGlobalVersionNumberUpdate
      Rte_Ev_Run1_CddNvMManager_CddNvMManager_DowngradeProtectionVersionApplication1Update
      Rte_Ev_Run1_CddNvMManager_CddNvMManager_DowngradeProtectionVersionApplication2Update
      Rte_Ev_Run1_CddNvMManager_CddNvMManager_DowngradeProtectionVersionNonVolatileMemoryUpdate
      Rte_Ev_Run1_CddNvMManager_CddNvMManager_DowngradeProtectionVersionReserved2Update
      Rte_Ev_Run1_CddNvMManager_CddNvMManager_DowngradeProtectionVersionTouchBackupUpdate
      Rte_Ev_Run1_CddNvMManager_CddNvMManager_EcuInfoUpdate
      Rte_Ev_Run1_CddNvMManager_CddNvMManager_ErrorCountersUpdate
      Rte_Ev_Run1_CddNvMManager_CddNvMManager_ErrorTraceUpdate
      Rte_Ev_Run1_CddNvMManager_CddNvMManager_FingerPrintApplication1Update
      Rte_Ev_Run1_CddNvMManager_CddNvMManager_FingerPrintApplication2Update
      Rte_Ev_Run1_CddNvMManager_CddNvMManager_FingerPrintNonVolatileMemoryUpdate
      Rte_Ev_Run1_CddNvMManager_CddNvMManager_FingerPrintReserved2Update
      Rte_Ev_Run1_CddNvMManager_CddNvMManager_FingerPrintTouchBackupUpdate
      Rte_Ev_Run1_CddNvMManager_CddNvMManager_MinimumSeveritiesUpdate
      Rte_Ev_Run1_CddNvMManager_CddNvMManager_TemperatureMinMaxUpdate
      Rte_Ev_Run1_CddNvMManager_CddNvMManager_VerifyModeUpdate
      Rte_Ev_Run1_CddNvMManager_CddNvMManager_VoltageMinMaxUpdate
    Rte_Al_TE_OsTask_ApplMainFunctions_0_1ms (OsAlarm): OsAlarmCounterRef=OsCounter_1ms, OsAlarmAccessingApplication=SystemApplication_OsCore0
      OsAlarmAction
        OsAlarmSetEvent: OsAlarmSetEventRef=Rte_Ev_Cyclic_OsTask_ApplMainFunctions_0_1ms, OsAlarmSetEventTaskRef=Os/OsTask_ApplMainFunctions
    Rte_Ev_Cyclic_OsTask_ApplMainFunctions_0_1ms (OsEvent)
    6 x OsIsr, all with OsIsrCategory=CATEGORY_2, OsIsrInterruptType=EXTERNAL, OsIsrInterruptPriority=0, OsIsrStackSize=1024, OsIsrEnableNesting=false, OsIsrUsesFpu=false, OsIsrInitialEnableInterruptSource=true:
      IRQDmaChannel5TransmitComplete: OsIsrInterruptSource=60, OsIsrSpecialFunctionName=CddUart_DmaChannel5TransmitCompleteNotification
      IRQDmaChannel5ReceiveComplete: OsIsrInterruptSource=61, OsIsrSpecialFunctionName=CddUart_DmaChannel5ReceiveCompleteNotification
      TAUD0_CH02_CAT2_ISR: OsIsrInterruptSource=9
      TAUD0_CH04_CAT2_ISR: OsIsrInterruptSource=10
      TAUD0_CH01_CAT2_ISR: OsIsrInterruptSource=48
      CanIsrGlobalRxFifo_0: OsIsrInterruptSource=23  # /ActiveEcuC/Can PLAIN_TEXT Global Can RX BasicCAN message received event of unit 0. This OsIsr container has been created automatically based on the Can driver configuration.
    Rte_Ev_OnRx_OsTask_Touch_CddTouchCypressGen7_PpCddTouchDisplayData_fingerData (OsEvent)
    Rte_Al_TE_CanTp_CanTp_MainFunction (OsAlarm): OsAlarmCounterRef=OsCounter_1ms, OsAlarmAccessingApplication=SystemApplication_OsCore0
      OsAlarmAction
        OsAlarmSetEvent: OsAlarmSetEventRef=Rte_Ev_Run_CanTp_CanTp_MainFunction, OsAlarmSetEventTaskRef=Os/OsTask_BswMainFunctions
    Rte_Ev_Run_CanTp_CanTp_MainFunction (OsEvent)
    OsCounter_10ms (OsCounter):
      OsCounterMaxAllowedValue = 1073741823
      OsCounterMinCycle = 1
      OsCounterTicksPerBase = 400000
      OsCounterType = HARDWARE
      OsSecondsPerTick = 0.01
      OsCounterAccessingApplication = SystemApplication_OsCore0
      OsDriver: OsDriverHighResolution=false, OsDriverHardwareTimerChannelRef=TAUJ2_CH0, OsDriverIsrRef=CounterIsr_OsCounter_10ms
    CounterIsr_OsCounter_10ms (OsIsr):
      OsIsrCategory = CATEGORY_2
      OsIsrInterruptType = EXTERNAL
      OsIsrInterruptSource = 277
      OsIsrInterruptPriority = 0
      OsIsrStackSize = 1024
      OsIsrEnableNesting = false
      OsIsrUsesFpu = false
      OsIsrInitialEnableInterruptSource = false
      OsIsrSpecialFunctionName = Os_TimerPitIsr
    5 x OsEvent:
      Rte_Ev_Run1_CddNvMManager_CddNvMManager_SwcComHandlerTxBlockCntrsUpdate
      Rte_Ev_Run1_CddNvMManager_CddNvMManager_SwcComHandlerTxEventCntrsUpdate
      Rte_Ev_Run1_CddNvMManager_PpCddNvmManagerLogisticsData_Update
      Rte_Ev_Run_SwcDimming_SwcDim_ProcessDeratingLimit
      Rte_Ev_Run_SwcDimming_SwcDim_ProcessDim01Data
    Rte_Res_SwcDimming_EASwcDimDiagnostics (OsResource): OsResourceProperty=STANDARD, OsResourceAccessingApplication=SystemApplication_OsCore0
    OsAlarm_SwcDispCtrlNauchLauf (OsAlarm): OsAlarmCounterRef=OsCounter_1ms, OsAlarmAccessingApplication=SystemApplication_OsCore0
      OsAlarmAction
        OsAlarmCallback: OsAlarmCallbackName=SwcDispCtrl_NauchLaufExpired
    Rte_Ev_Run_SwcDisplayControl_SwcDispCtrl_ProcessZr01Data (OsEvent)
    Rte_Al_TE_ShA_Ivd_MainFunction (OsAlarm): OsAlarmCounterRef=OsCounter_10ms, OsAlarmAccessingApplication=SystemApplication_OsCore0
      OsAlarmAction
        OsAlarmSetEvent: OsAlarmSetEventRef=Rte_Ev_Run_ShA_Ivd_MainFunction, OsAlarmSetEventTaskRef=Os/OsTask_ApplMainFunctions
    13 x OsEvent:
      Rte_Ev_Run_ShA_Ivd_MainFunction
      Rte_Ev_Run_SwcDisplayControl_SwcDispCtrl_ProcessDim01Data
      Rte_Ev_Run_SwcIVD_AdaptionCodingOrDsdl2_Data
      Rte_Ev_Run_SwcIVD_AppData_Dsdl1_AdrRange
      Rte_Ev_Run_SwcIVD_AppData_Dsdl1_Data
      Rte_Ev_Run1_CddNvMManager_CddNvMManager_SwcHwrCfgDataUpdate
      Rte_Ev_Run1_CddNvMManager_CddNvMManager_SwcDlMngrVerionHistoryUpdate
      Rte_Ev_Run1_CddNvMManager_CddNvMManager_TouchDeviceCfgUpdate
      Rte_Ev_Run1_CddNvMManager_CddNvMManager_CddWUDetNvmData2Update
      Rte_Ev_Run1_CddNvMManager_CddNvMManager_CddWUDetNvmDataUpdate
      Rte_Ev_Run_CddWakeupDetect_CddWUDet_ProcessBem02Data
      Rte_Ev_Run_CddWakeupDetect_CddWUDet_ProcessSi01Data
      Rte_Ev_Run_CddWakeupDetect_CddWUDet_ProcessZr01Data
    Rte_Res_CddWakeupDetect_EACddWUDetDiagnostics (OsResource): OsResourceProperty=STANDARD, OsResourceAccessingApplication=SystemApplication_OsCore0
    Rte_Res_CddHeadUnitInterface_EACddHUIfDeviceAccess (OsResource): OsResourceProperty=STANDARD, OsResourceAccessingApplication=SystemApplication_OsCore0
    ADC1_SG1_CAT2_ISR (OsIsr):
      OsIsrCategory = CATEGORY_2
      OsIsrInterruptType = EXTERNAL
      OsIsrInterruptSource = 213
      OsIsrInterruptPriority = 0
      OsIsrStackSize = 2048
      OsIsrEnableNesting = false
      OsIsrUsesFpu = false
      OsIsrInitialEnableInterruptSource = true
    7 x OsEvent:
      Rte_Ev_Run1_CddHeadUnitInterface_CddHUIf_OnButtonHold
      Rte_Ev_Run1_CddHeadUnitInterface_CddHUIf_OnZrResetComplete
      Rte_Ev_Run_ShA_Ivd_CurrentMode_PostRun
      Rte_Ev_Run_ShA_Ivd_CurrentMode_Run
      Rte_Ev_Run1_CddNvMManager_CddNvMManager_SwcComRxNvmDataUpdate
      Rte_Ev_Run1_CddNvMManager_CddNvMManager_SecAttemptCntrsUpdate
      Rte_Ev_Run1_CddNvMManager_CddNvMManager_ProgInfoUpdate
    OsAlarm_SwcHidKeysOnButtonHold (OsAlarm): OsAlarmCounterRef=OsCounter_1ms, OsAlarmAccessingApplication=SystemApplication_OsCore0
      OsAlarmAction
        OsAlarmSetEvent: OsAlarmSetEventRef=Rte_Ev_Run1_SwcHidKeys_SwcHidKeys_OnButtonHold, OsAlarmSetEventTaskRef=Os/OsTask_ApplMainFunctions
    4 x OsEvent:
      Rte_Ev_Run1_SwcHidKeys_SwcHidKeys_TxConfirmationTimeout
      Rte_Ev_Run_SwcHidKeys_SwcHidKeys_ProcessButtonStatus
      Rte_Ev_Run1_CddNvMManager_CddNvmManager_SparePartNumberUpdate
      Rte_Ev_Run1_CddNvMManager_CddNvMManager_DisplayInfoCfgUpdate
    TAUD0_CH05_CAT2_ISR (OsIsr):
      OsIsrCategory = CATEGORY_2
      OsIsrInterruptType = EXTERNAL
      OsIsrInterruptSource = 50
      OsIsrInterruptPriority = 1
      OsIsrStackSize = 2048
      OsIsrEnableNesting = true
      OsIsrUsesFpu = false
      OsIsrInitialEnableInterruptSource = true
    Rte_Al_TE_SwcTemperatureCorrection_SwcTempCor_MainFunction (OsAlarm): OsAlarmCounterRef=OsCounter_1ms, OsAlarmAccessingApplication=SystemApplication_OsCore0
      OsAlarmAction
        OsAlarmSetEvent: OsAlarmSetEventRef=Rte_Ev_Run1_SwcTemperatureCorrection_SwcTempCor_MainFunction, OsAlarmSetEventTaskRef=Os/OsTask_Dimming
    8 x OsEvent:
      Rte_Ev_Run1_CddHWRNXPRT1171_CddHwr_OnUartRxReady
      Rte_Ev_Run_CddHWRNXPRT1171_CddHwr_ProcessSwUpdateReq
      Rte_Ev_Run_CddHWRNXPRT1171_CddHwr_ProcessSwcDispCtrlModeReq
      Rte_Ev_Run_CddComTp_CddComTp_Transmit
      Rte_Ev_Run_CddHeadUnitInterface_CddHUIf_ProcessButtonStatus
      Rte_Ev_Run_SwcComHandlerTx_SwcComTx_ProcessWakeupReason
      Rte_Ev_Run_SwcHWR_SwcHWR_DeviceNotReady
      Rte_Ev_Run_SwcHWR_SwcHWR_DeviceReady
    Rte_Al_TE_CddHwrOnUartRxReady (OsAlarm): OsAlarmCounterRef=OsCounter_1ms, OsAlarmAccessingApplication=SystemApplication_OsCore0
      OsAlarmAction
        OsAlarmSetEvent: OsAlarmSetEventRef=Rte_Ev_Run1_CddHWRNXPRT1171_CddHwr_OnUartRxReady, OsAlarmSetEventTaskRef=Os/OsTask_ApplMainFunctions
    6 x OsResource, all with OsResourceProperty=STANDARD, OsResourceAccessingApplication=SystemApplication_OsCore0:
      Rte_Res_CddHWRNXPRT1171_EACddHwrCfgManager
      Rte_Res_CddHWRNXPRT1171_EACddHwrCom
      Rte_Res_CddHWRNXPRT1171_EACddHwrEventQueue
      Rte_Res_CddHWRNXPRT1171_EACddHwrModes
      Rte_Res_CddHWRNXPRT1171_EACddHwrMonitoring
      Rte_Res_CddHWRNXPRT1171_EACddHwrRequestCtrl
    11 x OsEvent:
      Rte_Ev_OnRx_OsTask_ApplMainFunctions_DI_Screendesign_oZentralrechner_01_oMIBCAN_be1aac5d_Rx
      Rte_Ev_Run1_SwcComHandlerRx_SwcComRx_ProcessZrPlatform
      Rte_Ev_Run1_SwcComHandlerRx_SwcComRx_WakeupReasonTimeout
      Rte_Ev_Run_SwcDisplayInfo_SwcDispInfo_ProcessSteeringWheelPos
      Rte_Ev_OnEntry_OsTask_ApplInitDeInit_SwcDisplayControl_PpSwcDispCtrlDisplayMode_Mode_UNINIT
      Rte_Ev_OnExit_OsTask_ApplInitDeInit_SwcDisplayControl_PpSwcDispCtrlDisplayMode_Mode_OFF
      Rte_Ev_OnExit_OsTask_ApplInitDeInit_SwcDisplayControl_PpSwcDispCtrlDisplayMode_Mode_UNINIT
      Rte_Ev_Run_CddHWRNXPRT1171Swdl_CddHwrSwdl_ProcessHwrHealthStatus
      Rte_Ev_Run_CddHWRNXPRT1171Swdl_CddHwrSwdl_SwUpdateOnEnter
      Rte_Ev_OnEntry_OsTask_ApplMainFunctions_ComM_UM_CN_MIBCAN_49695965_currentMode_COMM_FULL_COMMUNICATION
      Rte_Ev_OnExit_OsTask_ApplMainFunctions_ComM_UM_CN_MIBCAN_49695965_currentMode_COMM_FULL_COMMUNICATION
    OsAlarm_SwcHidKeystxConfirmationTimeout (OsAlarm): OsAlarmCounterRef=OsCounter_1ms, OsAlarmAccessingApplication=SystemApplication_OsCore0
      OsAlarmAction
        OsAlarmSetEvent: OsAlarmSetEventRef=Rte_Ev_Run1_SwcHidKeys_SwcHidKeys_TxConfirmationTimeout, OsAlarmSetEventTaskRef=Os/OsTask_Communication
    5 x OsEvent:
      Rte_Ev_Run_SwcTemperatureCorrection_SwcTempCor_ProcessBacklightTemp
      Rte_Ev_Run_SwcHidKeys_SwcHidKeys_DeInit
      Rte_Ev_Run1_SwcTemperatureCorrection_SwcTempCor_MainFunction
      Rte_Ev_Run_SwcTouch_SwcTouch_ProcessDisplayDataLO
      Rte_Ev_Run1_CddWakeupDetect_CddWUDet_ClearResetStatus
    OsAlarm_CddWakeupDetectClearResetStatus (OsAlarm): OsAlarmCounterRef=OsCounter_1ms, OsAlarmAccessingApplication=SystemApplication_OsCore0
      OsAlarmAction
        OsAlarmSetEvent: OsAlarmSetEventRef=Rte_Ev_Run1_CddWakeupDetect_CddWUDet_ClearResetStatus, OsAlarmSetEventTaskRef=Os/OsTask_ApplMainFunctions
    3 x OsEvent:
      Rte_Ev_Run1_SwcHidKeys_SwcHidKeys_OnButtonHold
      Rte_Ev_OnEntry_OsTask_DcmSessionChanges_Dcm_DcmDiagnosticSessionControl_DcmDiagnosticSessionControl_DEFAULT_SESSION
      Rte_Ev_OnEntry_OsTask_ApplInitDeInit_SwcDisplayControl_PpSwcDispCtrlDisplayMode_Mode_INIT
    OsAlarm_SwcComRxWakeupReasonTimeout (OsAlarm): OsAlarmCounterRef=OsCounter_1ms, OsAlarmAccessingApplication=SystemApplication_OsCore0
      OsAlarmAction
        OsAlarmSetEvent: OsAlarmSetEventRef=Rte_Ev_Run1_SwcComHandlerRx_SwcComRx_WakeupReasonTimeout, OsAlarmSetEventTaskRef=Os/OsTask_ApplMainFunctions
    Rte_Al_TE_CddUart_CddUart_MainFunction (OsAlarm): OsAlarmCounterRef=OsCounter_1ms, OsAlarmAccessingApplication=SystemApplication_OsCore0
      OsAlarmAction
        OsAlarmSetEvent: OsAlarmSetEventRef=Rte_Ev_Run_CddUart_CddUart_MainFunction, OsAlarmSetEventTaskRef=Os/OsTask_BswMainFunctions
    Rte_Ev_Run_CddUart_CddUart_MainFunction (OsEvent)
    Rte_Res_SwcError_EASwcErrorCounters (OsResource): OsResourceProperty=STANDARD, OsResourceAccessingApplication=SystemApplication_OsCore0
    6 x OsEvent:
      Rte_Ev_Run_SwcDisplayControl_SwcDispCtrl_OnEnterSldrBacklightEnabled
      Rte_Ev_Run_SwcComHandlerRx_SwcComRx_ProcessWakeupReason
      Rte_Ev_Run_CddHWRNXPRT1171Swdl_CddHwrSwdl_ProcessCddHwrAppVersion
      Rte_Ev_OnEntry_OsTask_Communication_SwcDisplayControl_PpSwcDispCtrlModeSwitch_mode_SWCDISPCTRL_OPMODE_ABTLOCAL
      Rte_Ev_Run_SwcDisplayControl_SwcDispCtrl_OnEnterDefaultSession
      Rte_Ev_Run_CddVoltageMonitor_CddVoltMon_OnEntryDefaultSession
    OsAlarm_CddTouchTimeout (OsAlarm): OsAlarmCounterRef=OsCounter_1ms, OsAlarmAccessingApplication=SystemApplication_OsCore0
      OsAlarmAction
        OsAlarmSetEvent: OsAlarmSetEventRef=Rte_Ev_Run1_CddTouchCypressGen7_CddTouch_Timeout, OsAlarmSetEventTaskRef=Os/OsTask_ApplMainFunctions
    5 x OsEvent:
      Rte_Ev_OnEntry_OsTask_ApplMainFunctions_ComM_UM_CN_MIBCAN_49695965_currentMode_COMM_NO_COMMUNICATION
      Rte_Ev_Run_CddNvMManager_CddNvMManager_SystemVersionUpdate
      Rte_Ev_Run_CddTouchCypressGen7_CddTouch_ModeReq
      Rte_Ev_Run_SwcDisplayControl_SwcDispCtrl_ProcessBist
      Rte_Ev_Run_SwcError_SwcError_OnEntryDcmDefaultSession
    Rte_Res_SwcComHandlerTx_EASwcComTxCmdQueueAccess (OsResource): OsResourceProperty=STANDARD, OsResourceAccessingApplication=SystemApplication_OsCore0
    7 x OsEvent:
      Rte_Ev_Run_CddKnockout_CddKo_ProcessBem02Data
      Rte_Ev_Run1_CddSliderBackLightTiSN1903001_CddSldr_OnReadSeqReady
      Rte_Ev_Run1_CddSliderBackLightTiSN1903001_CddSldr_OnWriteSeqReady
      Rte_Ev_Run1_SwcTestInterface_SwcTestIf_ProcessTouchData
      Rte_Ev_Run2_SwcTestInterface_SwcTestIf_ProcessTouchData
      Rte_Ev_Run_CddSliderBackLightTiSN1903001_CddSldr_ProcessSwcDispCtrlModeReq
      Rte_Ev_Run_SwcTouch_SwcTouch_ProcessSliderData
    Rte_Res_CddSliderBackLightTiSN1903001_EACddSldrBuffer (OsResource): OsResourceProperty=STANDARD, OsResourceAccessingApplication=SystemApplication_OsCore0
    3 x OsEvent:
      Rte_Ev_OnExit_OsTask_ApplMainFunctions_ComM_UM_CN_MIBCAN_49695965_currentMode_COMM_NO_COMMUNICATION
      Rte_Ev_Run1_CddNvMManager_CddNvMManager_HwrDlStateUpdate
      Rte_Ev_Run1_CddTouchCypressGen7_CddTouch_Timeout
    3 x OsResource, all with OsResourceProperty=STANDARD, OsResourceAccessingApplication=SystemApplication_OsCore0:
      Rte_Res_CddTouchCypressGen7_EACddTouchMode
      Rte_Res_CddTouchCypressGen7_EACddTouchTrigger
      Rte_Res_CddPeripheralControl_EACddPerCtrlDiagAccess
    Rte_Ev_Run1_CddDebugInfo_CddDbgInfo_OnTxReady (OsEvent)
    Rte_Res_CddDebugInfo_EACddDbgInfoBuffer (OsResource): OsResourceProperty=STANDARD, OsResourceAccessingApplication=SystemApplication_OsCore0
    Rte_Res_SwcHWR_EASwcHWRCharDataBuffer (OsResource): OsResourceProperty=STANDARD, OsResourceAccessingApplication=SystemApplication_OsCore0
    Rte_Ev_Run_CddBoosterMaximMAX20069_CddBstr_ProcessSwcDispCtrlModeReq (OsEvent)
    Rte_Al_TE_SwcSelfDiagnostics_SwcSelfDiag_UpdateCpuLoad (OsAlarm): OsAlarmCounterRef=OsCounter_10ms, OsAlarmAccessingApplication=SystemApplication_OsCore0
      OsAlarmAction
        OsAlarmSetEvent: OsAlarmSetEventRef=Rte_Ev_Run1_SwcSelfDiagnostics_SwcSelfDiag_UpdateCpuLoad, OsAlarmSetEventTaskRef=Os/OsTask_SelfDiagnostics
    Rte_Al_TE_SwcSelfDiagnostics_SwcSelfDiag_UpdateRuntime (OsAlarm): OsAlarmCounterRef=OsCounter_10ms, OsAlarmAccessingApplication=SystemApplication_OsCore0
      OsAlarmAction
        OsAlarmSetEvent: OsAlarmSetEventRef=Rte_Ev_Run_SwcSelfDiagnostics_SwcSelfDiag_UpdateRuntime, OsAlarmSetEventTaskRef=Os/OsTask_SelfDiagnostics
    10 x OsEvent:
      Rte_Ev_Run1_SwcSelfDiagnostics_SwcSelfDiag_UpdateCpuLoad
      Rte_Ev_Run_SwcSelfDiagnostics_SwcSelfDiag_EvaluateBacklightTemp
      Rte_Ev_Run_SwcSelfDiagnostics_SwcSelfDiag_EvaluateBatteryVoltage
      Rte_Ev_Run_SwcSelfDiagnostics_SwcSelfDiag_EvaluateBlTempDeratingLimit
      Rte_Ev_Run_SwcSelfDiagnostics_SwcSelfDiag_UpdateRuntime
      Rte_Ev_Run_CddPanelHimaxHx8249B_CddPnl_ProcessSwcDispCtrolModeReq
      Rte_Ev_Run_CddDeserializerTIDS90Ux948_CddDser_ProcessSwcDispCtrlModeReq
      Rte_Ev_Run_SwcDisplayControl_SwcDispCtrl_OnExitSldrBacklightEnabled
      Rte_Ev_Run_CddDownloadManager_CddDlMngr_OnEntryProgrammingSession
      Rte_Ev_Run_CddDownloadManager_CddDlMngr_OnExitProgrammingSession
    Rte_Al_TE_SwcTouch_SwcTouch_MainFunction (OsAlarm): OsAlarmCounterRef=OsCounter_1ms, OsAlarmAccessingApplication=SystemApplication_OsCore0
      OsAlarmAction
        OsAlarmSetEvent: OsAlarmSetEventRef=Rte_Ev_Run1_SwcTouch_SwcTouch_MainFunction, OsAlarmSetEventTaskRef=Os/OsTask_Touch
    Rte_Ev_Run1_SwcTouch_SwcTouch_MainFunction (OsEvent)
