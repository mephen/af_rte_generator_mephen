AUTOSAR XML (schema 00048)
package /ActiveEcuC
  module config EcuC1: definition=EcuC
    EcucPartitionCollection
      EcucPartition0 (EcucPartition): PartitionCanBeRestarted=true, EcucEcuPartitionRef=Kobe
      EcucPartition1 (EcucPartition): PartitionCanBeRestarted=true, EcucEcuPartitionRef=LarryBird
    EcucHardware
      EcucCoreDefinition0 (EcucCoreDefinition): EcucCoreId=0
      EcucCoreDefinition1 (EcucCoreDefinition): EcucCoreId=1
