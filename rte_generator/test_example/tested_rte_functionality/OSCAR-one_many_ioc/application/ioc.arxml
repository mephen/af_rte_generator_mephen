AUTOSAR XML (schema 00051)
package /ActiveEcuC
  module config OS: definition=Os
    IOC (OsIoc)
      4 x OsIocCommunication:
        Q1
          IOC_UNQUE_DATA (OsIocDataProperties): OsIocInitValue=444, OsIocDataTypeRef=Impl_uint16
          SND1 (OsIocSenderProperties): OsIocSenderId=0, OsIocFunctionImplementationKind=FUNCTION, OsIocSendingOsApplicationRef=App0
          RCV1 (OsIocReceiverProperties): OsIocReceiverId=0, OsIocFunctionImplementationKind=FUNCTION, OsIocReceivingOsApplicationRef=App1
          RCV2 (OsIocReceiverProperties): OsIocReceiverId=1, OsIocFunctionImplementationKind=FUNCTION, OsIocReceivingOsApplicationRef=App1
        Q2
          IOC_UNQUE_DATA (OsIocDataProperties): OsIocInitValue=222, OsIocDataTypeRef=Impl_uint16
          SND1 (OsIocSenderProperties): OsIocSenderId=0, OsIocFunctionImplementationKind=FUNCTION, OsIocSendingOsApplicationRef=App0
          RCV1 (OsIocReceiverProperties): OsIocReceiverId=0, OsIocFunctionImplementationKind=FUNCTION, OsIocReceivingOsApplicationRef=App1
          RCV2 (OsIocReceiverProperties): OsIocReceiverId=1, OsIocFunctionImplementationKind=FUNCTION, OsIocReceivingOsApplicationRef=App1
        Q3_1
          IOC_QUE_DATA (OsIocDataProperties): OsIocDataTypeRef=Impl_uint16
          RCV1 (OsIocReceiverProperties): OsIocReceiverId=0, OsIocFunctionImplementationKind=FUNCTION, OsIocReceivingOsApplicationRef=App1
          SND1 (OsIocSenderProperties): OsIocSenderId=0, OsIocFunctionImplementationKind=FUNCTION, OsIocSendingOsApplicationRef=App0
        Q3_2
          IOC_QUE_DATA (OsIocDataProperties): OsIocDataTypeRef=Impl_uint16
          RCV1 (OsIocReceiverProperties): OsIocReceiverId=0, OsIocFunctionImplementationKind=FUNCTION, OsIocReceivingOsApplicationRef=App1
          SND1 (OsIocSenderProperties): OsIocSenderId=0, OsIocFunctionImplementationKind=FUNCTION, OsIocSendingOsApplicationRef=App0
