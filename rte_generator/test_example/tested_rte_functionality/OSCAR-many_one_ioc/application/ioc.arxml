AUTOSAR XML (schema 00051)
package /ActiveEcuC
  module config OS: definition=Os
    IOC (OsIoc)
      3 x OsIocCommunication:
        Q1
          IOC_UNQUE_DATA (OsIocDataProperties): OsIocInitValue=111, OsIocDataTypeRef=Impl_uint16
          SND1 (OsIocSenderProperties): OsIocSenderId=0, OsIocFunctionImplementationKind=FUNCTION, OsIocSendingOsApplicationRef=App0
          SND2 (OsIocSenderProperties): OsIocSenderId=1, OsIocFunctionImplementationKind=FUNCTION, OsIocSendingOsApplicationRef=App0
          RCV1 (OsIocReceiverProperties): OsIocReceiverId=0, OsIocFunctionImplementationKind=FUNCTION, OsIocReceivingOsApplicationRef=App1
        Q2
          IOC_UNQUE_DATA (OsIocDataProperties): OsIocInitValue=111, OsIocDataTypeRef=Impl_uint16
          SND1 (OsIocSenderProperties): OsIocSenderId=0, OsIocFunctionImplementationKind=FUNCTION, OsIocSendingOsApplicationRef=App0
          SND2 (OsIocSenderProperties): OsIocSenderId=1, OsIocFunctionImplementationKind=FUNCTION, OsIocSendingOsApplicationRef=App0
          RCV1 (OsIocReceiverProperties): OsIocReceiverId=0, OsIocFunctionImplementationKind=FUNCTION, OsIocReceivingOsApplicationRef=App1
        Q3
          IOC_QUE_DATA (OsIocDataProperties): OsIocDataTypeRef=Impl_uint16
          SND1 (OsIocSenderProperties): OsIocSenderId=0, OsIocFunctionImplementationKind=FUNCTION, OsIocSendingOsApplicationRef=App0
          SND2 (OsIocSenderProperties): OsIocSenderId=1, OsIocFunctionImplementationKind=FUNCTION, OsIocSendingOsApplicationRef=App0
          RCV1 (OsIocReceiverProperties): OsIocReceiverId=0, OsIocFunctionImplementationKind=FUNCTION, OsIocReceivingOsApplicationRef=App1
