AUTOSAR XML (schema 00051)
package /ActiveEcuC
  module definition Os
    container OsIoc
      container OsIocCommunication
        integer OsIocBufferLength
        container OsIocSenderProperties
          integer OsIocSenderId
          enumeration OsIocFunctionImplementationKind
          reference OsIocSendingOsApplicationRef
        container OsIocReceiverProperties
          integer OsIocReceiverId
          enumeration OsIocFunctionImplementationKind
          function name OsIocReceiverPullCB
          reference OsIocReceivingOsApplicationRef
        container OsIocDataProperties
          foreign reference OsIocDataTypeRef
          foreign reference OsMemoryMappingCodeLocationRef
          string OsIocInitValue
          integer OsIocDataPropertyIndex
