AUTOSAR XML (schema 4-1-1)
package /ActiveEcuC
  module config Com: implementation-config-variant=VARIANT-POST-BUILD
    ComConfig: ComConfigurationId=(unset)
      ComTimeBase: ComRxTimeBase=0.001, ComTxTimeBase=0.001
      ComSignal1 (ComSignal):
        ComBitPosition = 0
        ComHandleId = (unset)
        ComSignalEndianness = opaque
        ComSignalType = UINT8_N
        ComTransferProperty = PENDING
        ComSignalInitValue = 0x00
        ComSignalLength = 8
        ComFirstTimeout = 0
        ComTimeout = 0
        ComSystemTemplateSystemSignalRef = pluginInstallationVCUsignalargInt32Mapping
      ComSignal2 (ComSignal):
        ComBitPosition = 0
        ComHandleId = (unset)
        ComSignalEndianness = opaque
        ComSignalType = UINT8_N
        ComSignalInitValue = 0
        ComSignalLength = 8
        ComTransferProperty = PENDING
        ComFirstTimeout = 0
        ComTimeout = 0
        ComSystemTemplateSystemSignalRef = pluginCommunicationTCUtoVCUsignalargInt32Mapping
    ComGeneral
