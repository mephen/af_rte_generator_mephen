AUTOSAR XML (schema 00048)
package /ActiveEcuC
  module config Os0: definition=Os
    App0 (OsApplication):
      OsTrusted = TRUE
      OsTrustedApplicationDelayTimingViolationCall = TRUE
      OsTrustedApplicationWithProtection = TRUE
      OsApplicationCoreRef = EcucCoreDefinition0
      OsAppEcucPartitionRef = EcucPartition0
      OsAppCounterRef = Counter001
      OsAppTaskRef = T001
      OsAppIsrRef = I001
      OsAppAlarmRef = Alarm001
      OsAppScheduleTableRef = ST001
      OsRestartTask = T001
      AIMER (OsApplicationTrustedFunction): OsTrustedFunctionName=AIMER, OsMemoryMappingCodeLocationRef=None
    App1 (OsApplication):
      OsTrusted = TRUE
      OsTrustedApplicationDelayTimingViolationCall = TRUE
      OsTrustedApplicationWithProtection = FALSE
      OsApplicationCoreRef = EcucCoreDefinition1
      OsAppEcucPartitionRef = EcucPartition1
      OsAppCounterRef = Counter011
      OsAppTaskRef = T011
      OsAppIsrRef = I011
      OsAppAlarmRef = Alarm011
      OsAppScheduleTableRef = ST011
      OsRestartTask = T011
      YUURI (OsApplicationTrustedFunction): OsTrustedFunctionName=YUURI, OsMemoryMappingCodeLocationRef=None
    OSDEFAULTAPPMODE (OsAppMode)
    T001 (OsTask): OsTaskActivation=1, OsTaskPriority=1, OsTaskSchedule=FULL, OsTaskStackSize=512, OsTaskType=BASIC, OsTaskAccessingApplication=App0
    T011 (OsTask): OsTaskActivation=1, OsTaskPriority=1, OsTaskSchedule=FULL, OsTaskStackSize=512, OsTaskType=BASIC, OsTaskAccessingApplication=App1
    Counter001 (OsCounter): OsCounterMaxAllowedValue=100, OsCounterMinCycle=0, OsCounterTicksPerBase=1, OsCounterType=HARDWARE
    Counter011 (OsCounter): OsCounterMaxAllowedValue=100, OsCounterMinCycle=0, OsCounterTicksPerBase=1, OsCounterType=HARDWARE
    I001 (OsIsr): OsIsrCategory=CATEGORY_2
    I011 (OsIsr): OsIsrCategory=CATEGORY_2
    E001 (OsEvent): OsEventMask=2
    E011 (OsEvent): OsEventMask=1
    Alarm001 (OsAlarm): OsAlarmCounterRef=Counter001, OsAlarmAccessingApplication=App0
      OsAlarmAction
        OsAlarmSetEvent: OsAlarmSetEventRef=E001, OsAlarmSetEventTaskRef=T001
    Alarm011 (OsAlarm): OsAlarmCounterRef=Counter011, OsAlarmAccessingApplication=App1
      OsAlarmAction
        OsAlarmSetEvent: OsAlarmSetEventRef=E011, OsAlarmSetEventTaskRef=T011
    ST001 (OsScheduleTable): OsScheduleTableDuration=10, OsScheduleTableRepeating=FALSE, OsTaskAccessingApplication=App0, OsScheduleTableCounterRef=Counter001
      ep0 (OsScheduleTableExpiryPoint): OsScheduleTblExpPointOffset=2
        OSTactivatetask1-1 (OsScheduleTableTaskActivation): OsScheduleTableActivateTaskRef=T002
        OSTadjustpoint1-1 (OsScheduleTblAdjustableExpPoint): OsScheduleTableMaxLengthen=1, OsScheduleTableMaxShorten=1
    ST011 (OsScheduleTable): OsScheduleTableDuration=10, OsScheduleTableRepeating=FALSE, OsTaskAccessingApplication=App1, OsScheduleTableCounterRef=Counter011
      ep0 (OsScheduleTableExpiryPoint): OsScheduleTblExpPointOffset=2
        OSTactivatetask1-1 (OsScheduleTableTaskActivation): OsScheduleTableActivateTaskRef=T002
        OSTadjustpoint1-1 (OsScheduleTblAdjustableExpPoint): OsScheduleTableMaxLengthen=1, OsScheduleTableMaxShorten=1
    IOC (OsIoc)
      3 x OsIocCommunication, all with OsIocBufferLength=30:
        Q1
          IOC_QUE_DATA (OsIocDataProperties): OsIocInitValue=1, OsIocDataTypeRef=int
          RCV (OsIocReceiverProperties): OsIocFunctionImplementationKind=FUNCTION, OsIocReceivingOsApplicationRef=A03
          SND (OsIocSenderProperties): OsIocSenderId=0, OsIocFunctionImplementationKind=FUNCTION, OsIocSendingOsApplicationRef=A01
        Q2
          IOC_QUE_DATA (OsIocDataProperties): OsIocDataPropertyIndex=0, OsIocInitValue=0U, OsIocDataTypeRef=int
          RCV (OsIocReceiverProperties): OsIocFunctionImplementationKind=FUNCTION, OsIocReceivingOsApplicationRef=A02
          SND (OsIocSenderProperties): OsIocFunctionImplementationKind=FUNCTION, OsIocSendingOsApplicationRef=A01
        Q3
          IOC_QUE_DATA (OsIocDataProperties): OsIocDataPropertyIndex=0, OsIocInitValue=0U, OsIocDataTypeRef=void*,int
          RCV (OsIocReceiverProperties): OsIocFunctionImplementationKind=FUNCTION, OsIocReceivingOsApplicationRef=A03
          SND (OsIocSenderProperties): OsIocFunctionImplementationKind=FUNCTION, OsIocSendingOsApplicationRef=A01
