AUTOSAR XML (schema 00051)
package /TPC_Composition/Components
  composition sw component type TPC_Composition
    component Ctrl: type=Controller
    component Ctrl2: type=Controller2
    component Obv: type=Observation
    connect Ctrl2.PpIfVehSpd -> Obv.RpIfVehSpd
    connect Ctrl2.PpIfVehAcc -> Obv.RpIfVehAcc
    connect Ctrl2.PpIfTemperature -> Obv.RpIfTemperature
    connect Ctrl2.PpIfVehSpd2 -> Obv.RpIfVehSpd
    connect Ctrl2.PpIfVehAcc2 -> Obv.RpIfVehAcc
    connect Ctrl2.PpIfTemperature2 -> Obv.RpIfTemperature
