AUTOSAR XML (schema 00048)
package /System
  system ModelX
    root-software-compositions:
      root sw composition prototype RootSwCompositionPrototype: software-composition=TPC_Composition
    system mapping SystemMapping: sender-receiver-to-signal-mapping{data-element=TPC_Composition.Ctrl.PpIfVehSpd.Spd, system-signal=SystemSignal1}
  ecu instance EcuInstance0
    ecu partition Naruto
    ecu partition Sasuke
  ecu instance EcuInstance1
    ecu partition Kobe
    ecu partition LarryBird
package /Network
  pdu ISignalIPdu1
    signal ISignal1: 32 bit, data-type-policy=PORT-INTERFACE-DEFINITION
