AUTOSAR XML (schema 00051)
package /ActiveEcuC
  module config Os0
    event1 (OsEvent): OsEventMask=2
    4 x OsApplication:
      App1: OsApplicationCoreRef=EcucCoreDefinition0, OsAppEcucPartitionRef=EcucPartition0
      App2: OsApplicationCoreRef=EcucCoreDefinition1, OsAppEcucPartitionRef=EcucPartition1
      App3: OsApplicationCoreRef=EcucCoreDefinition0, OsAppEcucPartitionRef=EcucPartition0
      App4: OsApplicationCoreRef=EcucCoreDefinition1, OsAppEcucPartitionRef=EcucPartition1
    12 x OsTask, all with OsTaskActivation=1, OsTaskSchedule=FULL, OsTaskStackSize=512:
      T01: OsTaskPriority=1, OsTaskType=BASIC, OsTaskAccessingApplication=App1
      T02: OsTaskPriority=2, OsTaskType=EXTENDED, OsTaskAccessingApplication=App1
      T04: OsTaskPriority=3, OsTaskType=EXTENDED, OsTaskAccessingApplication=App3
      T05: OsTaskPriority=4, OsTaskType=EXTENDED, OsTaskAccessingApplication=App3
      T03: OsTaskPriority=5, OsTaskType=EXTENDED, OsTaskAccessingApplication=App1
      T06: OsTaskPriority=6, OsTaskType=EXTENDED, OsTaskAccessingApplication=App3
      T11: OsTaskPriority=1, OsTaskType=EXTENDED, OsTaskAccessingApplication=App2
      T14: OsTaskPriority=2, OsTaskType=EXTENDED, OsTaskAccessingApplication=App4
      T12: OsTaskPriority=3, OsTaskType=EXTENDED, OsTaskAccessingApplication=App2
      T13: OsTaskPriority=4, OsTaskType=EXTENDED, OsTaskAccessingApplication=App2
      T15: OsTaskPriority=5, OsTaskType=EXTENDED, OsTaskAccessingApplication=App4
      T16: OsTaskPriority=6, OsTaskType=EXTENDED, OsTaskAccessingApplication=App4
    alarm4 ()
