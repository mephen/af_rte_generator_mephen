AUTOSAR XML (schema 00051)
package /ActiveEcuC
  module config Rte
    RteInitializationRunnableBatch
    SWC_LifeCycle_Instance (RteSwComponentInstance)
      4 x RteEventToTaskMapping:
        RteBackgroundEv_1_mapping: RteEventRef=RteBackgroundEvent_1, RteMappedToTaskRef=T16
        RteTimingEv_1_mapping: RteEventRef=RteTimingEvent_1, RteMappedToTaskRef=T02, RteUsedOsAlarmRef=alarm4
        RteInitEvent_1_mapping: RteEventRef=RteInitEvent_1, RteMappedToTaskRef=T03, RteUsedInitFnc=RteInitializationRunnableBatch, RtePositionInTask=2
        RteInitEvent_2_mapping: RteEventRef=RteInitEvent_2, RteMappedToTaskRef=T03, RteUsedInitFnc=RteInitializationRunnableBatch, RtePositionInTask=1
    SWC_Mode_A_Instance (RteSwComponentInstance)
      RteModeSwitchEvent_1_mapping (RteEventToTaskMapping): RteEventRef=RteModeSwitchEvent_1, RteMappedToTaskRef=T04
      RteModeSwitchEvent_2_mapping (RteEventToTaskMapping): RteEventRef=RteModeSwitchEvent_2, RteMappedToTaskRef=T04
