AUTOSAR XML (schema 00051)
package /CS_Composition/ModeGroup_ARPackage
  mode declaration group ModeGroup: initial-mode=INITMODE
    mode INITMODE
package /CS_Composition/SWCs
  application sw component type SWC_LifeCycle
    behavior SWC_LifeCycle_InternalBehavior
      background event RteBackgroundEvent_1: start-on-event=Runnable_background_1
      timing event RteTimingEvent_1: start-on-event=Runnable_timing_1, period=20
      init event RteInitEvent_1: start-on-event=Runnable_init_1
      init event RteInitEvent_2: start-on-event=Runnable_init_2
      4 x runnable:
        Runnable_background_1
        Runnable_timing_1
        Runnable_init_1
        Runnable_init_2
  application sw component type SWC_Mode_A
    behavior SWC_Mode_A_InternalBehavior
      swc mode switch event RteModeSwitchEvent_1: start-on-event=Runnable_modeSwitch_1, activation=ON-ENTRY, mode=INITMODE
      swc mode switch event RteModeSwitchEvent_2: start-on-event=Runnable_modeSwitch_2, mode=INITMODE
      runnable Runnable_modeSwitch_1
      runnable Runnable_modeSwitch_2
