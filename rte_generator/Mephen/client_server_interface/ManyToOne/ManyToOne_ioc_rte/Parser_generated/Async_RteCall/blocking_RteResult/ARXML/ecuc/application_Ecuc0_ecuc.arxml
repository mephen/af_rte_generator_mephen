AUTOSAR XML (schema 00051)
package /ActiveEcuC
  module config EcuC0: definition=EcuC
    EcucPartitionCollection
      EcucPartition0 (EcucPartition): PartitionCanBeRestarted=true, EcucEcuPartitionRef=Naruto
      EcucPartition1 (EcucPartition): PartitionCanBeRestarted=true, EcucEcuPartitionRef=Sasuke
    EcucHardware
      EcucCoreDefinition0 (EcucCoreDefinition): EcucCoreId=0
      EcucCoreDefinition1 (EcucCoreDefinition): EcucCoreId=1
