AUTOSAR XML (schema 00051)
package /bsw/BswModuleEntrys
  15 x bsw module entry, all with call-type=SCHEDULED, execution-context=TASK:
    BswSchedulableEntity_Entry
    BswSchedulableEntity_Temp_Sender_Entry
    BswSchedulableEntity_Temp_Receive_Entry
    BswSchedulableEntity_Acc_Sender_Entry
    BswSchedulableEntity_Acc_Receive_Entry
    BswSchedulableEntity_required_ClientServer_Entry1: is-synchronous=true
      sw service arg BswSchedulableEntity_required_ClientServer_Entry1_argument1: implementation-data-type=Impl_uint16
      sw service arg BswSchedulableEntity_required_ClientServer_Entry1_argument2: implementation-data-type=Impl_uint16
      return type BswSchedulableEntity_required_ClientServer_Entry1_ReturnType1: implementation-data-type=Impl_uint16
    BswSchedulableEntity_required_ClientServer_Entry2: is-synchronous=true
      sw service arg BswSchedulableEntity_required_ClientServer_Entry2_argument1: implementation-data-type=Impl_uint16
      sw service arg BswSchedulableEntity_required_ClientServer_Entry2_argument2: implementation-data-type=Impl_uint16
      return type BswSchedulableEntity_required_ClientServer_Entry2_ReturnType1: implementation-data-type=Impl_uint16
    BswSchedulableEntity_provided_ClientServer_Entry1: is-synchronous=true
      sw service arg BswSchedulableEntity_provided_ClientServer_Entry1_argument1: implementation-data-type=Impl_uint16
      sw service arg BswSchedulableEntity_provided_ClientServer_Entry1_argument2: implementation-data-type=Impl_uint16
      return type BswSchedulableEntity_provided_ClientServer_Entry1_ReturnType1: implementation-data-type=Impl_uint16
    BswSchedulableEntity_provided_ClientServer_Entry2: is-synchronous=true
      sw service arg BswSchedulableEntity_provided_ClientServer_Entry2_argument1: implementation-data-type=Impl_uint16
      sw service arg BswSchedulableEntity_provided_ClientServer_Entry2_argument2: implementation-data-type=Impl_uint16
      return type BswSchedulableEntity_provided_ClientServer_Entry2_ReturnType1: implementation-data-type=Impl_uint16
    BswSchedulableEntity_required_ClientServer_Entry3: is-synchronous=false
      sw service arg BswSchedulableEntity_required_ClientServer_Entry3_argument1: implementation-data-type=Impl_uint16
      sw service arg BswSchedulableEntity_required_ClientServer_Entry3_argument2: implementation-data-type=Impl_uint16
      return type BswSchedulableEntity_required_ClientServer_Entry3_ReturnType1: implementation-data-type=Impl_uint16
    BswSchedulableEntity_required_ClientServer_Entry4: is-synchronous=false
      sw service arg BswSchedulableEntity_required_ClientServer_Entry4_argument1: implementation-data-type=Impl_uint16
      sw service arg BswSchedulableEntity_required_ClientServer_Entry4_argument2: implementation-data-type=Impl_uint16
      return type BswSchedulableEntity_required_ClientServer_Entry4_ReturnType1: implementation-data-type=Impl_uint16
    BswSchedulableEntity_provided_ClientServer_Entry3: is-synchronous=false
      sw service arg BswSchedulableEntity_provided_ClientServer_Entry3_argument1: implementation-data-type=Impl_uint16
      sw service arg BswSchedulableEntity_provided_ClientServer_Entry3_argument2: implementation-data-type=Impl_uint16
      return type BswSchedulableEntity_provided_ClientServer_Entry3_ReturnType1: implementation-data-type=Impl_uint16
    BswSchedulableEntity_provided_ClientServer_Entry4: is-synchronous=false
      sw service arg BswSchedulableEntity_provided_ClientServer_Entry4_argument1: implementation-data-type=Impl_uint16
      sw service arg BswSchedulableEntity_provided_ClientServer_Entry4_argument2: implementation-data-type=Impl_uint16
      return type BswSchedulableEntity_provided_ClientServer_Entry4_ReturnType1: implementation-data-type=Impl_uint16
    BswSchedulableEntity_ExternalTriggerSource_Entry
    BswSchedulableEntity_ExternalTriggerSink_Entry
package /bsw/BswModuleDescription
  4 x bsw module description:
    Bsw1_Engine_Controller: module-id=80, implemented-entrys=BswSchedulableEntity_Entry
      provided-mode-groups:
        mode declaration group prototype ModeProvided: type=Engine_MDGroup
      bsw internal behavior IB_Engine_Controller: bsw-mode-sender-policy{enhanced-mode-api=false, provided-mode-group=ModeProvided, ack-request=timeout=10, queue-length=10}
        bsw schedulable entity BE_Engine_ModeSwitch: managed-mode-groups=ModeProvided
        bsw schedulable entity BE_Engine_Test
        bsw schedulable entity BE_Engine_ModeSwitchAck
        bsw mode switch event EV_Engine_ModeSwitch: starts-on-event=BE_Engine_ModeSwitch
        bsw mode switch event EV_Engine_Test: starts-on-event=BE_Engine_Test
        bsw mode switched ack event EV_Engine_ModeSwitchAck: starts-on-event=BE_Engine_ModeSwitchAck, mode-group=ModeProvided
    Bsw2_Engine_Mode_Display: module-id=90, implemented-entrys=BswSchedulableEntity_Entry
      required-mode-groups:
        mode declaration group prototype ModeRequired: type=Engine_MDGroup
      bsw internal behavior IB_Engine_Mode_Display: bsw-mode-receiver-policy{enhanced-mode-api=false, required-mode-group=ModeRequired, supports-asynchronous-mode-switch=false}
        21 x bsw schedulable entity:
          BE_{0..4}
          BE_5: accessed-mode-groups=ModeRequired
          BE_Mode0_Exit
          BE_Mode0_Transition
          BE_Mode0_Entry
          BE_Mode1_Exit
          BE_Mode1_Transition
          BE_Mode1_Entry
          BE_Mode2_Exit
          BE_Mode2_Transition
          BE_Mode2_Entry
          BE_Mode3_Exit
          BE_Mode3_Transition
          BE_Mode3_Entry
          BE_Mode4_Exit
          BE_Mode4_Transition
          BE_Mode4_Entry
        21 x bsw mode switch event:
          EV_10: starts-on-event=BE_0, disabled-in-mode=[INITMODE, P]
          EV_11: starts-on-event=BE_1, disabled-in-mode=P
          EV_12: starts-on-event=BE_2, disabled-in-mode=R
          EV_13: starts-on-event=BE_3, disabled-in-mode=N
          EV_14: starts-on-event=BE_4, disabled-in-mode=D
          EV_15: starts-on-event=BE_5
          EV_bsw_Mode0_Exit: starts-on-event=BE_Mode0_Exit, activation=ON-EXIT, mode=ModeRequired.INITMODE
          EV_bsw_Mode0_Transition: starts-on-event=BE_Mode0_Transition, activation=ON-TRANSITION, mode=ModeRequired.INITMODE
          EV_bsw_Mode0_Entry: starts-on-event=BE_Mode0_Entry, activation=ON-ENTRY, mode=ModeRequired.INITMODE
          EV_bsw_Mode1_Exit: starts-on-event=BE_Mode1_Exit, activation=ON-EXIT, mode=ModeRequired.P
          EV_bsw_Mode1_Transition: starts-on-event=BE_Mode1_Transition, activation=ON-TRANSITION, mode=ModeRequired.P
          EV_bsw_Mode1_Entry: starts-on-event=BE_Mode1_Entry, activation=ON-ENTRY, mode=ModeRequired.P
          EV_bsw_Mode2_Exit: starts-on-event=BE_Mode2_Exit, activation=ON-EXIT, mode=ModeRequired.R
          EV_bsw_Mode2_Transition: starts-on-event=BE_Mode2_Transition, activation=ON-TRANSITION, mode=ModeRequired.R
          EV_bsw_Mode2_Entry: starts-on-event=BE_Mode2_Entry, activation=ON-ENTRY, mode=ModeRequired.R
          EV_bsw_Mode3_Exit: starts-on-event=BE_Mode3_Exit, activation=ON-EXIT, mode=ModeRequired.N
          EV_bsw_Mode3_Transition: starts-on-event=BE_Mode3_Transition, activation=ON-TRANSITION, mode=ModeRequired.N
          EV_bsw_Mode3_Entry: starts-on-event=BE_Mode3_Entry, activation=ON-ENTRY, mode=ModeRequired.N
          EV_bsw_Mode4_Exit: starts-on-event=BE_Mode4_Exit, activation=ON-EXIT, mode=ModeRequired.D
          EV_bsw_Mode4_Transition: starts-on-event=BE_Mode4_Transition, activation=ON-TRANSITION, mode=ModeRequired.D
          EV_bsw_Mode4_Entry: starts-on-event=BE_Mode4_Entry, activation=ON-ENTRY, mode=ModeRequired.D
    Bsw12_lifecycle1: module-id=190
      bsw internal behavior IB_lifecycle1
        bsw schedulable entity BE_background1
        bsw schedulable entity BE_timing1
        bsw background event EV_background1: starts-on-event=BE_background1
        bsw timing event EV_timing1: starts-on-event=BE_timing1, period=20
    Bsw13_lifecycle2: module-id=200
      bsw internal behavior IB_lifecycle2
        bsw schedulable entity BE_background2
        bsw schedulable entity BE_timing2
        bsw background event EV_background2: starts-on-event=BE_background2
        bsw timing event EV_timing2: starts-on-event=BE_timing2, period=30
package /bsw/Engine_MDGroup
  mode declaration group Engine_MDGroup: category=ALPHABETIC_ORDER, initial-mode=INITMODE, mode-manager-error-behavior=error-reaction-policy=DEFAULT-MODE, mode-user-error-behavior=error-reaction-policy=DEFAULT-MODE
    5 x mode:
      INITMODE
      P
      R
      N
      D
package /bsw/BswEntryRelationshipSet
  bsw entry relationship set BswEntryRelationshipSet
    bsw-entry-relationships:
      from=BswSchedulableEntity_Temp_Sender_Entry, to=BswSchedulableEntity_Temp_Receive_Entry
      from=BswSchedulableEntity_Acc_Sender_Entry, to=BswSchedulableEntity_Acc_Receive_Entry
      from=BswSchedulableEntity_required_ClientServer_Entry1, to=BswSchedulableEntity_provided_ClientServer_Entry1
      from=BswSchedulableEntity_required_ClientServer_Entry3, to=BswSchedulableEntity_provided_ClientServer_Entry3
      from=BswSchedulableEntity_required_ClientServer_Entry2, to=BswSchedulableEntity_provided_ClientServer_Entry2
      from=BswSchedulableEntity_required_ClientServer_Entry4, to=BswSchedulableEntity_provided_ClientServer_Entry4
      from=BswSchedulableEntity_ExternalTriggerSource_Entry, to=BswSchedulableEntity_ExternalTriggerSink_Entry
