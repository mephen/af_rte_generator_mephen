AUTOSAR XML (schema 00048)
package /ActiveEcuC
  module config Os
    4 x OsApplication:
      App1: OsApplicationCoreRef=EcucCoreDefinition0, OsAppEcucPartitionRef=EcucPartition0
      App2: OsApplicationCoreRef=EcucCoreDefinition1, OsAppEcucPartitionRef=EcucPartition0
      App3: OsApplicationCoreRef=EcucCoreDefinition0, OsAppEcucPartitionRef=EcucPartition1
      App4: OsApplicationCoreRef=EcucCoreDefinition1, OsAppEcucPartitionRef=EcucPartition1
    12 x OsTask, all with OsTaskActivation=1, OsTaskSchedule=FULL, OsTaskStackSize=512:
      T01: OsTaskPriority=1, OsTaskType=BASIC, OsTaskAccessingApplication=App1
      T02: OsTaskPriority=2, OsTaskType=EXTENDED, OsTaskAccessingApplication=App1
      T04: OsTaskPriority=3, OsTaskType=EXTENDED, OsTaskAccessingApplication=App3
      T05: OsTaskPriority=4, OsTaskType=EXTENDED, OsTaskAccessingApplication=App3
      T03: OsTaskPriority=5, OsTaskType=EXTENDED, OsTaskAccessingApplication=App1
      T06: OsTaskPriority=6, OsTaskType=EXTENDED, OsTaskAccessingApplication=App3
      T11: OsTaskPriority=1, OsTaskType=EXTENDED, OsTaskAccessingApplication=App2
      T14: OsTaskPriority=2, OsTaskType=EXTENDED, OsTaskAccessingApplication=App4
      T12: OsTaskPriority=3, OsTaskType=EXTENDED, OsTaskAccessingApplication=App2
      T13: OsTaskPriority=4, OsTaskType=EXTENDED, OsTaskAccessingApplication=App2
      T15: OsTaskPriority=5, OsTaskType=EXTENDED, OsTaskAccessingApplication=App4
      T16: OsTaskPriority=6, OsTaskType=EXTENDED, OsTaskAccessingApplication=App4
    IOC (OsIoc)
      Q3 (OsIocCommunication): OsIocBufferLength=30
        IOC_QUE_DATA (OsIocDataProperties): OsIocDataTypeRef=Impl_uint16
        SND (OsIocSenderProperties): OsIocSenderId=0, OsIocFunctionImplementationKind=FUNCTION, OsIocSendingOsApplicationRef=App1
        RCV (OsIocReceiverProperties): OsIocReceiverId=0, OsIocFunctionImplementationKind=FUNCTION, OsIocReceivingOsApplicationRef=App2
