AUTOSAR XML (schema 00051)
package /EcuC
  module config Os
    20 x :
      App{1..4}
      T{01..06}
      T{11..16}
      event{1..3}
      OsIoc
