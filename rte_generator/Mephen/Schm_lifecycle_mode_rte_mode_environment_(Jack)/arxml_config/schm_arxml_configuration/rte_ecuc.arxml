AUTOSAR XML (schema 00051)
package /EcuC
  module config Rte
    4 x RteBswModuleInstance:
      Bsw1
        Bsw1_Engine_ModeSwitch (RteBswEventToTaskMapping): RteBswEventRef=EV_Engine_ModeSwitch, RteBswMappedToTaskRef=T02, RteBswUsedOsEventRef=event1
        Bsw1_Engine_ModeSwitchAck (RteBswEventToTaskMapping): RteBswEventRef=EV_Engine_ModeSwitchAck, RteBswMappedToTaskRef=T03, RteBswUsedOsEventRef=event1
      Bsw2
        20 x RteBswEventToTaskMapping, all with RteBswUsedOsEventRef=event1:
          Bsw2_BE_0: RteBswEventRef=EV_10, RteBswMappedToTaskRef=T15
          Bsw2_BE_1: RteBswEventRef=EV_11, RteBswMappedToTaskRef=T15
          Bsw2_BE_2: RteBswEventRef=EV_12, RteBswMappedToTaskRef=T15
          Bsw2_BE_3: RteBswEventRef=EV_13, RteBswMappedToTaskRef=T15
          Bsw2_BE_4: RteBswEventRef=EV_14, RteBswMappedToTaskRef=T15
          Bsw2_BE_5: RteBswEventRef=EV_15, RteBswMappedToTaskRef=T15
          BE_Mode0_Exit: RteBswEventRef=EV_bsw_Mode0_Exit, RteBswMappedToTaskRef=T13
          BE_Mode0_Transition: RteBswEventRef=EV_bsw_Mode0_Transition, RteBswMappedToTaskRef=T12
          BE_Mode1_Exit: RteBswEventRef=EV_bsw_Mode1_Exit, RteBswMappedToTaskRef=T13
          BE_Mode1_Transition: RteBswEventRef=EV_bsw_Mode1_Transition, RteBswMappedToTaskRef=T12
          BE_Mode1_Entry: RteBswEventRef=EV_bsw_Mode1_Entry, RteBswMappedToTaskRef=T14
          BE_Mode2_Exit: RteBswEventRef=EV_bsw_Mode2_Exit, RteBswMappedToTaskRef=T13
          BE_Mode2_Transition: RteBswEventRef=EV_bsw_Mode2_Transition, RteBswMappedToTaskRef=T12
          BE_Mode2_Entry: RteBswEventRef=EV_bsw_Mode2_Entry, RteBswMappedToTaskRef=T14
          BE_Mode3_Exit: RteBswEventRef=EV_bsw_Mode3_Exit, RteBswMappedToTaskRef=T13
          BE_Mode3_Transition: RteBswEventRef=EV_bsw_Mode3_Transition, RteBswMappedToTaskRef=T12
          BE_Mode3_Entry: RteBswEventRef=EV_bsw_Mode3_Entry, RteBswMappedToTaskRef=T14
          BE_Mode4_Exit: RteBswEventRef=EV_bsw_Mode4_Exit, RteBswMappedToTaskRef=T13
          BE_Mode4_Transition: RteBswEventRef=EV_bsw_Mode4_Transition, RteBswMappedToTaskRef=T12
          BE_Mode4_Entry: RteBswEventRef=EV_bsw_Mode4_Entry, RteBswMappedToTaskRef=T14
      Bsw12
        BE_background1 (RteBswEventToTaskMapping): RteBswEventRef=EV_background1, RteBswMappedToTaskRef=T16, RteBswUsedOsEventRef=event1
        BE_timing1 (RteBswEventToTaskMapping): RteBswEventRef=EV_timing1, RteBswMappedToTaskRef=T02, RteBswUsedOsAlarmRef=alarm3
      Bsw13
        BE_background2 (RteBswEventToTaskMapping): RteBswEventRef=EV_background2, RteBswMappedToTaskRef=T16, RteBswUsedOsEventRef=event1
        BE_timing2 (RteBswEventToTaskMapping): RteBswEventRef=EV_timing2, RteBswMappedToTaskRef=T14, RteBswUsedOsAlarmRef=alarm1
