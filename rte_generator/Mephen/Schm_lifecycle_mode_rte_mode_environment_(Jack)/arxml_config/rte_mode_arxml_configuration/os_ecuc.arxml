AUTOSAR XML (schema 00051)
package /EcuC
  module config Os
    17 x :
      App0
      App1
      T{01..06}
      T{11..16}
      event{1..3}
