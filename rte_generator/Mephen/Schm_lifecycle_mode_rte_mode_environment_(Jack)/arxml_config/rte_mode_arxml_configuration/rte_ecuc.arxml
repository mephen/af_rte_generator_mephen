AUTOSAR XML (schema 00051)
package /EcuC
  module config Rte
    App1Swc (RteSwComponentInstance): RteSoftwareComponentInstanceRef=Component_ModeManager
      RTE_timing1 (RteEventToTaskMapping): RteEventRef=？, RteMappedToTaskRef=？, RteUsedOsAlarmRef=？
      App1_AC_ModeSwitch (RteEventToTaskMapping): RteEventRef=EV_AC_ModeSwitch, RteMappedToTaskRef=T02, RteUsedOsAlarmRef=alarm4
    App2Swc (RteSwComponentInstance): RteSoftwareComponentInstanceRef=Component_ModeUser
      13 x RteEventToTaskMapping, all with RteUsedOsAlarmRef=event1:
        App2_Mode0_Entry: RteEventRef=EV_Mode0_Entry, RteMappedToTaskRef=T14
        App2_Mode0_Exit: RteEventRef=EV_Mode0_Exit, RteMappedToTaskRef=T13
        App2_Mode0_Transition: RteEventRef=EV_Mode0_Transition, RteMappedToTaskRef=T12
        App2_Mode1_Entry: RteEventRef=EV_Mode1_Entry, RteMappedToTaskRef=T14
        App2_Mode1_Exit: RteEventRef=EV_Mode1_Exit, RteMappedToTaskRef=T13
        App2_Mode1_Transition: RteEventRef=EV_Mode1_Transition, RteMappedToTaskRef=T12
        App2_Mode2_Entry: RteEventRef=EV_Mode2_Entry, RteMappedToTaskRef=T14
        App2_Mode2_Exit: RteEventRef=EV_Mode2_Exit, RteMappedToTaskRef=T13
        App2_Mode2_Transition: RteEventRef=EV_Mode2_Transition, RteMappedToTaskRef=T12
        App2_RE_{0..3}: RteEventRef=EV_{0..3}, RteMappedToTaskRef=T15
