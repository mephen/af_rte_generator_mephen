AUTOSAR XML (schema 00051)
package /Interface_Composition/Interfaces
  client server interface CS_If1
    operation Add_ImplUint16
      arg Add_ImplUint16_Arg1: direction=IN, server-argument-impl-policy=USE-ARGUMENT-TYPE, type=App_uint16
      arg Add_ImplUint16_Arg2: direction=IN, server-argument-impl-policy=USE-ARGUMENT-TYPE, type=App_uint16
    operation Sub_ImplUint16
      arg Sub_ImplUint16_Arg1: direction=IN, server-argument-impl-policy=USE-ARGUMENT-TYPE, type=App_uint16
      arg Sub_ImplUint16_Arg2: direction=IN, server-argument-impl-policy=USE-ARGUMENT-TYPE, type=App_uint16
    operation Multiply_ImplUint16
      arg Multiply_ImplUint16_Arg1: direction=IN, server-argument-impl-policy=USE-ARGUMENT-TYPE, type=App_uint16
      arg Multiply_ImplUint16_Arg2: direction=IN, server-argument-impl-policy=USE-ARGUMENT-TYPE, type=App_uint16
