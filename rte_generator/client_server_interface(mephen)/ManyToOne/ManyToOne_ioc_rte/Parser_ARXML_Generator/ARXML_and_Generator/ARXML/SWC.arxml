AUTOSAR XML (schema 00051)
package /SWC_Composition/SWCs
  application sw component type SWC_Client
    require port SWC_Client_Rport1: required-interface=CS_If1
      required-com-specs:
        end-to-end-call-response-timeout=50, operation=Add_ImplUint16
        end-to-end-call-response-timeout=50, operation=Sub_ImplUint16
        end-to-end-call-response-timeout=50, operation=Multiply_ImplUint16
    behavior SWC_Client_SwcInternalBehavior: port-api-option{port=SWC_Client_Rport1, error-handling=NO-TRANSFORMER-ERROR-HANDLING}
      init event InitEvent_{1..3}
      operation invoked event OperationInvokedEvent_{1..3}
      asynchronous server call returns event AsynchronousServerCallReturnsEvent_{1..3}
      6 x runnable:
        Client_1
          sync call CR1_SynSerCallPoint_1: return-value-provision=RETURN-VALUE-PROVIDED, timeout=50, operation=SWC_Client_Rport1.Add_ImplUint16
          async call CR1_AsynSerCallPoint_1: return-value-provision=RETURN-VALUE-PROVIDED, operation=SWC_Client_Rport1.Add_ImplUint16
        Client_Response_1
          asynchronous server call result point CRR1_AsynSerCallResultPoint_1: return-value-provision=RETURN-VALUE-PROVIDED, asynchronous-server-call-point=CR1_AsynSerCallPoint_1
          asynchronous server call result point CRR1_AsynSerCallResultPoint_2: return-value-provision=RETURN-VALUE-PROVIDED, asynchronous-server-call-point=CR1_AsynSerCallPoint_1
          wait point CRR1_WaitPoint_1: timeout=60, trigger=AsynchronousServerCallReturnsEvent_1
        Client_2
          sync call CR2_SynSerCallPoint_1: return-value-provision=RETURN-VALUE-PROVIDED, timeout=50, operation=SWC_Client_Rport1.Add_ImplUint16
          async call CR2_AsynSerCallPoint_1: return-value-provision=RETURN-VALUE-PROVIDED, operation=SWC_Client_Rport1.Add_ImplUint16
        Client_Response_2
          asynchronous server call result point CRR2_AsynSerCallResultPoint_1: return-value-provision=RETURN-VALUE-PROVIDED, asynchronous-server-call-point=CR2_AsynSerCallPoint_1
          asynchronous server call result point CRR2_AsynSerCallResultPoint_2: return-value-provision=RETURN-VALUE-PROVIDED, asynchronous-server-call-point=CR2_AsynSerCallPoint_1
          wait point CRR2_WaitPoint_1: timeout=60, trigger=AsynchronousServerCallReturnsEvent_2
        Client_3
          sync call CR3_SynSerCallPoint_1: return-value-provision=RETURN-VALUE-PROVIDED, timeout=50, operation=SWC_Client_Rport1.Multiply_ImplUint16
          async call CR3_AsynSerCallPoint_1: return-value-provision=RETURN-VALUE-PROVIDED, operation=SWC_Client_Rport1.Multiply_ImplUint16
        Client_Response_3
          asynchronous server call result point CRR3_AsynSerCallResultPoint_1: return-value-provision=RETURN-VALUE-PROVIDED, asynchronous-server-call-point=CR3_AsynSerCallPoint_1
          asynchronous server call result point CRR3_AsynSerCallResultPoint_3: return-value-provision=RETURN-VALUE-PROVIDED, asynchronous-server-call-point=CR3_AsynSerCallPoint_1
          wait point CRR3_WaitPoint_1: timeout=60, trigger=AsynchronousServerCallReturnsEvent_3
