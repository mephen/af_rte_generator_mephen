AUTOSAR XML (schema 00051)
package /ActiveEcuC
  module config Rte
    3 x RteSwComponentInstance:
      SWC_Client_Instance
        6 x RteEventToTaskMapping:
          SWC_Client_InitEvent_{1..3}_mapping: RteEventRef=InitEvent_{1..3}, RteMappedToTaskRef=T01
          SWC_Client_AsynchronousServerCallReturnsEvent_{1..3}_mapping: RteEventRef=AsynchronousServerCallReturnsEvent_{1..3}, RteMappedToTaskRef=T02, RteUsedOsEventRef=event1
      SWC_Server1_Instance
        SWC_Server1_OperationInvokedEvent_1_mapping (RteEventToTaskMapping): RteEventRef=OperationInvokedEvent_1, RteMappedToTaskRef=T02
        SWC_Server1_OperationInvokedEvent_2_mapping (RteEventToTaskMapping): RteEventRef=OperationInvokedEvent_2, RteMappedToTaskRef=T02
      SWC_Server2_Instance
        SWC_Server2_OperationInvokedEvent_3_mapping (RteEventToTaskMapping): RteEventRef=OperationInvokedEvent_3, RteMappedToTaskRef=T11
